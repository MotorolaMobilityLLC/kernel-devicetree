#include "dsi-panel-mot-dummy-qhd-video.dtsi"

&sde_dsi {

	qcom,dsi-default-panel = <&mot_dummy_vid_qhd>;
};



&mot_dummy_vid_qhd {
    qcom,platform-te-gpio = <&tlmm 23 0>;
    qcom,platform-reset-gpio = <&pmr735a_gpios 2 0>;

    qcom,mdss-dsi-bl-pmic-control-type = "bl_ctrl_dcs";

    qcom,dsi-select-clocks = "mux_byte_clk0", "mux_pixel_clk0";
    qcom,mdss-dsi-t-clk-post = <0x09>;
    qcom,mdss-dsi-t-clk-pre = <0x15>;
    qcom,mdss-dsi-display-timings {
        timing@0 {
            qcom,mdss-dsi-panel-phy-timings = [00 0B 02 02 1C 1C 03
                            02 01 02 04 00];
            qcom,display-topology = <1 0 1>;
            qcom,default-topology-index = <0>;
        };
    };
};
