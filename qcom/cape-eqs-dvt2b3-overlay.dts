/* Copyright (c) 2022, The Linux Foundation. All rights reserved.
 *
 * This program is free software; you can redistribute it and/or modify
 * it under the terms of the GNU General Public License version 2 and
 * only version 2 as published by the Free Software Foundation.
 *
 * This program is distributed in the hope that it will be useful,
 * but WITHOUT ANY WARRANTY; without even the implied warranty of
 * MERCHANTABILITY or FITNESS FOR A PARTICULAR PURPOSE.  See the
 * GNU General Public License for more details.
 */

/dts-v1/;
/plugin/;

#include "cape-eqs-common-overlay.dtsi"

/ {
	model = "eqs";
	compatible = "qcom,cape-mtp", "qcom,cape", "qcom,mtp", "moto,eqs";
	qcom,msm-id = <530 0x10000>, <531 0x10000>, <540 0x10000>;
	qcom,board-id = <0x41 0xB2B3>;
};

&nxp_eusb2_repeater {
	status = "disable";
};

&diodes_eusb2_repeater {
	status = "ok";
};

&eusb2_phy0 {
	dummy-supply = <&diodes_eusb2_repeater>;
	usb-repeater = <&diodes_eusb2_repeater>;
};
