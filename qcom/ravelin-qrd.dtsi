#include "ravelin-pmic-overlay.dtsi"
#include "ravelin-pmi632.dtsi"

&soc {
};

&qupv3_se1_i2c {
	#address-cells = <1>;
	#size-cells = <0>;

	status = "ok";
	qcom,i2c-touch-active = "focaltech,fts_ts";

	focaltech@38 {
		compatible = "focaltech,fts_ts";
		status = "ok";
		reg = <0x38>;

		interrupt-parent = <&tlmm>;
		interrupts = <13 0x2008>;
		focaltech,reset-gpio = <&tlmm 12 0x00>;
		focaltech,irq-gpio = <&tlmm 13 0x2008>;
		focaltech,display-coords = <0 0 1080 2408>;
		focaltech,max-touch-number = <5>;
		focaltech,ic-type = <0x8726081C>;
		focaltech,touch-type = "primary";
		focaltech,touch-environment = "pvm";

		pinctrl-names = "pmx_ts_active","pmx_ts_suspend","pmx_ts_release";
		pinctrl-0 = <&ts_active>;
		pinctrl-1 = <&ts_int_suspend &ts_reset_suspend>;
		pinctrl-2 = <&ts_release>;
	};
};