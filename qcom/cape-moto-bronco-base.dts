/* Copyright (c) 2022, The Linux Foundation. All rights reserved.
 *
 * This program is free software; you can redistribute it and/or modify
 * it under the terms of the GNU General Public License version 2 and
 * only version 2 as published by the Free Software Foundation.
 *
 * This program is distributed in the hope that it will be useful,
 * but WITHOUT ANY WARRANTY; without even the implied warranty of
 * MERCHANTABILITY or FITNESS FOR A PARTICULAR PURPOSE.  See the
 * GNU General Public License for more details.
 */

/dts-v1/;

#include "cape-moto-common-base.dtsi"

/delete-node/ &adsp_mem;
/delete-node/ &video_mem;

/* adsp occupy video region, then move video to the end */
&reserved_memory {
	adsp_mem: adsp_region@85700000 {
		no-map;
		reg = <0x0 0x85700000 0x0 0x2800000>;
	};

	video_mem: video_region@9fd00000 {
		no-map;
		reg = <0x0 0x9fd00000 0x0 0x700000>;
	};
};

&usb_qmp_dp_phy {
	qcom,qmp-phy-init-seq =
		/* <reg_offset, value> */
		<USB3_DP_QSERDES_COM_SSC_STEP_SIZE1_MODE1                  0x55
		USB3_DP_QSERDES_COM_SSC_STEP_SIZE2_MODE1                   0x0E
		USB3_DP_QSERDES_COM_CP_CTRL_MODE1                          0x02
		USB3_DP_QSERDES_COM_PLL_RCTRL_MODE1                        0x16
		USB3_DP_QSERDES_COM_PLL_CCTRL_MODE1                        0x36
		USB3_DP_QSERDES_COM_CORECLK_DIV_MODE1                      0x04
		USB3_DP_QSERDES_COM_LOCK_CMP1_MODE1                        0x2E
		USB3_DP_QSERDES_COM_LOCK_CMP2_MODE1                        0x82
		USB3_DP_QSERDES_COM_DEC_START_MODE1                        0x04
		USB3_DP_QSERDES_COM_DEC_START_MSB_MODE1                    0x01
		USB3_DP_QSERDES_COM_DIV_FRAC_START1_MODE1                  0x55
		USB3_DP_QSERDES_COM_DIV_FRAC_START2_MODE1                  0xD5
		USB3_DP_QSERDES_COM_DIV_FRAC_START3_MODE1                  0x05
		USB3_DP_QSERDES_COM_HSCLK_SEL_1                            0x01
		USB3_DP_QSERDES_COM_VCO_TUNE1_MODE1                        0x25
		USB3_DP_QSERDES_COM_VCO_TUNE2_MODE1                        0x02
		USB3_DP_QSERDES_COM_BIN_VCOCAL_CMP_CODE1_MODE1             0xB7
		USB3_DP_QSERDES_COM_BIN_VCOCAL_CMP_CODE2_MODE1             0x1E
		USB3_DP_QSERDES_COM_BIN_VCOCAL_CMP_CODE1_MODE0             0xB7
		USB3_DP_QSERDES_COM_BIN_VCOCAL_CMP_CODE2_MODE0             0x1E
		USB3_DP_QSERDES_COM_SSC_STEP_SIZE1_MODE0                   0x55
		USB3_DP_QSERDES_COM_SSC_STEP_SIZE2_MODE0                   0x0E
		USB3_DP_QSERDES_COM_CP_CTRL_MODE0                          0x02
		USB3_DP_QSERDES_COM_PLL_RCTRL_MODE0                        0x16
		USB3_DP_QSERDES_COM_PLL_CCTRL_MODE0                        0x36
		USB3_DP_QSERDES_COM_LOCK_CMP1_MODE0                        0x12
		USB3_DP_QSERDES_COM_LOCK_CMP2_MODE0                        0x34
		USB3_DP_QSERDES_COM_DEC_START_MODE0                        0x04
		USB3_DP_QSERDES_COM_DEC_START_MSB_MODE0                    0x01
		USB3_DP_QSERDES_COM_DIV_FRAC_START1_MODE0                  0x55
		USB3_DP_QSERDES_COM_DIV_FRAC_START2_MODE0                  0xD5
		USB3_DP_QSERDES_COM_DIV_FRAC_START3_MODE0                  0x05
		USB3_DP_QSERDES_COM_VCO_TUNE1_MODE0                        0x25
		USB3_DP_QSERDES_COM_VCO_TUNE2_MODE0                        0x02
		USB3_DP_QSERDES_COM_BG_TIMER                               0x0E
		USB3_DP_QSERDES_COM_SSC_EN_CENTER                          0x01
		USB3_DP_QSERDES_COM_SSC_PER1                               0x31
		USB3_DP_QSERDES_COM_SSC_PER2                               0x01
		USB3_DP_QSERDES_COM_SYSCLK_BUF_ENABLE                      0x0C
		USB3_DP_QSERDES_COM_SYSCLK_EN_SEL                          0x1A
		USB3_DP_QSERDES_COM_LOCK_CMP_CFG                           0x14
		USB3_DP_QSERDES_COM_VCO_TUNE_MAP                           0x04
		USB3_DP_QSERDES_COM_CORE_CLK_EN                            0x20
		USB3_DP_QSERDES_COM_CMN_CONFIG_1                           0x04
		USB3_DP_QSERDES_COM_AUTO_GAIN_ADJ_CTRL_1                   0xB6
		USB3_DP_QSERDES_COM_AUTO_GAIN_ADJ_CTRL_2                   0x4B
		USB3_DP_QSERDES_COM_AUTO_GAIN_ADJ_CTRL_3                   0x37
		USB3_DP_QSERDES_COM_ADDITIONAL_MISC                        0x0C
		USB3_DP_QSERDES_TXA_RES_CODE_LANE_TX                       0x00
		USB3_DP_QSERDES_TXA_RES_CODE_LANE_RX                       0x00
		USB3_DP_QSERDES_TXA_RES_CODE_LANE_OFFSET_TX                0x1F
		USB3_DP_QSERDES_TXA_RES_CODE_LANE_OFFSET_RX                0x09
		USB3_DP_QSERDES_TXA_LANE_MODE_1                            0xF5
		USB3_DP_QSERDES_TXA_LANE_MODE_3                            0x3F
		USB3_DP_QSERDES_TXA_LANE_MODE_4                            0x3F
		USB3_DP_QSERDES_TXA_LANE_MODE_5                            0x5F
		USB3_DP_QSERDES_TXA_RCV_DETECT_LVL_2                       0x12
		USB3_DP_QSERDES_TXA_PI_QEC_CTRL                            0x21
		USB3_DP_QSERDES_RXA_UCDR_FO_GAIN                           0x0A
		USB3_DP_QSERDES_RXA_UCDR_SO_GAIN                           0x06
		USB3_DP_QSERDES_RXA_UCDR_FASTLOCK_FO_GAIN                  0x2F
		USB3_DP_QSERDES_RXA_UCDR_SO_SATURATION_AND_ENABLE          0x7F
		USB3_DP_QSERDES_RXA_UCDR_FASTLOCK_COUNT_LOW                0xFF
		USB3_DP_QSERDES_RXA_UCDR_FASTLOCK_COUNT_HIGH               0x0F
		USB3_DP_QSERDES_RXA_UCDR_PI_CONTROLS                       0x99
		USB3_DP_QSERDES_RXA_UCDR_SB2_THRESH1                       0x08
		USB3_DP_QSERDES_RXA_UCDR_SB2_THRESH2                       0x08
		USB3_DP_QSERDES_RXA_UCDR_SB2_GAIN1                         0x00
		USB3_DP_QSERDES_RXA_UCDR_SB2_GAIN2                         0x08
		USB3_DP_QSERDES_RXA_AUX_DATA_TCOARSE_TFINE                 0xA0
		USB3_DP_QSERDES_RXA_VGA_CAL_CNTRL1                         0x54
		USB3_DP_QSERDES_RXA_VGA_CAL_CNTRL2                         0x0F
		USB3_DP_QSERDES_RXA_GM_CAL                                 0x13
		USB3_DP_QSERDES_RXA_RX_EQU_ADAPTOR_CNTRL2                  0x0F
		USB3_DP_QSERDES_RXA_RX_EQU_ADAPTOR_CNTRL3                  0x4A
		USB3_DP_QSERDES_RXA_RX_EQU_ADAPTOR_CNTRL4                  0x0A
		USB3_DP_QSERDES_RXA_RX_IDAC_TSETTLE_LOW                    0x07
		USB3_DP_QSERDES_RXA_RX_IDAC_TSETTLE_HIGH                   0x00
		USB3_DP_QSERDES_RXA_RX_EQ_OFFSET_ADAPTOR_CNTRL1            0x47
		USB3_DP_QSERDES_RXA_SIGDET_CNTRL                           0x04
		USB3_DP_QSERDES_RXA_SIGDET_DEGLITCH_CNTRL                  0x0E
		USB3_DP_QSERDES_RXA_RX_MODE_00_LOW                         0x3F
		USB3_DP_QSERDES_RXA_RX_MODE_00_HIGH                        0xFF
		USB3_DP_QSERDES_RXA_RX_MODE_00_HIGH2                       0xFF
		USB3_DP_QSERDES_RXA_RX_MODE_00_HIGH3                       0xDF
		USB3_DP_QSERDES_RXA_RX_MODE_00_HIGH4                       0xFE
		USB3_DP_QSERDES_RXA_RX_MODE_01_LOW                         0xDC
		USB3_DP_QSERDES_RXA_RX_MODE_01_HIGH                        0x5C
		USB3_DP_QSERDES_RXA_RX_MODE_01_HIGH2                       0x9C
		USB3_DP_QSERDES_RXA_RX_MODE_01_HIGH3                       0x1D
		USB3_DP_QSERDES_RXA_RX_MODE_01_HIGH4                       0x09
		USB3_DP_QSERDES_RXA_DFE_EN_TIMER                           0x04
		USB3_DP_QSERDES_RXA_DFE_CTLE_POST_CAL_OFFSET               0x38
		USB3_DP_QSERDES_RXA_DCC_CTRL1                              0x0C
		USB3_DP_QSERDES_RXA_VTH_CODE                               0x10
		USB3_DP_QSERDES_RXA_SIGDET_CAL_CTRL1                       0x14
		USB3_DP_QSERDES_RXA_SIGDET_CAL_TRIM                        0x08
		USB3_DP_QSERDES_TXB_RES_CODE_LANE_TX                       0x00
		USB3_DP_QSERDES_TXB_RES_CODE_LANE_RX                       0x00
		USB3_DP_QSERDES_TXB_RES_CODE_LANE_OFFSET_TX                0x1F
		USB3_DP_QSERDES_TXB_RES_CODE_LANE_OFFSET_RX                0x09
		USB3_DP_QSERDES_TXB_LANE_MODE_1                            0xF5
		USB3_DP_QSERDES_TXB_LANE_MODE_3                            0x3F
		USB3_DP_QSERDES_TXB_LANE_MODE_4                            0x3F
		USB3_DP_QSERDES_TXB_LANE_MODE_5                            0x5F
		USB3_DP_QSERDES_TXB_RCV_DETECT_LVL_2                       0x12
		USB3_DP_QSERDES_TXB_PI_QEC_CTRL                            0x05
		USB3_DP_QSERDES_RXB_UCDR_FO_GAIN                           0x0A
		USB3_DP_QSERDES_RXB_UCDR_SO_GAIN                           0x06
		USB3_DP_QSERDES_RXB_UCDR_FASTLOCK_FO_GAIN                  0x2F
		USB3_DP_QSERDES_RXB_UCDR_SO_SATURATION_AND_ENABLE          0x7F
		USB3_DP_QSERDES_RXB_UCDR_FASTLOCK_COUNT_LOW                0xFF
		USB3_DP_QSERDES_RXB_UCDR_FASTLOCK_COUNT_HIGH               0x0F
		USB3_DP_QSERDES_RXB_UCDR_PI_CONTROLS                       0x99
		USB3_DP_QSERDES_RXB_UCDR_SB2_THRESH1                       0x08
		USB3_DP_QSERDES_RXB_UCDR_SB2_THRESH2                       0x08
		USB3_DP_QSERDES_RXB_UCDR_SB2_GAIN1                         0x00
		USB3_DP_QSERDES_RXB_UCDR_SB2_GAIN2                         0x08
		USB3_DP_QSERDES_RXB_AUX_DATA_TCOARSE_TFINE                 0xA0
		USB3_DP_QSERDES_RXB_VGA_CAL_CNTRL1                         0x54
		USB3_DP_QSERDES_RXB_VGA_CAL_CNTRL2                         0x0F
		USB3_DP_QSERDES_RXB_GM_CAL                                 0x13
		USB3_DP_QSERDES_RXB_RX_EQU_ADAPTOR_CNTRL2                  0x0F
		USB3_DP_QSERDES_RXB_RX_EQU_ADAPTOR_CNTRL3                  0x4A
		USB3_DP_QSERDES_RXB_RX_EQU_ADAPTOR_CNTRL4                  0x0A
		USB3_DP_QSERDES_RXB_RX_IDAC_TSETTLE_LOW                    0x07
		USB3_DP_QSERDES_RXB_RX_IDAC_TSETTLE_HIGH                   0x00
		USB3_DP_QSERDES_RXB_RX_EQ_OFFSET_ADAPTOR_CNTRL1            0x47
		USB3_DP_QSERDES_RXB_SIGDET_CNTRL                           0x04
		USB3_DP_QSERDES_RXB_SIGDET_DEGLITCH_CNTRL                  0x0E
		USB3_DP_QSERDES_RXB_RX_MODE_00_LOW                         0x3F
		USB3_DP_QSERDES_RXB_RX_MODE_00_HIGH                        0xFF
		USB3_DP_QSERDES_RXB_RX_MODE_00_HIGH2                       0xFF
		USB3_DP_QSERDES_RXB_RX_MODE_00_HIGH3                       0xDF
		USB3_DP_QSERDES_RXB_RX_MODE_00_HIGH4                       0xFE
		USB3_DP_QSERDES_RXB_RX_MODE_01_LOW                         0xDC
		USB3_DP_QSERDES_RXB_RX_MODE_01_HIGH                        0x5C
		USB3_DP_QSERDES_RXB_RX_MODE_01_HIGH2                       0x9C
		USB3_DP_QSERDES_RXB_RX_MODE_01_HIGH3                       0x1D
		USB3_DP_QSERDES_RXB_RX_MODE_01_HIGH4                       0x09
		USB3_DP_QSERDES_RXB_DFE_EN_TIMER                           0x04
		USB3_DP_QSERDES_RXB_DFE_CTLE_POST_CAL_OFFSET               0x38
		USB3_DP_QSERDES_RXB_DCC_CTRL1                              0x0C
		USB3_DP_QSERDES_RXB_VTH_CODE                               0x10
		USB3_DP_QSERDES_RXB_SIGDET_CAL_CTRL1                       0x14
		USB3_DP_QSERDES_RXB_SIGDET_CAL_TRIM                        0x08
		USB3_DP_PCS_LOCK_DETECT_CONFIG1                            0xC4
		USB3_DP_PCS_LOCK_DETECT_CONFIG2                            0x89
		USB3_DP_PCS_LOCK_DETECT_CONFIG3                            0x20
		USB3_DP_PCS_LOCK_DETECT_CONFIG6                            0x13
		USB3_DP_PCS_REFGEN_REQ_CONFIG1                             0x21
		USB3_DP_PCS_RX_SIGDET_LVL                                  0x99
		USB3_DP_PCS_RCVR_DTCT_DLY_P1U2_L                           0xE7
		USB3_DP_PCS_RCVR_DTCT_DLY_P1U2_H                           0x03
		USB3_DP_PCS_CDR_RESET_TIME                                 0x0A
		USB3_DP_PCS_ALIGN_DETECT_CONFIG1                           0x88
		USB3_DP_PCS_ALIGN_DETECT_CONFIG2                           0x13
		USB3_DP_PCS_PCS_TX_RX_CONFIG                               0x0C
		USB3_DP_PCS_EQ_CONFIG1                                     0x4B
		USB3_DP_PCS_EQ_CONFIG5                                     0x10
		USB3_DP_PCS_USB3_LFPS_DET_HIGH_COUNT_VAL                   0xF8
		USB3_DP_PCS_USB3_RXEQTRAINING_DFE_TIME_S2                  0x07
		USB3_DP_PCS_USB3_RCVR_DTCT_DLY_U3_L                        0x40
		USB3_DP_PCS_USB3_RCVR_DTCT_DLY_U3_H                        0x00
		USB3_DP_QSERDES_TXA_TX_DRV_LVL                             0x36
		USB3_DP_QSERDES_TXB_TX_DRV_LVL                             0x36>;
};
