/dts-v1/;
/plugin/;

#include "seraphp-atp.dtsi"

/ {
	model = "Qualcomm Technologies, Inc. SeraphP ATP";
	compatible = "qcom,seraphp-atp", "qcom,seraphp", "qcom,atp";
	qcom,msm-id = <673 0x10000>;
	qcom,board-id = <0x10021 0>;
};

