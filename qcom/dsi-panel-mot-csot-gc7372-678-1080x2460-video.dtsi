&mdss_mdp {
	dsi_csot_gc7372_678_fhd_video: qcom,mdss_dsi_csot_gc7372_678_fhd_video {
		qcom,mdss-dsi-panel-name =
				"mipi_mot_vid_csot_gc7372_fhd_678";
		qcom,mdss-dsi-panel-type = "dsi_video_mode";

		qcom,dsi-ctrl-num = <0>;
		qcom,dsi-phy-num = <0>;
		qcom,mdss-dsi-virtual-channel-id = <0>;
		qcom,mdss-dsi-stream = <0>;
		qcom,mdss-dsi-bpp = <24>;
		qcom,mdss-dsi-color-order = "rgb_swap_rgb";
		qcom,mdss-dsi-underflow-color = <0xfff>;
		qcom,mdss-dsi-border-color = <0>;
		qcom,mdss-dsi-h-sync-pulse = <0>;
		qcom,mdss-dsi-traffic-mode = "non_burst_sync_event";
		qcom,mdss-dsi-lane-map = "lane_map_0123";
		qcom,mdss-dsi-bllp-eof-power-mode;
		qcom,mdss-dsi-bllp-power-mode;
		qcom,mdss-dsi-tx-eot-append;
		qcom,mdss-dsi-lane-0-state;
		qcom,mdss-dsi-lane-1-state;
		qcom,mdss-dsi-lane-2-state;
		qcom,mdss-dsi-lane-3-state;
		qcom,mdss-dsi-dma-trigger = "trigger_sw";
		qcom,mdss-dsi-mdp-trigger = "none";
		qcom,mdss-dsi-lp11-init;
		qcom,mdss-dsi-reset-sequence = <1 10>, <0 10>, <1 10>;
		qcom,mdss-pan-physical-width-dimension = <69>;
		qcom,mdss-pan-physical-height-dimension = <158>;

		qcom,mdss-dsi-cabc-mv-command = [15 01 00 00 00 00 02 55 03];
		qcom,mdss-dsi-cabc-mv-command-state =  "dsi_hs_mode";
		qcom,mdss-dsi-cabc-ui-command = [15 01 00 00 00 00 02 55 01];
		qcom,mdss-dsi-cabc-ui-command-state =  "dsi_hs_mode";
		qcom,mdss-dsi-cabc-dis-command = [15 01 00 00 00 00 02 55 00];
		qcom,mdss-dsi-cabc-dis-command-state =  "dsi_hs_mode";

		qcom,mdss-dsi-display-timings {
			timing@0 {
			qcom,mdss-dsi-panel-width = <1080>;
			qcom,mdss-dsi-panel-height = <2460>;
			qcom,mdss-dsi-h-front-porch = <20>;
			qcom,mdss-dsi-h-back-porch = <16>;
			qcom,mdss-dsi-h-pulse-width = <4>;
			qcom,mdss-dsi-h-sync-skew = <0>;
			qcom,mdss-dsi-h-sync-pulse = <0>;
			qcom,mdss-dsi-v-back-porch = <18>;
			qcom,mdss-dsi-v-front-porch = <2511>;
			qcom,mdss-dsi-v-pulse-width = <1>;
			qcom,mdss-dsi-panel-framerate = <60>;
			qcom,mdss-dsi-h-left-border = <0>;
			qcom,mdss-dsi-h-right-border = <0>;
			qcom,mdss-dsi-v-top-border = <0>;
			qcom,mdss-dsi-v-bottom-border = <0>;
			qcom,mdss-dsi-on-command =
			[
					39 01 00 00 00 00 04 FF 55 AA 66
					15 01 00 00 00 00 02 FF B3
					15 01 00 00 00 00 02 FB 00
					15 01 00 00 00 00 02 D4 30
					15 01 00 00 00 00 02 01 06
					15 01 00 00 00 00 02 0B 06
					15 01 00 00 00 00 02 1E 06
					15 01 00 00 00 00 02 FF 20
					15 01 00 00 00 00 02 FB 00
					15 01 00 00 00 00 02 2F 41
					15 01 00 00 00 00 02 15 DD
					15 01 00 00 00 00 02 FF 28
					15 01 00 00 00 00 02 FB 00
					15 01 00 00 00 00 02 02 04
					15 01 00 00 00 00 02 04 3C
					15 01 00 00 00 00 02 05 20
					15 01 00 00 00 00 02 06 0C
					15 01 00 00 00 00 02 07 18
					15 01 00 00 00 00 02 08 00
					15 01 00 00 00 00 02 0B 22
					15 01 00 00 00 00 02 0C 1C
					15 01 00 00 00 00 02 0D 1C
					15 01 00 00 00 00 02 0E BB
					15 01 00 00 00 00 02 0F 06
					15 01 00 00 00 00 02 10 20
					15 01 00 00 00 00 02 11 00
					15 01 00 00 00 00 02 12 0E
					15 01 00 00 00 00 02 13 1C
					15 01 00 00 00 00 02 14 2A
					15 01 00 00 00 00 02 15 38
					15 01 00 00 00 00 02 16 46
					15 01 00 00 00 00 02 17 54
					15 01 00 00 00 00 02 18 62
					15 01 00 00 00 00 02 19 69
					15 01 00 00 00 00 02 1A 70
					15 01 00 00 00 00 02 1B 77
					15 01 00 00 00 00 02 1C 79
					15 01 00 00 00 00 02 1D 7B
					15 01 00 00 00 00 02 1E 7D
					15 01 00 00 00 00 02 1F 7E
					15 01 00 00 00 00 02 2E 01
					15 01 00 00 00 00 02 2F 00
					15 01 00 00 00 00 02 30 11
					15 01 00 00 00 00 02 31 33
					15 01 00 00 00 00 02 32 33
					15 01 00 00 00 00 02 33 33
					15 01 00 00 00 00 02 34 55
					15 01 00 00 00 00 02 35 75
					15 01 00 00 00 00 02 36 44
					15 01 00 00 00 00 02 37 65
					15 01 00 00 00 00 02 38 77
					15 01 00 00 00 00 02 39 87
					15 01 00 00 00 00 02 3A A9
					15 01 00 00 00 00 02 3B CB
					15 01 00 00 00 00 02 3D DD
					15 01 00 00 00 00 02 3E 0F
					15 01 00 00 00 00 02 3F 02
					15 01 00 00 00 00 02 40 00
					15 01 00 00 00 00 02 41 00
					15 01 00 00 00 00 02 42 3E
					15 01 00 00 00 00 02 43 3C
					15 01 00 00 00 00 02 44 3A
					15 01 00 00 00 00 02 45 38
					15 01 00 00 00 00 02 46 38
					15 01 00 00 00 00 02 47 38
					15 01 00 00 00 00 02 48 36
					15 01 00 00 00 00 02 49 36
					15 01 00 00 00 00 02 4A 34
					15 01 00 00 00 00 02 4B 34
					15 01 00 00 00 00 02 4C 34
					15 01 00 00 00 00 02 4D 33
					15 01 00 00 00 00 02 4E 11
					15 01 00 00 00 00 02 FF 10
					15 01 00 00 00 00 02 FB 00
					15 01 00 00 00 00 02 BF 81
					39 01 00 00 00 00 11 C0 80 0A 00 F6 02 00 02 0E 00 ED 00 07 0A AB 0A 2C
					39 01 00 00 00 00 03 C1 10 F0
					15 01 00 00 00 00 02 36 08
					15 01 00 00 00 00 02 BA 03
					15 01 00 00 00 00 02 69 00
					15 01 00 00 00 00 02 35 00
					15 01 00 00 00 00 02 53 28
					39 01 00 00 00 00 03 51 03 32
					15 01 00 00 00 00 02 55 01
					05 01 00 00 96 00 01 11
					05 01 00 00 32 00 01 29
			];
			qcom,mdss-dsi-off-command = [
				05 01 00 00 64 00 01 28
				05 01 00 00 64 00 01 10
			];
			qcom,mdss-dsi-on-command-state = "dsi_lp_mode";
			qcom,mdss-dsi-off-command-state = "dsi_hs_mode";

			qcom,compression-mode = "dsc";
			qcom,mdss-dsc-datatype = <0x3E>;
			qcom,mdss-dsc-slice-height = <10>;
			qcom,mdss-dsc-slice-width = <540>;
			qcom,mdss-dsc-slice-per-pkt = <2>;
			qcom,mdss-dsc-bit-per-component = <8>;
			qcom,mdss-dsc-bit-per-pixel = <8>;
			qcom,mdss-dsc-block-prediction-enable;

			};
		};

	};
};
