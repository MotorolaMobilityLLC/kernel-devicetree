/* Copyright (c) 2021, The Linux Foundation. All rights reserved.
 *
 * This program is free software; you can redistribute it and/or modify
 * it under the terms of the GNU General Public License version 2 and
 * only version 2 as published by the Free Software Foundation.
 *
 * This program is distributed in the hope that it will be useful,
 * but WITHOUT ANY WARRANTY; without even the implied warranty of
 * MERCHANTABILITY or FITNESS FOR A PARTICULAR PURPOSE.  See the
 * GNU General Public License for more details.
 */
#include "blair-milanf-common-overlay.dtsi"
#include "blair-nopmi-moto-common-overlay.dtsi"
#include "tcpc_config.dtsi"
#include "rt9426a.dtsi"

&usb0 {
       qcom,force-adb-enable;
};


&qupv3_se8_i2c {
	status = "okay";
	oz8806@2f {
		compatible = "o2micro,oz8806";
		reg = <0x2f>;
		status = "okay";
	};
};
