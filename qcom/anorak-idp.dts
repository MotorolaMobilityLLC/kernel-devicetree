/dts-v1/;

#include "anorak.dtsi"
#include "anorak-idp.dtsi"

/ {
	model = "Qualcomm Technologies, Inc. Anorak IDP";
	compatible = "qcom,anorak-idp", "qcom,anorak", "qcom,anorak";
	qcom,board-id = <34 0>;
};
