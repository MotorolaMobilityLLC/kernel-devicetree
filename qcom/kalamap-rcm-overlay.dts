/dts-v1/;
/plugin/;

#include "kalamap-rcm.dtsi"

/ {
	model = "Qualcomm Technologies, Inc. KalamaP RCM";
	compatible = "qcom,kalama-rcm", "qcom,kalama", "qcom,rcm";
	qcom,msm-id = <519 0x10000>, <536 0x10000>, <519 0x20000>, <536 0x20000>, <600 0x20000>, <601 0x20000>, <603 0x20000>, <604 0x20000>;
	qcom,board-id = <0x10615 0>;
};
