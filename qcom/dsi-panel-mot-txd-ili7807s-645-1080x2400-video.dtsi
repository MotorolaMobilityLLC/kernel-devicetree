&mdss_mdp {
	dsi_ili7807s_fhd_plus_120_video: qcom,mdss_dsi_txd_ili7807s_645_fhd_plus_120_video {
		qcom,mdss-dsi-panel-name =
				"mipi_mot_vid_txd_ili7807s_fhdp_645_120";
		qcom,mdss-dsi-panel-type = "dsi_video_mode";

		qcom,dsi-ctrl-num = <0>;
		qcom,dsi-phy-num = <0>;
		qcom,mdss-dsi-virtual-channel-id = <0>;
		qcom,mdss-dsi-stream = <0>;
		qcom,mdss-dsi-bpp = <24>;
		qcom,mdss-dsi-color-order = "rgb_swap_rgb";
		qcom,mdss-dsi-underflow-color = <0xfff>;
		qcom,mdss-dsi-border-color = <0>;
		qcom,mdss-dsi-h-sync-pulse = <0>;
		qcom,mdss-dsi-traffic-mode = "non_burst_sync_event";
		qcom,mdss-dsi-lane-map = "lane_map_0123";
		qcom,mdss-dsi-bllp-eof-power-mode;
		qcom,mdss-dsi-bllp-power-mode;
		qcom,mdss-dsi-tx-eot-append;
		qcom,mdss-dsi-lane-0-state;
		qcom,mdss-dsi-lane-1-state;
		qcom,mdss-dsi-lane-2-state;
		qcom,mdss-dsi-lane-3-state;
		qcom,mdss-dsi-dma-trigger = "trigger_sw";
		qcom,mdss-dsi-mdp-trigger = "none";
		qcom,mdss-dsi-lp11-init;
		qcom,mdss-dsi-reset-sequence = <1 4>, <0 1>, <1 12>;
		qcom,mdss-pan-physical-width-dimension = <69>;
		qcom,mdss-pan-physical-height-dimension = <158>;

		qcom,mdss-dsi-cabc-mv-command = [15 01 00 00 00 00 02 55 03];
		qcom,mdss-dsi-cabc-mv-command-state =  "dsi_hs_mode";
		qcom,mdss-dsi-cabc-ui-command = [15 01 00 00 00 00 02 55 01];
		qcom,mdss-dsi-cabc-ui-command-state =  "dsi_hs_mode";
		qcom,mdss-dsi-cabc-dis-command = [15 01 00 00 00 00 02 55 00];
		qcom,mdss-dsi-cabc-dis-command-state =  "dsi_hs_mode";

		qcom,mdss-dsi-display-timings {
			timing@0 {
                                qcom,mdss-dsi-panel-width = <1080>;
                                qcom,mdss-dsi-panel-height = <2400>;
                                qcom,mdss-dsi-h-front-porch = <28>;
                                qcom,mdss-dsi-h-back-porch = <24>;
                                qcom,mdss-dsi-h-pulse-width = <4>;
                                qcom,mdss-dsi-h-sync-skew = <0>;
                                qcom,mdss-dsi-h-sync-pulse = <0>;
                                qcom,mdss-dsi-v-back-porch = <12>;
                                qcom,mdss-dsi-v-front-porch = <2565>;
                                qcom,mdss-dsi-v-pulse-width = <2>;
                                qcom,mdss-dsi-panel-framerate = <60>;
                                qcom,mdss-dsi-h-left-border = <0>;
                                qcom,mdss-dsi-h-right-border = <0>;
                                qcom,mdss-dsi-v-top-border = <0>;
                                qcom,mdss-dsi-v-bottom-border = <0>;


			qcom,mdss-dsi-on-command =
			[
                                        15 01 00 00 00 00 02 FF 10
                                        15 01 00 00 00 00 02 FB 01
                                        39 01 00 00 00 00 06 3B 03 14 36 04 04
                                        15 01 00 00 00 00 02 B0 00
                                        39 01 00 00 00 00 03 C2 1B A0

                                        15 01 00 00 00 00 02 FF F0
                                        15 01 00 00 00 00 02 FB 01
                                        15 01 00 00 00 00 02 1C 01
                                        15 01 00 00 00 00 02 33 01
                                        15 01 00 00 00 00 02 5A 00
                                        15 01 00 00 00 00 02 FF D0
                                        15 01 00 00 00 00 02 FB 01
                                        15 01 00 00 00 00 02 53 22
                                        15 01 00 00 00 00 02 54 02
                                        15 01 00 00 00 00 02 FF C0
                                        15 01 00 00 00 00 02 FB 01
                                        15 01 00 00 00 00 02 9C 11
                                        15 01 00 00 00 00 02 9D 11
                                        15 01 00 00 00 00 02 FF 10
                                        15 01 00 00 00 00 02 FB 01
                                        15 01 00 00 00 00 02 C0 03
                                        15 01 00 00 00 00 02 51 CC
                                        15 01 00 00 00 00 02 53 2C
                                        15 01 00 00 00 00 02 55 01
                                        05 01 00 00 64 00 01 11
                                        05 01 00 00 48 00 01 29
			];
			qcom,mdss-dsi-off-command = [
				05 01 00 00 32 00 01 28
				05 01 00 00 96 00 01 10
			];
			qcom,mdss-dsi-on-command-state = "dsi_lp_mode";
			qcom,mdss-dsi-off-command-state = "dsi_lp_mode";

			qcom,compression-mode = "dsc";
			qcom,mdss-dsc-slice-height = <10>;
			qcom,mdss-dsc-slice-width = <540>;
			qcom,mdss-dsc-slice-per-pkt = <2>;
			qcom,mdss-dsc-bit-per-component = <8>;
			qcom,mdss-dsc-bit-per-pixel = <8>;
			qcom,mdss-dsc-block-prediction-enable;

			};
		};

	};
};
