/* Copyright (c) 2022, The Linux Foundation. All rights reserved.
 *
 * This program is free software; you can redistribute it and/or modify
 * it under the terms of the GNU General Public License version 2 and
 * only version 2 as published by the Free Software Foundation.
 *
 * This program is distributed in the hope that it will be useful,
 * but WITHOUT ANY WARRANTY; without even the implied warranty of
 * MERCHANTABILITY or FITNESS FOR A PARTICULAR PURPOSE.  See the
 * GNU General Public License for more details.
 */

/dts-v1/;

#include "cape-v2-moto-common-base.dtsi"

/delete-node/ &adsp_mem;
/delete-node/ &video_mem;

/* adsp occupy video region, then move video to end */
&reserved_memory {
       adsp_mem: adsp_region@85700000 {
               no-map;
               reg = <0x0 0x85700000 0x0 0x2800000>;
       };

       video_mem: video_region@9fd00000 {
               no-map;
               reg = <0x0 0x9fd00000 0x0 0x700000>;
       };
};

&qupv3_se5_i2c {
       /delete-node/ nq@64;
};

