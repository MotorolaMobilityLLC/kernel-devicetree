/*
 * Copyright (c) 2023, The Linux Foundation. All rights reserved.
 *
 * This program is free software; you can redistribute it and/or modify
 * it under the terms of the GNU General Public License version 2 and
 * only version 2 as published by the Free Software Foundation.
 *
 * This program is distributed in the hope that it will be useful,
 * but WITHOUT ANY WARRANTY; without even the implied warranty of
 * MERCHANTABILITY or FITNESS FOR A PARTICULAR PURPOSE.  See the
 * GNU General Public License for more details.
 */

&qupv3_se19_spi {
	#address-cells = <1>;
	#size-cells = <0>;

	status = "ok";

	synaptics_tcm@0 {
		compatible = "synaptics,tcm-spi";
		reg = <0>;
		spi-max-frequency = <9600000>;
		interrupt-parent = <&tlmm>;
		interrupts = <158 0x2008>;
		vdd-supply = <&L4B>;
		avdd-supply = <&L14B>;
		pinctrl-names = "pmx_ts_active", "pmx_ts_suspend";
		pinctrl-0 = <&ts_active>;
		pinctrl-1 = <&ts_int_suspend &ts_reset_suspend>;
		pinctrl-2 = <&ts_release>;
		synaptics,avdd-name = "vdd";
		synaptics,vdd-name = "avdd";
		synaptics,power-delay-ms = <200>;
		synaptics,irq-gpio = <&tlmm 158 0x2008>;
		synaptics,irq-on-state = <0>;
		synaptics,reset-gpio = <&tlmm 66 0x00>;
		synaptics,reset-on-state = <0>;
		synaptics,reset-active-ms = <20>;
		synaptics,reset-delay-ms = <200>;
		synaptics,spi-mode = <0>;
		synaptics,spi-byte-delay-us = <0>;
		synaptics,spi-block-delay-us = <0>;
	};

};
