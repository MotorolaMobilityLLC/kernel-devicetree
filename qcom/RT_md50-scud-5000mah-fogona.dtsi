/*
 * Copyright (C) 2021 MediaTek Inc.
 *
 * This program is free software; you can redistribute it and/or modify
 * it under the terms of the GNU General Public License version 2 as
 * published by the Free Software Foundation.
 *
 * This program is distributed in the hope that it will be useful,
 * but WITHOUT ANY WARRANTY; without even the implied warranty of
 * MERCHANTABILITY or FITNESS FOR A PARTICULAR PURPOSE.
 * See http://www.gnu.org/licenses/gpl-2.0.html for more details.
 */
md50-scud-5000mah {
        serialnum = "SB18D96853";
        /* add for aging cv */
	rt,fcc_design = <5000>;
        rt,fcc = <4873>;
        rt,fg_fc_vth = <0xAc>;
        rt,fg_extreg_table = [80 80 34 6E B6 E2 58 02 D0 98 60 3A 88 80 00 00
                                        40 34 00 00 FB 3E 00 20 7F 0A 1D 32 12 07 28 3C
                                        00 82 00 02 00 02 00 40 00 40 09 13 09 13 04 F4
                                        64 00 5F 0B 64 00 5F 0B FF 00 00 14 00 00 28 B7
                                        15 0E 48 44 AC 4C 05 41 19 15 B5 12 A3 32 0A 00
                                        13 88 24 82 77 AD 14 73 12 A3 52 68 57 64 1C 09
                                        25 0F 03 02 02 02 01 01 00 FC 04 04 04 02 02 FE
                                        F5 F6 F6 F6 F7 F7 E7 CC F6 F6 F6 C9 C9 A8 9C 00
                                        76 02 E0 48 0A 09 00 00 00 00 00 00 00 00 37 73
                                        2D 19 05 FB 00 00 B9 36 96 33 0F 07 06 05 0B A9
                                        32 32 88 88 32 32 88 88 32 32 88 88 32 32 88 88
                                        32 32 88 88 32 32 88 88 32 32 88 88 32 32 88 88
                                        32 32 88 88 32 32 88 88 32 32 88 88 32 32 88 88
                                        32 32 88 88 32 32 88 88 32 32 88 88 32 32 88 88 ];
                rt,fg_ocv_table0 = <0x0013 0x4EC0 0x5500 0x5893 0x5C3A 0x5C40 0x5D3A 0x5E66
                                        0x5FBA 0x60D3 0x620D 0x631A 0x63F3 0x667A 0x68ED 0x6A73
                                        0x6BBA 0x6CFA 0x6E1A 0x706D 0x1900 0x0393 0x02CF 0x0007
                                        0x0040 0x003F 0x002A 0x0042 0x0074 0x0091 0x007C 0x0080
                                        0x0099 0x009F 0x009B 0x008E 0x0053 0x00EE 0x0013 0xFF80
                                        0x0000 0x0200 0x049A 0x0680 0x0E4D 0x17E6 0x281A 0x309A
                                        0x3600 0x39B3 0x3D33 0x474D 0x4F80 0x5466 0x589A 0x5D1A
                                        0x6400 0x6900 0x000A 0x0048 0x005B 0x2600 0x0400 0x0416
                                        0x061D 0x03DD 0x0234 0x01C3 0x020F 0x0200 0x01AC 0x019B
                                        0x01A6 0x01CD 0x0311 0x0113 0x0EE2 0x0000 0x0000 0x0000>;

};

