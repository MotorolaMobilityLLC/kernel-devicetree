/dts-v1/;

#include "neo_luna-v2.dtsi"
#include "neo_luna-v2-sg-qar.dtsi"

/ {
	model = "Qualcomm Technologies, Inc. NEO LUNA-V2 SG QAR";
	compatible = "qcom,neo-idp", "qcom,neo", "qcom,idp";
	qcom,board-id = <44 1>;
};
