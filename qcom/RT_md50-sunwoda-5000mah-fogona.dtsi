/*
 * Copyright (C) 2021 MediaTek Inc.
 *
 * This program is free software; you can redistribute it and/or modify
 * it under the terms of the GNU General Public License version 2 as
 * published by the Free Software Foundation.
 *
 * This program is distributed in the hope that it will be useful,
 * but WITHOUT ANY WARRANTY; without even the implied warranty of
 * MERCHANTABILITY or FITNESS FOR A PARTICULAR PURPOSE.
 * See http://www.gnu.org/licenses/gpl-2.0.html for more details.
 */
md50-sunwoda-5000mah {
        serialnum = "SB18D96854";
        /* add for aging cv */
        rt,fcc_design = <5000>;
        rt,fcc = <4852>;
        rt,fg_fc_vth = <0xAc>;
	rt,fg_extreg_table = [80 80 34 6E B6 E2 58 02 D0 98 60 3A 88 80 00 00
				40 34 00 00 FB 3E 00 20 7F 0A 1D 32 12 07 28 3C
				00 82 00 02 00 02 00 40 00 40 F4 12 F4 12 04 F4
				64 00 5F 0B 64 00 5F 0B FF 00 00 14 00 00 28 B7
				15 0E 48 44 AC 4C 05 41 19 15 B5 12 A3 32 0A 00
				13 88 24 82 77 AD 14 73 12 A3 52 68 57 64 1C 09
				25 0F 03 00 00 00 00 00 FE FC 02 02 02 01 01 FF
				F9 FB FB FB FB FB F2 E3 FB FB FB DE DE BC A8 00
				76 02 E0 48 0A 09 00 00 00 00 00 00 00 00 37 73
				2D 19 05 FB 00 00 B9 36 96 33 0F 07 06 05 0B A9
				32 32 88 88 32 32 88 88 32 32 88 88 32 32 88 88
				32 32 88 88 32 32 88 88 32 32 88 88 32 32 88 88
				32 32 88 88 32 32 88 88 32 32 88 88 32 32 88 88
				32 32 88 88 32 32 88 88 32 32 88 88 32 32 88 88 ];
        rt,fg_ocv_table0 = <0x0013 0x4EC0 0x5500 0x59B3 0x5C1A 0x5C4D 0x5D3A 0x5E7A
				0x5FDA 0x60FA 0x626D 0x6360 0x6420 0x66AD 0x6920 0x6AA6
				0x6BE6 0x6D26 0x6E93 0x706D 0x1900 0x04B3 0x01D9 0x0036
				0x003D 0x0043 0x002B 0x0044 0x0089 0x0083 0x006E 0x0081
				0x0099 0x009F 0x0098 0x008E 0x006A 0x00BD 0x0013 0xFF80
				0x0000 0x0200 0x049A 0x0680 0x0E4D 0x17E6 0x281A 0x309A
				0x3600 0x39B3 0x3D33 0x474D 0x4F80 0x5466 0x589A 0x5D1A
				0x6400 0x6900 0x000A 0x0036 0x008B 0x04C0 0x0437 0x03D7
				0x05E4 0x03C7 0x01DD 0x01F3 0x0255 0x01FB 0x01AC 0x019B
				0x01AE 0x01CD 0x026C 0x015A 0xBC26 0x0000 0x0000 0x0000>;

};

