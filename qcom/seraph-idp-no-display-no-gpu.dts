/dts-v1/;
/plugin/;

#include "seraph.dtsi"
#include "seraph-idp.dtsi"

/ {
	model = "Qualcomm Technologies, Inc. Seraph IDP NO DISPLAY NO GPU";
	compatible = "qcom,seraph-idp", "qcom,seraph", "qcom,idp";
	qcom,board-id = <0x10022 3>;
};
