/* Copyright (c) 2019-2020, The Linux Foundation. All rights reserved.
 *
 * This program is free software; you can redistribute it and/or modify
 * it under the terms of the GNU General Public License version 2 and
 * only version 2 as published by the Free Software Foundation.
 *
 * This program is distributed in the hope that it will be useful,
 * but WITHOUT ANY WARRANTY; without even the implied warranty of
 * MERCHANTABILITY or FITNESS FOR A PARTICULAR PURPOSE.  See the
 * GNU General Public License for more details.
 */
&mdss_mdp {
	mot_csot_c7_vtdr6115_655_1080x2400_dsc_vid_v1: qcom,mdss_dsi_mot_csot_c7_vtdr6115_655_1080x2400_dsc_vid_v1 {
		qcom,mdss-dsi-panel-name =
			"mipi_moto_vid_csot_1080p_dsc_655";
		qcom,mdss-dsi-panel-type = "dsi_video_mode";
		qcom,mdss-dsi-panel-physical-type = "oled";
		qcom,mdss-dsi-virtual-channel-id = <0>;
		qcom,mdss-dsi-stream = <0>;
		qcom,dsi-ctrl-num = <0>;
		qcom,dsi-phy-num = <0>;
		qcom,mdss-pan-physical-width-dimension = <69>;
		qcom,mdss-pan-physical-height-dimension = <154>;
		qcom,mdss-dsi-bpp = <30>;
		qcom,mdss-dsi-underflow-color = <0xff>;
		qcom,mdss-dsi-border-color = <0>;

		qcom,mdss-dsi-traffic-mode = "non_burst_sync_event";
		qcom,mdss-dsi-bllp-eof-power-mode;
		qcom,mdss-dsi-bllp-power-mode;
		qcom,mdss-dsi-lp11-init;
		qcom,mdss-dsi-lane-0-state;
		qcom,mdss-dsi-lane-1-state;
		qcom,mdss-dsi-lane-2-state;
		qcom,mdss-dsi-lane-3-state;
		qcom,mdss-dsi-dma-trigger = "trigger_sw";
		qcom,mdss-dsi-mdp-trigger = "none";
		qcom,mdss-dsi-reset-sequence = <1 2>, <0 2>, <1 20>;

		qcom,mdss-dsi-panel-hdr-enabled;
		qcom,mdss-dsi-panel-hdr-color-primaries = <14500 15500 32000
					17000 15500 30000 8000 3000>;
		qcom,mdss-dsi-panel-peak-brightness = <5000000>;//4200000

		qcom,mdss-dsi-panel-blackness-level = <3515>;//3230

		qcom,mdss-dsi-dc-off-command = [
				39 01 00 00 00 00 02 5E 00];
		qcom,mdss-dsi-dc-off-command-state = "dsi_hs_mode";
		qcom,mdss-dsi-dc-on-command = [
				39 01 00 00 00 00 02 5E 01];
		qcom,mdss-dsi-dc-on-command-state = "dsi_hs_mode";

		qcom,mdss-dsi-hbm-on-command = [
				39 00 00 00 00 00 03 51 0F 59
				39 00 00 00 00 00 02 62 00
				39 00 00 00 00 00 03 F0 AA 13
				39 01 00 00 00 00 02 C6 00];
		qcom,mdss-dsi-hbm-off-command = [
				39 00 00 00 00 00 03 51 0D BA
				39 00 00 00 00 00 02 62 00
				39 00 00 00 00 00 03 F0 AA 13
				39 01 00 00 00 00 02 C6 00];

		qcom,mdss-dsi-hbm-fod;
		qcom,mdss-dsi-hbm-fod-on-command = [
				39 00 00 00 00 00 03 F0 AA 13
				39 00 00 00 00 00 02 C6 01
				39 00 00 00 00 00 03 63 03 FF
				39 00 00 00 00 00 03 51 05 2A
				39 01 00 00 00 00 02 62 03];

		qcom,mdss-dsi-panel-lhbm-wait-fps-valid;
		qcom,mdss-dsi-panel-local-hbm-wait-fps-count = <68>;
		qcom,mdss-dsi-panel-local-hbm-wait-fps-interval = <2>;
		qcom,mdss-dsi-panel-lhbm-not-allowed-fps-list = <60 90>;

		qcom,mdss-dsi-panel-local-hbm-enabled;
		qcom,mdss-dsi-panel-local-hbm-DC-HYBIRD-THRESHOLD-BL = <1322>; //0x052A
		qcom,mdss-dsi-panel-local-hbm-alpha-register = <0x63>;
		qcom,mdss-dsi-panel-local-hbm-alpha-size = <4096>;
		qcom,mdss-dsi-panel-local-hbm-alpha-table = <
				4   218 218 218 220 220 220 220 221 220 221 221 221 221 221 223
				223 223 224 224 224 224 224 224 225 225 226 227 226 227 227 227
				227 227 228 228 230 230 230 230 230 230 230 231 231 231 231 233
				233 233 233 233 234 234 234 234 234 235 236 236 237 237 237 237
				237 237 238 238 238 240 240 241 241 240 241 241 241 241 242 243
				244 244 244 244 244 245 245 245 245 245 247 247 247 247 248 248
				248 248 248 249 249 251 251 251 251 251 251 251 252 252 252 252
				254 254 254 254 255 255 255 255 255 255 257 257 257 258 258 258
				258 258 259 259 259 261 261 261 261 261 261 262 262 262 262 262
				264 264 265 265 265 265 265 265 266 266 266 268 268 268 269 269
				269 269 269 269 270 271 271 272 272 272 272 272 273 273 273 273
				275 275 276 276 276 276 276 277 277 277 277 279 279 279 279 279
				280 280 281 281 280 281 282 283 283 283 283 283 283 283 284 284
				286 286 286 287 287 287 287 287 287 288 288 289 290 290 290 290
				290 291 291 291 291 291 293 294 294 294 294 294 295 295 295 295
				295 297 297 298 297 298 298 298 298 299 299 301 301 301 301 301
				302 302 302 303 303 303 305 305 305 305 305 306 306 306 306 306
				306 308 308 308 309 309 309 309 310 310 310 311 313 313 313 313
				313 313 314 314 314 314 316 316 316 316 317 317 317 317 317 317
				318 319 320 320 320 321 321 321 321 321 321 322 323 323 324 324
				325 324 324 325 325 325 325 327 327 328 328 328 328 328 329 329
				329 331 331 331 331 331 331 332 332 332 334 334 334 335 336 336
				337 338 339 339 341 341 341 341 343 343 343 345 345 345 347 348
				348 348 350 350 350 352 352 352 354 354 354 354 356 356 356 358
				358 359 360 361 361 361 363 363 363 365 365 365 367 367 367 367
				369 369 369 371 372 372 373 373 374 374 376 376 376 378 378 378
				378 380 380 381 382 383 383 384 384 385 385 386 387 387 388 388
				389 390 390 391 391 392 392 393 395 395 395 397 397 397 398 399
				399 400 401 401 402 403 403 404 404 406 406 406 408 408 408 410
				410 410 411 412 412 412 414 414 415 417 416 417 417 418 419 419
				421 421 421 423 423 423 423 425 425 425 427 427 427 429 429 429
				429 431 431 432 433 433 434 435 435 436 436 438 438 438 439 440
				440 441 442 442 442 443 444 444 446 446 446 448 448 448 448 450
				450 450 452 452 452 454 454 454 455 456 457 457 458 458 459 459
				461 461 463 463 464 465 464 466 466 467 468 469 469 471 471 473
				473 473 474 474 475 476 477 478 479 479 480 481 481 482 482 484
				484 486 486 487 488 487 489 489 490 491 492 492 494 494 495 496
				496 498 498 499 499 501 501 502 502 504 504 504 506 506 508 507
				509 509 510 510 512 512 512 514 514 516 516 517 517 518 519 520
				520 520 522 522 523 524 525 525 527 527 527 528 528 529 530 531
				531 532 533 534 535 535 536 536 538 538 539 539 541 541 542 542
				542 544 544 546 546 547 547 548 549 550 550 550 551 552 553 553
				554 554 556 556 557 557 557 559 559 560 560 561 561 563 563 564
				564 564 566 566 568 568 569 570 571 571 571 572 573 574 574 575
				575 577 577 578 578 578 579 580 581 581 582 583 585 585 586 586
				586 588 588 589 590 591 591 592 592 594 594 594 595 596 597 597
				598 599 600 600 601 601 602 603 603 604 604 606 606 607 607 609
				609 609 611 611 612 612 614 614 615 615 615 617 617 618 618 619
				620 621 621 622 622 623 624 624 625 625 627 627 628 629 630 630
				632 633 633 634 635 636 636 637 638 639 640 641 642 642 643 644
				644 645 646 647 647 648 649 650 651 652 653 653 654 655 655 656
				657 658 658 660 661 662 663 663 664 664 666 666 667 668 669 670
				670 671 672 672 674 675 676 677 677 679 679 680 681 681 682 683
				684 684 685 686 687 687 688 689 689 690 691 692 692 693 694 695
				696 697 698 698 699 700 700 701 702 703 703 704 705 705 707 708
				709 709 710 711 711 712 712 713 714 715 716 716 716 718 719 719
				720 721 721 722 723 723 724 725 726 726 727 728 728 729 730 731
				731 732 733 733 734 735 736 736 737 738 739 739 740 741 741 742
				743 743 744 745 746 746 747 749 749 750 750 751 751 752 753 753
				754 755 756 756 757 758 759 759 760 761 761 762 763 763 764 765
				766 766 767 768 768 769 770 771 771 772 773 773 774 775 776 776
				777 777 778 779 780 781 781 782 783 783 784 785 786 785 787 787
				787 789 790 791 791 792 793 793 794 794 795 795 796 797 797 799
				800 800 800 802 802 802 803 804 805 805 805 806 807 808 809 810
				810 811 812 812 812 813 814 814 815 815 815 817 818 819 819 819
				821 820 821 822 823 823 823 824 824 825 827 827 828 829 830 830
				831 831 831 832 833 834 834 835 836 836 837 838 839 839 840 841
				841 842 843 843 843 844 846 846 847 848 849 849 849 850 850 851
				852 853 853 854 856 856 856 857 858 858 858 860 861 861 862 863
				863 864 865 866 867 867 868 869 870 869 870 872 873 873 874 875
				875 875 877 878 879 879 880 880 881 882 883 884 885 885 885 886
				887 888 889 890 890 891 892 892 894 894 895 896 896 897 897 898
				900 900 900 901 902 902 903 905 905 906 906 907 908 908 910 911
				911 911 912 913 914 914 916 916 917 917 918 919 920 921 922 923
				923 923 924 925 926 927 927 928 929 929 930 931 933 933 934 934
				935 936 936 938 939 939 939 940 941 941 942 944 944 945 945 946
				947 947 949 949 950 950 951 952 953 954 955 955 956 956 957 958
				958 959 960 961 962 962 962 963 965 965 966 967 968 968 968 969
				971 971 972 973 973 973 974 976 977 977 977 978 979 979 981 982
				982 982 983 984 985 985 986 987 988 988 989 990 990 991 992 993
				993 993 994 995 995 997 997 998 999 999 999 1000 1002 1002 1003 1003
				1004 1004 1005 1007 1007 1007 1008 1009 1010 1011 1011 1013 1014 1014 1014 1015
				1016 1016 1017 1018 1019 1019 1020 1020 1021 1023 1023 1023 1023 1023 1023 1023
				1023 1023 1023 1023 1023 1023 1023 1023 1023 1023 1023 1023 1023 1023 1023 1023
				1023 1023 1023 1023 1023 1023 1023 1023 1023 1023 1023 1023 1023 1023 1023 1023
				1023 1023 1023 1023 1023 1023 1023 1023 1023 1023 1023 1023 1023 1023 1023 1023
				1023 1023 1023 1023 1023 1023 1023 1023 1023 1023 1023 1023 1023 1023 1023 1023
				1023 1023 1023 1023 1023 1023 1023 1023 1023 1023 1023 1023 1023 1023 1023 1023
				1023 1023 1023 1023 1023 1023 1023 1023 1023 1023 1023 1023 1023 1023 1023 1023
				1023 1023 1023 1023 1023 1023 1023 1023 1023 1023 1023 1023 1023 1023 1023 1023
				1023 1023 1023 1023 1023 1023 1023 1023 1023 1023 1023 1023 1023 1023 1023 1023
				1023 1023 1023 1023 1023 1023 1023 1023 1023 1023 1023 1023 1023 1023 1023 1023
				1023 1023 1023 1023 1023 1023 1023 1023 1023 1023 1023 1023 1023 1023 1023 1023
				1023 1023 1023 1023 1023 1023 1023 1023 1023 1023 1023 1023 1023 1023 1023 1023
				1023 1023 1023 1023 1023 1023 1023 1023 1023 1023 1023 1023 1023 1023 1023 1023
				1023 1023 1023 1023 1023 1023 1023 1023 1023 1023 1023 1023 1023 1023 1023 1023
				1023 1023 1023 1023 1023 1023 1023 1023 1023 1023 1023 1023 1023 1023 1023 1023
				1023 1023 1023 1023 1023 1023 1023 1023 1023 1023 1023 1023 1023 1023 1023 1023
				1023 1023 1023 1023 1023 1023 1023 1023 1023 1023 1023 1023 1023 1023 1023 1023
				1023 1023 1023 1023 1023 1023 1023 1023 1023 1023 1023 1023 1023 1023 1023 1023
				1023 1023 1023 1023 1023 1023 1023 1023 1023 1023 1023 1023 1023 1023 1023 1023
				1023 1023 1023 1023 1023 1023 1023 1023 1023 1023 1023 1023 1023 1023 1023 1023
				1023 1023 1023 1023 1023 1023 1023 1023 1023 1023 1023 1023 1023 1023 1023 1023
				1023 1023 1023 1023 1023 1023 1023 1023 1023 1023 1023 1023 1023 1023 1023 1023
				1023 1023 1023 1023 1023 1023 1023 1023 1023 1023 1023 1023 1023 1023 1023 1023
				1023 1023 1023 1023 1023 1023 1023 1023 1023 1023 1023 1023 1023 1023 1023 1023
				1023 1023 1023 1023 1023 1023 1023 1023 1023 1023 1023 1023 1023 1023 1023 1023
				1023 1023 1023 1023 1023 1023 1023 1023 1023 1023 1023 1023 1023 1023 1023 1023
				1023 1023 1023 1023 1023 1023 1023 1023 1023 1023 1023 1023 1023 1023 1023 1023
				1023 1023 1023 1023 1023 1023 1023 1023 1023 1023 1023 1023 1023 1023 1023 1023
				1023 1023 1023 1023 1023 1023 1023 1023 1023 1023 1023 1023 1023 1023 1023 1023
				1023 1023 1023 1023 1023 1023 1023 1023 1023 1023 1023 1023 1023 1023 1023 1023
				1023 1023 1023 1023 1023 1023 1023 1023 1023 1023 1023 1023 1023 1023 1023 1023
				1023 1023 1023 1023 1023 1023 1023 1023 1023 1023 1023 1023 1023 1023 1023 1023
				1023 1023 1023 1023 1023 1023 1023 1023 1023 1023 1023 1023 1023 1023 1023 1023
				1023 1023 1023 1023 1023 1023 1023 1023 1023 1023 1023 1023 1023 1023 1023 1023
				1023 1023 1023 1023 1023 1023 1023 1023 1023 1023 1023 1023 1023 1023 1023 1023
				1023 1023 1023 1023 1023 1023 1023 1023 1023 1023 1023 1023 1023 1023 1023 1023
				1023 1023 1023 1023 1023 1023 1023 1023 1023 1023 1023 1023 1023 1023 1023 1023
				1023 1023 1023 1023 1023 1023 1023 1023 1023 1023 1023 1023 1023 1023 1023 1023
				1023 1023 1023 1023 1023 1023 1023 1023 1023 1023 1023 1023 1023 1023 1023 1023
				1023 1023 1023 1023 1023 1023 1023 1023 1023 1023 1023 1023 1023 1023 1023 1023
				1023 1023 1023 1023 1023 1023 1023 1023 1023 1023 1023 1023 1023 1023 1023 1023
				1023 1023 1023 1023 1023 1023 1023 1023 1023 1023 1023 1023 1023 1023 1023 1023
				1023 1023 1023 1023 1023 1023 1023 1023 1023 1023 1023 1023 1023 1023 1023 1023
				1023 1023 1023 1023 1023 1023 1023 1023 1023 1023 1023 1023 1023 1023 1023 1023
				1023 1023 1023 1023 1023 1023 1023 1023 1023 1023 1023 1023 1023 1023 1023 1023
				1023 1023 1023 1023 1023 1023 1023 1023 1023 1023 1023 1023 1023 1023 1023 1023
				1023 1023 1023 1023 1023 1023 1023 1023 1023 1023 1023 1023 1023 1023 1023 1023
				1023 1023 1023 1023 1023 1023 1023 1023 1023 1023 1023 1023 1023 1023 1023 1023
				1023 1023 1023 1023 1023 1023 1023 1023 1023 1023 1023 1023 1023 1023 1023 1023
				1023 1023 1023 1023 1023 1023 1023 1023 1023 1023 1023 1023 1023 1023 1023 1023
				1023 1023 1023 1023 1023 1023 1023 1023 1023 1023 1023 1023 1023 1023 1023 1023
				1023 1023 1023 1023 1023 1023 1023 1023 1023 1023 1023 1023 1023 1023 1023 1023
				1023 1023 1023 1023 1023 1023 1023 1023 1023 1023 1023 1023 1023 1023 1023 1023
				1023 1023 1023 1023 1023 1023 1023 1023 1023 1023 1023 1023 1023 1023 1023 1023
				1023 1023 1023 1023 1023 1023 1023 1023 1023 1023 1023 1023 1023 1023 1023 1023
				1023 1023 1023 1023 1023 1023 1023 1023 1023 1023 1023 1023 1023 1023 1023 1023
				1023 1023 1023 1023 1023 1023 1023 1023 1023 1023 1023 1023 1023 1023 1023 1023
				1023 1023 1023 1023 1023 1023 1023 1023 1023 1023 1023 1023 1023 1023 1023 1023
				1023 1023 1023 1023 1023 1023 1023 1023 1023 1023 1023 1023 1023 1023 1023 1023
				1023 1023 1023 1023 1023 1023 1023 1023 1023 1023 1023 1023 1023 1023 1023 1023
				1023 1023 1023 1023 1023 1023 1023 1023 1023 1023 1023 1023 1023 1023 1023 1023
				1023 1023 1023 1023 1023 1023 1023 1023 1023 1023 1023 1023 1023 1023 1023 1023
				1023 1023 1023 1023 1023 1023 1023 1023 1023 1023 1023 1023 1023 1023 1023 1023
				1023 1023 1023 1023 1023 1023 1023 1023 1023 1023 1023 1023 1023 1023 1023 1023
				1023 1023 1023 1023 1023 1023 1023 1023 1023 1023 1023 1023 1023 1023 1023 1023
				1023 1023 1023 1023 1023 1023 1023 1023 1023 1023 1023 1023 1023 1023 1023 1023
				1023 1023 1023 1023 1023 1023 1023 1023 1023 1023 1023 1023 1023 1023 1023 1023
				1023 1023 1023 1023 1023 1023 1023 1023 1023 1023 1023 1023 1023 1023 1023 1023
				1023 1023 1023 1023 1023 1023 1023 1023 1023 1023 1023 1023 1023 1023 1023 1023
				1023 1023 1023 1023 1023 1023 1023 1023 1023 1023 1023 1023 1023 1023 1023 1023
				1023 1023 1023 1023 1023 1023 1023 1023 1023 1023 1023 1023 1023 1023 1023 1023
				1023 1023 1023 1023 1023 1023 1023 1023 1023 1023 1023 1023 1023 1023 1023 1023
				1023 1023 1023 1023 1023 1023 1023 1023 1023 1023 1023 1023 1023 1023 1023 1023
				1023 1023 1023 1023 1023 1023 1023 1023 1023 1023 1023 1023 1023 1023 1023 1023
				1023 1023 1023 1023 1023 1023 1023 1023 1023 1023 1023 1023 1023 1023 1023 1023
				1023 1023 1023 1023 1023 1023 1023 1023 1023 1023 1023 1023 1023 1023 1023 1023
				1023 1023 1023 1023 1023 1023 1023 1023 1023 1023 1023 1023 1023 1023 1023 1023
				1023 1023 1023 1023 1023 1023 1023 1023 1023 1023 1023 1023 1023 1023 1023 1023
				1023 1023 1023 1023 1023 1023 1023 1023 1023 1023 1023 1023 1023 1023 1023 1023
				1023 1023 1023 1023 1023 1023 1023 1023 1023 1023 1023 1023 1023 1023 1023 1023
				1023 1023 1023 1023 1023 1023 1023 1023 1023 1023 1023 1023 1023 1023 1023 1023
				1023 1023 1023 1023 1023 1023 1023 1023 1023 1023 1023 1023 1023 1023 1023 1023
				1023 1023 1023 1023 1023 1023 1023 1023 1023 1023 1023 1023 1023 1023 1023 1023
				1023 1023 1023 1023 1023 1023 1023 1023 1023 1023 1023 1023 1023 1023 1023 1023
				1023 1023 1023 1023 1023 1023 1023 1023 1023 1023 1023 1023 1023 1023 1023 1023
				1023 1023 1023 1023 1023 1023 1023 1023 1023 1023 1023 1023 1023 1023 1023 1023
				1023 1023 1023 1023 1023 1023 1023 1023 1023 1023 1023 1023 1023 1023 1023 1023
				1023 1023 1023 1023 1023 1023 1023 1023 1023 1023 1023 1023 1023 1023 1023 1023
				1023 1023 1023 1023 1023 1023 1023 1023 1023 1023 1023 1023 1023 1023 1023 1023
				1023 1023 1023 1023 1023 1023 1023 1023 1023 1023 1023 1023 1023 1023 1023 1023
				1023 1023 1023 1023 1023 1023 1023 1023 1023 1023 1023 1023 1023 1023 1023 1023
				1023 1023 1023 1023 1023 1023 1023 1023 1023 1023 1023 1023 1023 1023 1023 1023
				1023 1023 1023 1023 1023 1023 1023 1023 1023 1023 1023 1023 1023 1023 1023 1023
				1023 1023 1023 1023 1023 1023 1023 1023 1023 1023 1023 1023 1023 1023 1023 1023
				1023 1023 1023 1023 1023 1023 1023 1023 1023 1023 1023 1023 1023 1023 1023 1023
				1023 1023 1023 1023 1023 1023 1023 1023 1023 1023 1023 1023 1023 1023 1023 1023
				1023 1023 1023 1023 1023 1023 1023 1023 1023 1023 1023 1023 1023 1023 1023 1023
				1023 1023 1023 1023 1023 1023 1023 1023 1023 1023 1023 1023 1023 1023 1023 1023
				1023 1023 1023 1023 1023 1023 1023 1023 1023 1023 1023 1023 1023 1023 1023 1023
				1023 1023 1023 1023 1023 1023 1023 1023 1023 1023 1023 1023 1023 1023 1023 1023
				1023 1023 1023 1023 1023 1023 1023 1023 1023 1023 1023 1023 1023 1023 1023 1023
				1023 1023 1023 1023 1023 1023 1023 1023 1023 1023 1023 1023 1023 1023 1023 1023
				1023 1023 1023 1023 1023 1023 1023 1023 1023 1023 1023 1023 1023 1023 1023 1023
				1023 1023 1023 1023 1023 1023 1023 1023 1023 1023 1023 1023 1023 1023 1023 1023
				1023 1023 1023 1023 1023 1023 1023 1023 1023 1023 1023 1023 1023 1023 1023 1023
				1023 1023 1023 1023 1023 1023 1023 1023 1023 1023 1023 1023 1023 1023 1023 1023
				1023 1023 1023 1023 1023 1023 1023 1023 1023 1023 1023 1023 1023 1023 1023 1023
				1023 1023 1023 1023 1023 1023 1023 1023 1023 1023 1023 1023 1023 1023 1023 1023
				1023 1023 1023 1023 1023 1023 1023 1023 1023 1023 1023 1023 1023 1023 1023 1023
				1023 1023 1023 1023 1023 1023 1023 1023 1023 1023 1023 1023 1023 1023 1023 1023
				1023 1023 1023 1023 1023 1023 1023 1023 1023 1023 1023 1023 1023 1023 1023 1023
				1023 1023 1023 1023 1023 1023 1023 1023 1023 1023 1023 1023 1023 1023 1023 1023
				1023 1023 1023 1023 1023 1023 1023 1023 1023 1023 1023 1023 1023 1023 1023 1023
				1023 1023 1023 1023 1023 1023 1023 1023 1023 1023 1023 1023 1023 1023 1023 1023
				1023 1023 1023 1023 1023 1023 1023 1023 1023 1023 1023 1023 1023 1023 1023 1023
				1023 1023 1023 1023 1023 1023 1023 1023 1023 1023 1023 1023 1023 1023 1023 1023
				1023 1023 1023 1023 1023 1023 1023 1023 1023 1023 1023 1023 1023 1023 1023 1023
				1023 1023 1023 1023 1023 1023 1023 1023 1023 1023 1023 1023 1023 1023 1023 1023
				1023 1023 1023 1023 1023 1023 1023 1023 1023 1023 1023 1023 1023 1023 1023 1023
				1023 1023 1023 1023 1023 1023 1023 1023 1023 1023 1023 1023 1023 1023 1023 1023
				1023 1023 1023 1023 1023 1023 1023 1023 1023 1023 1023 1023 1023 1023 1023 1023
				1023 1023 1023 1023 1023 1023 1023 1023 1023 1023 1023 1023 1023 1023 1023 1023
				1023 1023 1023 1023 1023 1023 1023 1023 1023 1023 1023 1023 1023 1023 1023 1023
				1023 1023 1023 1023 1023 1023 1023 1023 1023 1023 1023 1023 1023 1023 1023 1023
				1023 1023 1023 1023 1023 1023 1023 1023 1023 1023 1023 1023 1023 1023 1023 1023
				1023 1023 1023 1023 1023 1023 1023 1023 1023 1023 1023 1023 1023 1023 1023 1023
				1023 1023 1023 1023 1023 1023 1023 1023 1023 1023 1023 1023 1023 1023 1023 1023
				1023 1023 1023 1023 1023 1023 1023 1023 1023 1023 1023 1023 1023 1023 1023 1023
				1023 1023 1023 1023 1023 1023 1023 1023 1023 1023 1023 1023 1023 1023 1023 1023
				1023 1023 1023 1023 1023 1023 1023 1023 1023 1023 1023 1023 1023 1023 1023 1023
				1023 1023 1023 1023 1023 1023 1023 1023 1023 1023 1023 1023 1023 1023 1023 1023
				1023 1023 1023 1023 1023 1023 1023 1023 1023 1023 1023 1023 1023 1023 1023 1023
				1023 1023 1023 1023 1023 1023 1023 1023 1023 1023 1023 1023 1023 1023 1023 1023
				1023 1023 1023 1023 1023 1023 1023 1023 1023 1023 1023 1023 1023 1023 1023 1023
				1023 1023 1023 1023 1023 1023 1023 1023 1023 1023 1023 1023 1023 1023 1023 1023
				1023 1023 1023 1023 1023 1023 1023 1023 1023 1023 1023 1023 1023 1023 1023 1023
				1023 1023 1023 1023 1023 1023 1023 1023 1023 1023 1023 1023 1023 1023 1023 1023
				1023 1023 1023 1023 1023 1023 1023 1023 1023 1023 1023 1023 1023 1023 1023 1023
				1023 1023 1023 1023 1023 1023 1023 1023 1023 1023 1023 1023 1023 1023 1023 1023
				1023 1023 1023 1023 1023 1023 1023 1023 1023 1023 1023 1023 1023 1023 1023 1023
				1023 1023 1023 1023 1023 1023 1023 1023 1023 1023 1023 1023 1023 1023 1023 1023
				1023 1023 1023 1023 1023 1023 1023 1023 1023 1023 1023 1023 1023 1023 1023 1023
				1023 1023 1023 1023 1023 1023 1023 1023 1023 1023 1023 1023 1023 1023 1023 1023
				1023 1023 1023 1023 1023 1023 1023 1023 1023 1023 1023 1023 1023 1023 1023 1023
				1023 1023 1023 1023 1023 1023 1023 1023 1023 1023 1023 1023 1023 1023 1023 1023
				1023 1023 1023 1023 1023 1023 1023 1023 1023 1023 1023 1023 1023 1023 1023 1023
				1023 1023 1023 1023 1023 1023 1023 1023 1023 1023 1023 1023 1023 1023 1023 1023
				1023 1023 1023 1023 1023 1023 1023 1023 1023 1023 1023 1023 1023 1023 1023 1023
				1023 1023 1023 1023 1023 1023 1023 1023 1023 1023 1023 1023 1023 1023 1023 1023
				1023 1023 1023 1023 1023 1023 1023 1023 1023 1023 1023 1023 1023 1023 1023 1023
				1023 1023 1023 1023 1023 1023 1023 1023 1023 1023 1023 1023 1023 1023 1023 1023
				1023 1023 1023 1023 1023 1023 1023 1023 1023 1023 1023 1023 1023 1023 1023 1023
				1023 1023 1023 1023 1023 1023 1023 1023 1023 1023 1023 1023 1023 1023 1023 1023
				1023 1023 1023 1023 1023 1023 1023 1023 1023 1023 1023 1023 1023 1023 1023 1023
				1023 1023 1023 1023 1023 1023 1023 1023 1023 1023 1023 1023 1023 1023 1023 1023
				1023 1023 1023 1023 1023 1023 1023 1023 1023 1023 1023 1023 1023 1023 1023 1023
				1023 1023 1023 1023 1023 1023 1023 1023 1023 1023 1023 1023 1023 1023 1023 1023
				1023 1023 1023 1023 1023 1023 1023 1023 1023 1023 1023 1023 1023 1023 1023 1023
				1023 1023 1023 1023 1023 1023 1023 1023 1023 1023 1023 1023 1023 1023 1023 1023
				1023 1023 1023 1023 1023 1023 1023 1023 1023 1023 1023 1023 1023 1023 1023 1023
				1023 1023 1023 1023 1023 1023 1023 1023 1023 1023 1023 1023 1023 1023 1023 1023
				1023 1023 1023 1023 1023 1023 1023 1023 1023 1023 1023 1023 1023 1023 1023 1023
				1023 1023 1023 1023 1023 1023 1023 1023 1023 1023 1023 1023 1023 1023 1023 1023
				1023 1023 1023 1023 1023 1023 1023 1023 1023 1023 1023 1023 1023 1023 1023 1023
				1023 1023 1023 1023 1023 1023 1023 1023 1023 1023 1023 1023 1023 1023 1023 1023
				1023 1023 1023 1023 1023 1023 1023 1023 1023 1023 1023 1023 1023 1023 1023 1023
				1023 1023 1023 1023 1023 1023 1023 1023 1023 1023 1023 1023 1023 1023 1023 1023
				1023 1023 1023 1023 1023 1023 1023 1023 1023 1023 1023 1023 1023 1023 1023 1023
				1023 1023 1023 1023 1023 1023 1023 1023 1023 1023 1023 1023 1023 1023 1023 1023
				1023 1023 1023 1023 1023 1023 1023 1023 1023 1023 1023 1023 1023 1023 1023 1023
				1023 1023 1023 1023 1023 1023 1023 1023 1023 1023 1023 1023 1023 1023 1023 1023
				1023 1023 1023 1023 1023 1023 1023 1023 1023 1023 1023 1023 1023 1023 1023 1023
				1023 1023 1023 1023 1023 1023 1023 1023 1023 1023 1023 1023 1023 1023 1023 1023
				1023 1023 1023 1023 1023 1023 1023 1023 1023 1023 1023 1023 1023 1023 1023 1023>;

		qcom,mdss-dsi-display-timings {
			timing@0 {
				cell-index = <0>;
				qcom,mdss-dsi-panel-framerate = <60>;
				qcom,mdss-dsi-panel-width = <1080>;
				qcom,mdss-dsi-panel-height = <2400>;
				qcom,mdss-dsi-h-front-porch = <26>;
				qcom,mdss-dsi-h-back-porch = <30>;
				qcom,mdss-dsi-h-pulse-width = <10>;
				qcom,mdss-dsi-h-sync-skew = <0>;
				qcom,mdss-dsi-v-back-porch = <8>;
				qcom,mdss-dsi-v-front-porch = <3444>;
				qcom,mdss-dsi-v-pulse-width = <4>;
				qcom,mdss-dsi-h-left-border = <0>;
				qcom,mdss-dsi-h-right-border = <0>;
				qcom,mdss-dsi-v-top-border = <0>;
				qcom,mdss-dsi-v-bottom-border = <0>;

				qcom,mdss-dsi-on-command = [
					39 01 00 00 00 00 02 03 01
					39 01 00 00 00 00 02 53 20
					39 01 00 00 00 00 03 51 00 00
					39 01 00 00 00 00 02 6F 01
					39 01 00 00 00 00 02 35 00
					39 01 00 00 00 00 02 55 10
					39 01 00 00 00 00 02 59 09
					39 01 00 00 00 00 02 6C 00
					39 01 00 00 00 00 03 F0 AA 10
					39 01 00 00 00 00 17 D0 84 15 50 14 20 00 39 06 17 09 0B 00 06 17 09 0B 00 1B 05 05 17 17
					39 01 00 00 00 00 03 FF 5A 80
					39 01 00 00 00 00 02 65 0E
					39 01 00 00 00 00 02 F9 B9
					39 01 00 00 00 00 03 FF 5A 81
					39 01 00 00 00 00 02 65 03
					39 01 00 00 00 00 02 F4 03
					39 01 00 00 00 00 02 65 08
					39 01 00 00 00 00 03 F6 51 44
					05 01 00 00 4B 00 01 11
					39 01 00 00 00 00 03 FF 5A 81
					39 01 00 00 00 00 02 F3 08
					39 01 00 00 00 00 03 F0 AA 13
					39 01 00 00 00 00 07 C5 02 C0 02 95 03 44
					39 01 00 00 00 00 03 FF 5A 00
					39 01 00 00 00 00 03 F0 AA 00
					05 01 00 00 00 00 01 29
				];

				qcom,mdss-dsi-off-command = [
					05 01 00 00 14 00 02 28 00
					05 01 00 00 78 00 02 10 00];
				qcom,mdss-dsi-on-command-state = "dsi_lp_mode";
				qcom,mdss-dsi-off-command-state = "dsi_lp_mode";
				qcom,mdss-dsi-h-sync-pulse = <0>;
				qcom,compression-mode = "dsc";
				qcom,mdss-dsc-slice-height = <12>;
				qcom,mdss-dsc-slice-width = <540>;
				qcom,mdss-dsc-slice-per-pkt = <2>;
				qcom,mdss-dsc-bit-per-component = <10>;
				qcom,mdss-dsc-bit-per-pixel = <8>;
				qcom,mdss-dsc-block-prediction-enable;

				qcom,mdss-dsi-dfps-60-command = [
					39 00 00 00 00 00 02 6C 00
					39 01 00 00 00 00 02 62 00];
				qcom,mdss-dsi-dfps-60-command-state = "dsi_hs_mode";

				qcom,mdss-dsi-dfps-90-command = [
					39 00 00 00 00 00 02 6c 01
					39 00 00 00 00 00 02 62 01
					39 00 00 00 00 00 03 F0 AA 10
					39 01 00 00 00 00 0E B1 01 57 00 0C 0D 74 00 01 57 00 0C 05 D4];
				qcom,mdss-dsi-dfps-90-command-state = "dsi_hs_mode";

				qcom,mdss-dsi-dfps-120-command = [
					39 00 00 00 00 00 02 6c 01
					39 00 00 00 00 00 02 62 00
					39 00 00 00 00 00 03 F0 AA 10
					39 01 00 00 00 00 0E B1 01 57 00 0C 0D 74 00 01 57 00 0C 02 04];
				qcom,mdss-dsi-dfps-120-command-state = "dsi_hs_mode";
			};
		};
	};
};
