/dts-v1/;
/plugin/;

#include "parrot-lamy-common-overlay.dtsi"

/ {
	model = "lamy";
	compatible = "qcom,parrot-qrd", "qcom,parrot", "qcom,qrd", "moto,lamy";
	qcom,msm-id = <663 0x10000>;
	qcom,board-id = <0x42 0x9000>;
};

