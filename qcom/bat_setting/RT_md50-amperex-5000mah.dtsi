/*
 * Copyright (C) 2021 MediaTek Inc.
 *
 * This program is free software; you can redistribute it and/or modify
 * it under the terms of the GNU General Public License version 2 as
 * published by the Free Software Foundation.
 *
 * This program is distributed in the hope that it will be useful,
 * but WITHOUT ANY WARRANTY; without even the implied warranty of
 * MERCHANTABILITY or FITNESS FOR A PARTICULAR PURPOSE.
 * See http://www.gnu.org/licenses/gpl-2.0.html for more details.
 */
md50-amperex-5000mah {
        serialnum = "SB18D33989";
	/* add for aging cv */
	rt,fcc_design = <5000>;
	rt,fcc = <4654 4654 4654 4654 4654>;
	rt,fg_fc_vth = <0x9e 0x9e 0x9e 0x9e 0x9e>;
	rt,init_ocv_table = <3400 3485 3571 3614 3657 3683 3683 3686 3690 3695
			     3699 3704 3708 3712 3717 3721 3726 3731 3736 3740
			     3745 3750 3754 3759 3764 3767 3771 3775 3778 3782
			     3786 3789 3793 3797 3800 3804 3808 3811 3815 3819
			     3822 3827 3831 3835 3840 3844 3849 3853 3857 3863
			     3869 3875 3882 3888 3895 3905 3915 3925 3935 3946
			     3956 3966 3976 3985 3995 4005 4014 4024 4033 4043
			     4053 4062 4073 4083 4094 4105 4116 4127 4138 4149
			     4160 4171 4182 4193 4204 4215 4227 4238 4249 4260
			     4271 4283 4294 4305 4312 4318 4325 4331 4338 4344 4351>;
	rt,fg_extreg_table = [80 80 33 6E B7 E4 58 02 CF 98 61 3A 88 81 00 00
			      80 34 00 00 FB 3E 00 20 FB 0A 1D 32 12 05 5A 5A
			      00 82 00 02 00 02 00 40 00 40 2E 12 2E 12 04 24
			      64 00 5F 0B 64 00 5F 0B FF 00 00 14 00 00 5A B7
			      15 0E 48 44 9E 64 05 41 19 07 B6 12 23 32 03 00
			      13 88 24 82 77 AD 04 73 12 A3 52 68 57 64 25 0F
			      20 16 03 0B 0B 0B 0A 0A 01 FE 07 07 07 07 07 F5
			      EB F6 F6 F6 F7 F7 B9 98 80 80 80 A9 A9 80 80 00
			      76 02 C0 48 14 09 00 00 00 00 00 00 00 00 37 73
			      2D 19 05 FB 00 00 B9 36 96 33 0F 07 06 05 0B A9
			      32 32 88 88 32 32 88 88 32 32 88 88 32 32 88 88
			      32 32 88 88 32 32 88 88 32 32 88 88 32 32 88 88
			      32 32 88 88 32 32 88 88 32 32 88 88 32 32 88 88
			      32 32 88 88 32 32 88 88 32 32 88 88 32 32 88 88];
	rt,fg_ocv_table0 = <0x0013 0x49C0 0x5500 0x594C 0x5C12 0x5C19 0x5CF8 0x5E18
			    0x5F94 0x6083 0x6161 0x6253 0x6338 0x65A3 0x67DD 0x693B
			    0x6A68 0x6BAA 0x6CC6 0x706D 0x2D00 0x044C 0x0223 0x0007
			    0x0039 0x003C 0x002F 0x0038 0x0052 0x0083 0x0083 0x007B
			    0x008B 0x008F 0x008F 0x008F 0x0052 0x0176 0x0013 0xFF80
			    0x0000 0x0200 0x049A 0x0680 0x0E4D 0x17E6 0x281A 0x309A
			    0x3600 0x39B3 0x3D33 0x474D 0x4F80 0x5466 0x589A 0x5D1A
			    0x6400 0x6900 0x0006 0x003C 0x0078 0x2277 0x047F 0x0442
			    0x0576 0x048B 0x0320 0x01F5 0x01F4 0x0217 0x01D8 0x01CA
			    0x01CA 0x01CA 0x031B 0x00AF 0x0F15 0x0000 0x0000 0x0000>;
	rt,fg_ocv_table1 = <0x0013 0x49C0 0x5500 0x594C 0x5C12 0x5C19 0x5CF8 0x5E18
			    0x5F94 0x6083 0x6161 0x6253 0x6338 0x65A3 0x67DD 0x693B
			    0x6A68 0x6BAA 0x6CC6 0x706D 0x2D00 0x044C 0x0223 0x0007
			    0x0039 0x003C 0x002F 0x0038 0x0052 0x0083 0x0083 0x007B
			    0x008B 0x008F 0x008F 0x008F 0x0052 0x0176 0x0013 0xFF80
			    0x0000 0x0200 0x049A 0x0680 0x0E4D 0x17E6 0x281A 0x309A
			    0x3600 0x39B3 0x3D33 0x474D 0x4F80 0x5466 0x589A 0x5D1A
			    0x6400 0x6900 0x0006 0x003C 0x0078 0x2277 0x047F 0x0442
			    0x0576 0x048B 0x0320 0x01F5 0x01F4 0x0217 0x01D8 0x01CA
			    0x01CA 0x01CA 0x031B 0x00AF 0x0F15 0x0000 0x0000 0x0000>;
	rt,fg_ocv_table2 = <0x0013 0x49C0 0x5500 0x594C 0x5C12 0x5C19 0x5CF8 0x5E18
			    0x5F94 0x6083 0x6161 0x6253 0x6338 0x65A3 0x67DD 0x693B
			    0x6A68 0x6BAA 0x6CC6 0x706D 0x2D00 0x044C 0x0223 0x0007
			    0x0039 0x003C 0x002F 0x0038 0x0052 0x0083 0x0083 0x007B
			    0x008B 0x008F 0x008F 0x008F 0x0052 0x0176 0x0013 0xFF80
			    0x0000 0x0200 0x049A 0x0680 0x0E4D 0x17E6 0x281A 0x309A
			    0x3600 0x39B3 0x3D33 0x474D 0x4F80 0x5466 0x589A 0x5D1A
			    0x6400 0x6900 0x0006 0x003C 0x0078 0x2277 0x047F 0x0442
			    0x0576 0x048B 0x0320 0x01F5 0x01F4 0x0217 0x01D8 0x01CA
			    0x01CA 0x01CA 0x031B 0x00AF 0x0F15 0x0000 0x0000 0x0000>;
	rt,fg_ocv_table3 = <0x0013 0x49C0 0x5500 0x594C 0x5C12 0x5C19 0x5CF8 0x5E18
			    0x5F94 0x6083 0x6161 0x6253 0x6338 0x65A3 0x67DD 0x693B
			    0x6A68 0x6BAA 0x6CC6 0x706D 0x2D00 0x044C 0x0223 0x0007
			    0x0039 0x003C 0x002F 0x0038 0x0052 0x0083 0x0083 0x007B
			    0x008B 0x008F 0x008F 0x008F 0x0052 0x0176 0x0013 0xFF80
			    0x0000 0x0200 0x049A 0x0680 0x0E4D 0x17E6 0x281A 0x309A
			    0x3600 0x39B3 0x3D33 0x474D 0x4F80 0x5466 0x589A 0x5D1A
			    0x6400 0x6900 0x0006 0x003C 0x0078 0x2277 0x047F 0x0442
			    0x0576 0x048B 0x0320 0x01F5 0x01F4 0x0217 0x01D8 0x01CA
			    0x01CA 0x01CA 0x031B 0x00AF 0x0F15 0x0000 0x0000 0x0000>;
	rt,fg_ocv_table4 = <0x0013 0x49C0 0x5500 0x594C 0x5C12 0x5C19 0x5CF8 0x5E18
			    0x5F94 0x6083 0x6161 0x6253 0x6338 0x65A3 0x67DD 0x693B
			    0x6A68 0x6BAA 0x6CC6 0x706D 0x2D00 0x044C 0x0223 0x0007
			    0x0039 0x003C 0x002F 0x0038 0x0052 0x0083 0x0083 0x007B
			    0x008B 0x008F 0x008F 0x008F 0x0052 0x0176 0x0013 0xFF80
			    0x0000 0x0200 0x049A 0x0680 0x0E4D 0x17E6 0x281A 0x309A
			    0x3600 0x39B3 0x3D33 0x474D 0x4F80 0x5466 0x589A 0x5D1A
			    0x6400 0x6900 0x0006 0x003C 0x0078 0x2277 0x047F 0x0442
			    0x0576 0x048B 0x0320 0x01F5 0x01F4 0x0217 0x01D8 0x01CA
			    0x01CA 0x01CA 0x031B 0x00AF 0x0F15 0x0000 0x0000 0x0000>;
};

