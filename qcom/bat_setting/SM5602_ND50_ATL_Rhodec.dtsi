/*
 * Copyright (C) 2022 Motorola Inc.
 *
 * This program is free software; you can redistribute it and/or modify
 * it under the terms of the GNU General Public License version 2 as
 * published by the Free Software Foundation.
 *
 * This program is distributed in the hope that it will be useful,
 * but WITHOUT ANY WARRANTY; without even the implied warranty of
 * MERCHANTABILITY or FITNESS FOR A PARTICULAR PURPOSE.
 * See http://www.gnu.org/licenses/gpl-2.0.html for more details.
 */
SM5602_ND50_ATL {
	serialnum = "SB18D24973";

	battery,param_version = <3>;
	battery,max_voltage_uv = <4450000>;
	battery,battery_type = <4450 0x0 0x277A>;
	battery,battery_table0 = <0x1400 0x1B49 0x1C5A 0x1CDF 0x1D3E 0x1D62 0x1D80 0x1D97
					0x1DB7 0x1DF4 0x1E1B 0x1E4A 0x1E78 0x1EC8 0x1F28 0x1F6E
					0x1FAB 0x1FFE 0x20C8 0x2174 0x2247 0x22BF 0x2340 0x24CC>;
	battery,battery_table1 = <0x0 0x66 0x1B8 0x2BB 0x3BE 0x440 0x543 0xAD6 0xCDD 0x11EE
 					0x16FF 0x1C10 0x23A9 0x2DCB 0x3564 0x37ED 0x3A75 0x3F86
					0x49A8 0x5141 0x59DE 0x5EEF 0x6400 0x64E6>;
	battery,battery_table2 = <0x1E2E 0x1719 0x1415 0x1112 0x1010 0x0F0F 0x0E0E 0x0E0E>;
	battery,alpha = <0x00CC>;
	battery,beta = <0x0025>;
	battery,rs = <0x005F>;
	battery,rs_value = <0x0050 0x010A 0x3800 0x0048>;
	battery,vit_period = <0x315A>;
	battery,volt_cal = <0x8000>;
	battery,mix_value = <0x0003>;
	battery,curr_offset = <0x000>;
	battery,curr_slope = <0x8080>;
	battery,topoff_soc = <7 500>;
	battery,temp_std = <25>;
	battery,temp_offset = <0 11 1 0 8 (-1)>;
	battery,temp_cal = <0 6 1 11 (-1) 0 6 1 9 1>;
	battery,ext_temp_cal = <0 2 1 2 1 1 2 3 2 3>;
	battery,tem_poff = <3400 100>;
        battery,thermal_table = <0x3CAB 0x365A 0x3025 0x2A24 0x2436 0x1E74 0x18D7 0x13A6 0x0E6F 0x0963
					0x047E 0xF78B 0xF2F2 0xEE7D 0xEA3D 0xE629 0xE23C 0xDE7B 0xDAE1 0xD769
					0xD414 0xD0E7 0xCDDA 0xCAEF 0xC827 0xC57C 0xC2EE 0xC07F 0xBE2D 0xBBF2
					0xB9D5 0xB7CE 0xB5E1 0xB409 0xB248 0xB09A 0xAF03 0xAD7D 0xAC08 0xAAA8
					0xA957 0xA818 0xA6DD 0xA5BD 0xA4A7 0xA39C 0xA2A1 0xA1B1 0xA0CA 0x9FF3
					0x9F22 0x9E58 0x9D99 0x9CE6 0x9C3B 0x9B94 0x9AF6 0x9A61 0x99D2 0x994B
					0x98CB 0x984E 0x97D6 0x9765 0x96FA 0x9693 0x9632 0x95D4 0x9579 0x9522
					0x94D0 0x9481 0x9435 0x93EC 0x93A6 0x9364 0x9325 0x92EA 0x92B1 0x927B
					0x9246 0x9212 0x91E1 0x91B2 0x9185 0x915A 0x9132 0x910B 0x90E6 0x90C2
					0x90A0 0x907F 0x905E 0x903F 0x9022 0x9005 0x8FEA 0x8FD0 0x8FB7 0x8F9F
					0x8F89>;  //NTC value(DEC) table -20~80
};
