/*
 * Copyright (C) 2021 Motorola Inc.
 *
 * This program is free software; you can redistribute it and/or modify
 * it under the terms of the GNU General Public License version 2 as
 * published by the Free Software Foundation.
 *
 * This program is distributed in the hope that it will be useful,
 * but WITHOUT ANY WARRANTY; without even the implied warranty of
 * MERCHANTABILITY or FITNESS FOR A PARTICULAR PURPOSE.
 * See http://www.gnu.org/licenses/gpl-2.0.html for more details.
 */
nh50-atl-4850mah {
	serialnum = "SB18D69208";
		rt,fg_extreg_table = [80 80 46 79 A7 BB 58 02 AA 85 5F 40 88 81 00 00
							  40 24 00 00 FB 3E 00 20 7F 0A 1D 32 12 07 5A 5A
							  00 82 00 02 00 02 00 40 00 40 94 11 94 11 04 24
							  64 00 5F 0B 64 00 5F 0B FF 00 00 14 00 00 5A B7
							  15 0E 48 44 A2 77 05 41 19 08 B5 12 23 32 08 00
							  13 88 24 82 77 AD 04 73 12 A3 52 68 57 64 1F 0F
							  32 19 09 0B 0B 0B 09 09 03 FB 08 08 08 05 05 FC
							  EA E9 E9 E9 CF CF B3 86 E9 E9 E9 86 86 86 86 00
							  76 02 C0 48 0A 09 00 00 00 00 00 00 00 00 37 73
							  2D 19 05 FB 00 00 B9 36 96 33 0F 07 07 05 0B A9
							  32 32 88 88 32 32 88 88 32 32 88 88 32 32 88 88
							  32 32 88 88 32 32 88 88 32 32 88 88 32 32 88 88
							  32 32 88 88 32 32 88 88 32 32 88 88 32 32 88 88
							  32 32 88 88 32 32 88 88 32 32 88 88 32 32 88 88];
		rt,init_ocv_table = <3400 3501 3603 3633 3663 3683 3688 3692 3696 3701
							 3705 3710 3714 3719 3723 3727 3731 3735 3739 3743
							 3747 3751 3755 3759 3763 3767 3771 3775 3779 3783
							 3786 3790 3794 3798 3802 3806 3810 3814 3817 3821
							 3825 3830 3835 3839 3844 3849 3854 3859 3863 3869
							 3877 3885 3893 3901 3908 3919 3929 3940 3950 3961
							 3971 3981 3992 4002 4012 4023 4033 4043 4053 4064
							 4074 4084 4095 4106 4118 4129 4140 4152 4163 4174
							 4186 4196 4207 4218 4229 4240 4251 4263 4274 4284
							 4293 4301 4310 4319 4328 4337 4345 4354 4363 4372 4381>;
		rt,fcc_design = <5000>;
		rt,fcc = <4500 4500 4500 4500 4500>;
		rt,fg_fc_vth = <0xA2 0xA2 0xA2 0xA2 0xA2>;
		rt,fg_ocv_table0 = <0x0013 0x4A40 0x5500 0x5A17 0x5C0D 0x5C41 0x5D20 0x5E16
							0x5FA6 0x60AB 0x61B9 0x62B0 0x639A 0x6631 0x6884 0x69DB
							0x6B05 0x6C02 0x6D86 0x706D 0x2B00 0x0517 0x0183 0x0037
							0x0039 0x0033 0x0031 0x003D 0x0064 0x0086 0x0086 0x0083
							0x0091 0x008C 0x008E 0x0071 0x0071 0x0129 0x0013 0xFF80
							0x0000 0x0200 0x049A 0x0680 0x0E4D 0x17E6 0x281A 0x309A
							0x3600 0x39B3 0x3D33 0x474D 0x4F80 0x5466 0x589A 0x5D1A
							0x6400 0x6900 0x0006 0x0032 0x00A9 0x04AA 0x047D 0x0500
							0x052C 0x042B 0x0290 0x01EB 0x01EB 0x01F3 0x01C4 0x01D4
							0x01CE 0x0246 0x0246 0x00DD 0xC224 0x0000 0x0000 0x0000>;
		rt,fg_ocv_table1 = <0x0013 0x4A40 0x5500 0x5A17 0x5C0D 0x5C41 0x5D20 0x5E16
							0x5FA6 0x60AB 0x61B9 0x62B0 0x639A 0x6631 0x6884 0x69DB
							0x6B05 0x6C02 0x6D86 0x706D 0x2B00 0x0517 0x0183 0x0037
							0x0039 0x0033 0x0031 0x003D 0x0064 0x0086 0x0086 0x0083
							0x0091 0x008C 0x008E 0x0071 0x0071 0x0129 0x0013 0xFF80
							0x0000 0x0200 0x049A 0x0680 0x0E4D 0x17E6 0x281A 0x309A
							0x3600 0x39B3 0x3D33 0x474D 0x4F80 0x5466 0x589A 0x5D1A
							0x6400 0x6900 0x0006 0x0032 0x00A9 0x04AA 0x047D 0x0500
							0x052C 0x042B 0x0290 0x01EB 0x01EB 0x01F3 0x01C4 0x01D4
							0x01CE 0x0246 0x0246 0x00DD 0xC224 0x0000 0x0000 0x0000>;
		rt,fg_ocv_table2 = <0x0013 0x4A40 0x5500 0x5A17 0x5C0D 0x5C41 0x5D20 0x5E16
							0x5FA6 0x60AB 0x61B9 0x62B0 0x639A 0x6631 0x6884 0x69DB
							0x6B05 0x6C02 0x6D86 0x706D 0x2B00 0x0517 0x0183 0x0037
							0x0039 0x0033 0x0031 0x003D 0x0064 0x0086 0x0086 0x0083
							0x0091 0x008C 0x008E 0x0071 0x0071 0x0129 0x0013 0xFF80
							0x0000 0x0200 0x049A 0x0680 0x0E4D 0x17E6 0x281A 0x309A
							0x3600 0x39B3 0x3D33 0x474D 0x4F80 0x5466 0x589A 0x5D1A
							0x6400 0x6900 0x0006 0x0032 0x00A9 0x04AA 0x047D 0x0500
							0x052C 0x042B 0x0290 0x01EB 0x01EB 0x01F3 0x01C4 0x01D4
							0x01CE 0x0246 0x0246 0x00DD 0xC224 0x0000 0x0000 0x0000>;
		rt,fg_ocv_table3 = <0x0013 0x4A40 0x5500 0x5A17 0x5C0D 0x5C41 0x5D20 0x5E16
							0x5FA6 0x60AB 0x61B9 0x62B0 0x639A 0x6631 0x6884 0x69DB
							0x6B05 0x6C02 0x6D86 0x706D 0x2B00 0x0517 0x0183 0x0037
							0x0039 0x0033 0x0031 0x003D 0x0064 0x0086 0x0086 0x0083
							0x0091 0x008C 0x008E 0x0071 0x0071 0x0129 0x0013 0xFF80
							0x0000 0x0200 0x049A 0x0680 0x0E4D 0x17E6 0x281A 0x309A
							0x3600 0x39B3 0x3D33 0x474D 0x4F80 0x5466 0x589A 0x5D1A
							0x6400 0x6900 0x0006 0x0032 0x00A9 0x04AA 0x047D 0x0500
							0x052C 0x042B 0x0290 0x01EB 0x01EB 0x01F3 0x01C4 0x01D4
							0x01CE 0x0246 0x0246 0x00DD 0xC224 0x0000 0x0000 0x0000>;
		rt,fg_ocv_table4 = <0x0013 0x4A40 0x5500 0x5A17 0x5C0D 0x5C41 0x5D20 0x5E16
							0x5FA6 0x60AB 0x61B9 0x62B0 0x639A 0x6631 0x6884 0x69DB
							0x6B05 0x6C02 0x6D86 0x706D 0x2B00 0x0517 0x0183 0x0037
							0x0039 0x0033 0x0031 0x003D 0x0064 0x0086 0x0086 0x0083
							0x0091 0x008C 0x008E 0x0071 0x0071 0x0129 0x0013 0xFF80
							0x0000 0x0200 0x049A 0x0680 0x0E4D 0x17E6 0x281A 0x309A
							0x3600 0x39B3 0x3D33 0x474D 0x4F80 0x5466 0x589A 0x5D1A
							0x6400 0x6900 0x0006 0x0032 0x00A9 0x04AA 0x047D 0x0500
							0x052C 0x042B 0x0290 0x01EB 0x01EB 0x01F3 0x01C4 0x01D4
							0x01CE 0x0246 0x0246 0x00DD 0xC224 0x0000 0x0000 0x0000>;
};
