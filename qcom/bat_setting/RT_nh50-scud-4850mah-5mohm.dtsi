/*
 * Copyright (C) 2021 Motorola Inc.
 *
 * This program is free software; you can redistribute it and/or modify
 * it under the terms of the GNU General Public License version 2 as
 * published by the Free Software Foundation.
 *
 * This program is distributed in the hope that it will be useful,
 * but WITHOUT ANY WARRANTY; without even the implied warranty of
 * MERCHANTABILITY or FITNESS FOR A PARTICULAR PURPOSE.
 * See http://www.gnu.org/licenses/gpl-2.0.html for more details.
 */
nh50-scud-4850mah {
	serialnum = "SB18D69209";
		rt,fg_extreg_table = [80 80 46 79 A7 BB 58 02 AA 85 5F 40 88 81 00 00
							  40 24 00 00 FB 3E 00 20 7F 0A 1D 32 12 07 5A 5A
							  00 82 00 02 00 02 00 40 00 40 7B 11 7B 11 04 24
							  64 00 5F 0B 64 00 5F 0B FF 00 00 14 00 00 5A B7
							  15 0E 48 44 A2 77 05 41 19 08 B5 12 23 32 08 00
							  13 88 24 82 77 AD 04 73 12 A3 52 68 57 64 1F 0F
							  32 19 09 08 08 08 06 06 01 FB 05 05 05 03 03 FD
							  F3 F6 F6 F6 CD CD B7 94 F6 F6 F6 80 80 80 80 00
							  76 02 C0 48 0A 09 00 00 00 00 00 00 00 00 37 73
							  2D 19 05 FB 00 00 B9 36 96 33 0F 07 0A 05 0B A9
							  32 32 88 88 32 32 88 88 32 32 88 88 32 32 88 88
							  32 32 88 88 32 32 88 88 32 32 88 88 32 32 88 88
							  32 32 88 88 32 32 88 88 32 32 88 88 32 32 88 88
							  32 32 88 88 32 32 88 88 32 32 88 88 32 32 88 88];
		rt,init_ocv_table = <3400 3488 3577 3616 3655 3678 3679 3682 3687 3692
							 3697 3702 3708 3713 3718 3723 3728 3734 3739 3744
							 3749 3755 3760 3765 3770 3774 3779 3783 3787 3791
							 3796 3800 3804 3808 3813 3817 3821 3825 3829 3834
							 3838 3843 3848 3854 3859 3864 3870 3875 3880 3887
							 3894 3901 3909 3916 3924 3933 3943 3952 3962 3973
							 3985 3996 4007 4018 4029 4041 4052 4063 4074 4085
							 4096 4108 4119 4130 4141 4152 4163 4174 4186 4197
							 4208 4219 4231 4242 4253 4264 4275 4286 4297 4306
							 4314 4322 4330 4338 4346 4354 4362 4370 4378 4386 4395>;
		rt,fcc_design = <5000>;
		rt,fcc = <4475 4475 4475 4475 4475>;
		rt,fg_fc_vth = <0xA2 0xA2 0xA2 0xA2 0xA2>;
		rt,fg_ocv_table0 = <0x0013 0x4A40 0x5500 0x5973 0x5BF8 0x5BFE 0x5CFF 0x5E42
					0x5FF9 0x611B 0x621A 0x62FB 0x63F8 0x66C9 0x6912 0x6A76
					0x6B97 0x6C7E 0x6DE0 0x706D 0x2B00 0x0473 0x01F0 0x0007
					0x0042 0x0043 0x0036 0x0044 0x005F 0x0079 0x0091 0x008F
					0x008F 0x0091 0x0089 0x0067 0x0067 0x0105 0x0013 0xFF80
				    0x0000 0x0200 0x049A 0x0680 0x0E4D 0x17E6 0x281A 0x309A
				    0x3600 0x39B3 0x3D33 0x474D 0x4F80 0x5466 0x589A 0x5D1A
					0x6400 0x6900 0x0006 0x003A 0x0084 0x25F9 0x03E3 0x03CF
					0x04B9 0x03C1 0x02B3 0x021C 0x01C5 0x01CB 0x01CB 0x01C3
					0x01DD 0x027F 0x027F 0x00FB 0xD326 0x0000 0x0000 0x0000>;
		rt,fg_ocv_table1 = <0x0013 0x4A40 0x5500 0x5973 0x5BF8 0x5BFE 0x5CFF 0x5E42
					0x5FF9 0x611B 0x621A 0x62FB 0x63F8 0x66C9 0x6912 0x6A76
					0x6B97 0x6C7E 0x6DE0 0x706D 0x2B00 0x0473 0x01F0 0x0007
					0x0042 0x0043 0x0036 0x0044 0x005F 0x0079 0x0091 0x008F
					0x008F 0x0091 0x0089 0x0067 0x0067 0x0105 0x0013 0xFF80
				    0x0000 0x0200 0x049A 0x0680 0x0E4D 0x17E6 0x281A 0x309A
				    0x3600 0x39B3 0x3D33 0x474D 0x4F80 0x5466 0x589A 0x5D1A
					0x6400 0x6900 0x0006 0x003A 0x0084 0x25F9 0x03E3 0x03CF
					0x04B9 0x03C1 0x02B3 0x021C 0x01C5 0x01CB 0x01CB 0x01C3
					0x01DD 0x027F 0x027F 0x00FB 0xD326 0x0000 0x0000 0x0000>;
		rt,fg_ocv_table2 = <0x0013 0x4A40 0x5500 0x5973 0x5BF8 0x5BFE 0x5CFF 0x5E42
					0x5FF9 0x611B 0x621A 0x62FB 0x63F8 0x66C9 0x6912 0x6A76
					0x6B97 0x6C7E 0x6DE0 0x706D 0x2B00 0x0473 0x01F0 0x0007
					0x0042 0x0043 0x0036 0x0044 0x005F 0x0079 0x0091 0x008F
					0x008F 0x0091 0x0089 0x0067 0x0067 0x0105 0x0013 0xFF80
				    0x0000 0x0200 0x049A 0x0680 0x0E4D 0x17E6 0x281A 0x309A
				    0x3600 0x39B3 0x3D33 0x474D 0x4F80 0x5466 0x589A 0x5D1A
					0x6400 0x6900 0x0006 0x003A 0x0084 0x25F9 0x03E3 0x03CF
					0x04B9 0x03C1 0x02B3 0x021C 0x01C5 0x01CB 0x01CB 0x01C3
					0x01DD 0x027F 0x027F 0x00FB 0xD326 0x0000 0x0000 0x0000>;
		rt,fg_ocv_table3 = <0x0013 0x4A40 0x5500 0x5973 0x5BF8 0x5BFE 0x5CFF 0x5E42
					0x5FF9 0x611B 0x621A 0x62FB 0x63F8 0x66C9 0x6912 0x6A76
					0x6B97 0x6C7E 0x6DE0 0x706D 0x2B00 0x0473 0x01F0 0x0007
					0x0042 0x0043 0x0036 0x0044 0x005F 0x0079 0x0091 0x008F
					0x008F 0x0091 0x0089 0x0067 0x0067 0x0105 0x0013 0xFF80
				    0x0000 0x0200 0x049A 0x0680 0x0E4D 0x17E6 0x281A 0x309A
				    0x3600 0x39B3 0x3D33 0x474D 0x4F80 0x5466 0x589A 0x5D1A
					0x6400 0x6900 0x0006 0x003A 0x0084 0x25F9 0x03E3 0x03CF
					0x04B9 0x03C1 0x02B3 0x021C 0x01C5 0x01CB 0x01CB 0x01C3
					0x01DD 0x027F 0x027F 0x00FB 0xD326 0x0000 0x0000 0x0000>;
		rt,fg_ocv_table4 = <0x0013 0x4A40 0x5500 0x5973 0x5BF8 0x5BFE 0x5CFF 0x5E42
					0x5FF9 0x611B 0x621A 0x62FB 0x63F8 0x66C9 0x6912 0x6A76
					0x6B97 0x6C7E 0x6DE0 0x706D 0x2B00 0x0473 0x01F0 0x0007
					0x0042 0x0043 0x0036 0x0044 0x005F 0x0079 0x0091 0x008F
					0x008F 0x0091 0x0089 0x0067 0x0067 0x0105 0x0013 0xFF80
				    0x0000 0x0200 0x049A 0x0680 0x0E4D 0x17E6 0x281A 0x309A
				    0x3600 0x39B3 0x3D33 0x474D 0x4F80 0x5466 0x589A 0x5D1A
					0x6400 0x6900 0x0006 0x003A 0x0084 0x25F9 0x03E3 0x03CF
					0x04B9 0x03C1 0x02B3 0x021C 0x01C5 0x01CB 0x01CB 0x01C3
					0x01DD 0x027F 0x027F 0x00FB 0xD326 0x0000 0x0000 0x0000>;
};
