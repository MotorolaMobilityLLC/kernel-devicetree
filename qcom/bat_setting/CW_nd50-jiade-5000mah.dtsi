/*
 * Copyright (C) 2021 Motorola Inc.
 *
 * This program is free software; you can redistribute it and/or modify
 * it under the terms of the GNU General Public License version 2 as
 * published by the Free Software Foundation.
 *
 * This program is distributed in the hope that it will be useful,
 * but WITHOUT ANY WARRANTY; without even the implied warranty of
 * MERCHANTABILITY or FITNESS FOR A PARTICULAR PURPOSE.
 * See http://www.gnu.org/licenses/gpl-2.0.html for more details.
 */
nd50-jiade-5000mah {
	serialnum = "SB18D25053";
	fcc_design = <5000>;
	ui_full = <98>;
	config_profile_info = [5A 00 00 00 00 00 00 00
				9E BE B7 CF C2 C1 91 4F
				31 FF FF FF C3 A3 8B 75
				61 57 4C 8E E6 DE 83 D0
				CC C8 D1 D5 D6 D4 D1 CD
				CC CA CB C1 A0 94 8A 81
				76 6D 7A 91 A7 86 5F 72
				20 00 57 10 02 B0 5A 00
				00 00 64 26 D3 4D 00 00
				00 00 00 00 00 00 00 04 ];
};