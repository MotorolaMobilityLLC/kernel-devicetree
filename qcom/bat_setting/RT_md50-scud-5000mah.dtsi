/*
 * Copyright (C) 2021 Motorola Inc.
 *
 * This program is free software; you can redistribute it and/or modify
 * it under the terms of the GNU General Public License version 2 as
 * published by the Free Software Foundation.
 *
 * This program is distributed in the hope that it will be useful,
 * but WITHOUT ANY WARRANTY; without even the implied warranty of
 * MERCHANTABILITY or FITNESS FOR A PARTICULAR PURPOSE.
 * See http://www.gnu.org/licenses/gpl-2.0.html for more details.
 */
md50-scud-5000mah {
        serialnum = "SB18D01192";
	/* add for aging cv */
	rt,fcc_design = <5000>;
	rt,fcc = <4540 4540 4540 4540 4540>;
	rt,fg_fc_vth = <0x9e 0x9e 0x9e 0x9e 0x9e>;
	rt,init_ocv_table = <3400 3483 3567 3609 3651 3678 3682 3685 3689 3693
			     3697 3700 3704 3708 3711 3716 3722 3727 3732 3738
			     3743 3748 3754 3759 3764 3768 3773 3777 3781 3785
			     3789 3793 3797 3801 3805 3809 3813 3817 3821 3825
			     3829 3834 3839 3844 3848 3853 3858 3862 3867 3873
			     3880 3888 3895 3903 3910 3917 3924 3930 3938 3949
			     3959 3970 3980 3991 4002 4012 4023 4034 4044 4055
			     4066 4076 4088 4101 4113 4125 4138 4150 4163 4175
			     4185 4193 4201 4209 4217 4226 4237 4248 4258 4269
			     4280 4290 4301 4312 4317 4322 4326 4331 4335 4340 4345>;
	rt,fg_extreg_table = [80 80 33 6E B7 E4 58 02 CF 98 61 3A 88 81 00 00
			      80 34 00 00 FB 3E 00 20 FB 0A 1D 32 12 05 5A 5A
			      00 82 00 02 00 02 00 40 00 40 BC 11 BC 11 04 24
			      64 00 5F 0B 64 00 5F 0B FF 00 00 14 00 00 5A B7
			      15 0E 48 44 9E 64 05 41 19 07 B6 12 23 32 08 00
			      13 88 24 82 77 AD 04 73 12 A3 52 68 57 64 25 0F
			      20 16 03 0D 0D 0D 0C 0C 05 01 07 07 07 07 07 F4
			      E9 F5 F5 F5 F4 F4 B8 98 80 80 80 93 93 80 80 00
			      76 02 C0 48 14 09 00 00 00 00 00 00 00 00 37 73
			      2D 19 05 FB 00 00 B9 36 96 33 0F 07 00 00 0B A9
			      32 32 88 88 32 32 88 88 32 32 88 88 32 32 88 88
			      32 32 88 88 32 32 88 88 32 32 88 88 32 32 88 88
			      32 32 88 88 32 32 88 88 32 32 88 88 32 32 88 88
			      32 32 88 88 32 32 88 88 32 32 88 88 32 32 88 88];
	rt,fg_ocv_table0 = <0x0013 0x4A40 0x5500 0x592F 0x5BEF 0x5C19 0x5CD4 0x5E1D
			    0x5FC2 0x60C2 0x61C3 0x6264 0x6350 0x6601 0x688B 0x6982
			    0x6AA2 0x6BD6 0x6CA0 0x706D 0x2B00 0x042F 0x021E 0x002C
			    0x0030 0x0045 0x0034 0x003C 0x005F 0x0057 0x0087 0x0088
			    0x009F 0x0065 0x0089 0x0089 0x003B 0x0185 0x0013 0xFF80
			    0x0000 0x0200 0x049A 0x0680 0x0E4D 0x17E6 0x281A 0x309A
			    0x3600 0x39B3 0x3D33 0x474D 0x4F80 0x5466 0x589A 0x5D1A
			    0x6400 0x6900 0x0006 0x003D 0x0079 0x05C9 0x055D 0x03BC
			    0x04EB 0x0442 0x02B0 0x02F2 0x01E7 0x01E0 0x019D 0x028A
			    0x01DE 0x01DE 0x045F 0x00A8 0x9FD7 0x0000 0x0000 0x0000>;
	rt,fg_ocv_table1 = <0x0013 0x4A40 0x5500 0x592F 0x5BEF 0x5C19 0x5CD4 0x5E1D
			    0x5FC2 0x60C2 0x61C3 0x6264 0x6350 0x6601 0x688B 0x6982
			    0x6AA2 0x6BD6 0x6CA0 0x706D 0x2B00 0x042F 0x021E 0x002C
			    0x0030 0x0045 0x0034 0x003C 0x005F 0x0057 0x0087 0x0088
			    0x009F 0x0065 0x0089 0x0089 0x003B 0x0185 0x0013 0xFF80
			    0x0000 0x0200 0x049A 0x0680 0x0E4D 0x17E6 0x281A 0x309A
			    0x3600 0x39B3 0x3D33 0x474D 0x4F80 0x5466 0x589A 0x5D1A
			    0x6400 0x6900 0x0006 0x003D 0x0079 0x05C9 0x055D 0x03BC
			    0x04EB 0x0442 0x02B0 0x02F2 0x01E7 0x01E0 0x019D 0x028A
			    0x01DE 0x01DE 0x045F 0x00A8 0x9FD7 0x0000 0x0000 0x0000>;
	rt,fg_ocv_table2 = <0x0013 0x4A40 0x5500 0x592F 0x5BEF 0x5C19 0x5CD4 0x5E1D
			    0x5FC2 0x60C2 0x61C3 0x6264 0x6350 0x6601 0x688B 0x6982
			    0x6AA2 0x6BD6 0x6CA0 0x706D 0x2B00 0x042F 0x021E 0x002C
			    0x0030 0x0045 0x0034 0x003C 0x005F 0x0057 0x0087 0x0088
			    0x009F 0x0065 0x0089 0x0089 0x003B 0x0185 0x0013 0xFF80
			    0x0000 0x0200 0x049A 0x0680 0x0E4D 0x17E6 0x281A 0x309A
			    0x3600 0x39B3 0x3D33 0x474D 0x4F80 0x5466 0x589A 0x5D1A
			    0x6400 0x6900 0x0006 0x003D 0x0079 0x05C9 0x055D 0x03BC
			    0x04EB 0x0442 0x02B0 0x02F2 0x01E7 0x01E0 0x019D 0x028A
			    0x01DE 0x01DE 0x045F 0x00A8 0x9FD7 0x0000 0x0000 0x0000>;
	rt,fg_ocv_table3 = <0x0013 0x4A40 0x5500 0x592F 0x5BEF 0x5C19 0x5CD4 0x5E1D
			    0x5FC2 0x60C2 0x61C3 0x6264 0x6350 0x6601 0x688B 0x6982
			    0x6AA2 0x6BD6 0x6CA0 0x706D 0x2B00 0x042F 0x021E 0x002C
			    0x0030 0x0045 0x0034 0x003C 0x005F 0x0057 0x0087 0x0088
			    0x009F 0x0065 0x0089 0x0089 0x003B 0x0185 0x0013 0xFF80
			    0x0000 0x0200 0x049A 0x0680 0x0E4D 0x17E6 0x281A 0x309A
			    0x3600 0x39B3 0x3D33 0x474D 0x4F80 0x5466 0x589A 0x5D1A
			    0x6400 0x6900 0x0006 0x003D 0x0079 0x05C9 0x055D 0x03BC
			    0x04EB 0x0442 0x02B0 0x02F2 0x01E7 0x01E0 0x019D 0x028A
			    0x01DE 0x01DE 0x045F 0x00A8 0x9FD7 0x0000 0x0000 0x0000>;
	rt,fg_ocv_table4 = <0x0013 0x4A40 0x5500 0x592F 0x5BEF 0x5C19 0x5CD4 0x5E1D
			    0x5FC2 0x60C2 0x61C3 0x6264 0x6350 0x6601 0x688B 0x6982
			    0x6AA2 0x6BD6 0x6CA0 0x706D 0x2B00 0x042F 0x021E 0x002C
			    0x0030 0x0045 0x0034 0x003C 0x005F 0x0057 0x0087 0x0088
			    0x009F 0x0065 0x0089 0x0089 0x003B 0x0185 0x0013 0xFF80
			    0x0000 0x0200 0x049A 0x0680 0x0E4D 0x17E6 0x281A 0x309A
			    0x3600 0x39B3 0x3D33 0x474D 0x4F80 0x5466 0x589A 0x5D1A
			    0x6400 0x6900 0x0006 0x003D 0x0079 0x05C9 0x055D 0x03BC
			    0x04EB 0x0442 0x02B0 0x02F2 0x01E7 0x01E0 0x019D 0x028A
			    0x01DE 0x01DE 0x045F 0x00A8 0x9FD7 0x0000 0x0000 0x0000>;

};

