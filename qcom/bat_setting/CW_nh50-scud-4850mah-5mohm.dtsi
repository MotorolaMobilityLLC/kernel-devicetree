/*
 * Copyright (C) 2021 Motorola Inc.
 *
 * This program is free software; you can redistribute it and/or modify
 * it under the terms of the GNU General Public License version 2 as
 * published by the Free Software Foundation.
 *
 * This program is distributed in the hope that it will be useful,
 * but WITHOUT ANY WARRANTY; without even the implied warranty of
 * MERCHANTABILITY or FITNESS FOR A PARTICULAR PURPOSE.
 * See http://www.gnu.org/licenses/gpl-2.0.html for more details.
 */
nh50-scud-4850mah {
	serialnum = "SB18D69209";
	fcc_design = <4850>;
	ui_full = <99>;
	config_profile_info = [5A 00 00 00 00 00 00 00
				 A9 C0 C7 C5 BA B4 A1 63
				 42 FD D8 A4 8B 77 65 58
				 52 50 4D 77 D9 DE 99 D5
				 C8 C9 D1 D4 D3 D2 CF CB
				 C8 C9 D5 B7 9D 92 8A 83
				 7B 7A 85 94 AA 86 64 73
				 80 00 AB 10 00 A0 73 00
				 00 00 64 21 C3 77 00 00
				 00 00 00 00 00 00 00 6B];
};
