&mmi_charger{
	compatible = "mmi,mmi-charger";
	mmi,enable-charging-limit;
	mmi,upper-limit-capacity = <65>;
	mmi,lower-limit-capacity = <60>;
	mmi,heartbeat-interval = <10000>;
	mmi,dcp-power-max = <10000>;
	mmi,hvdcp-power-max = <18000>;
	mmi,factory-kill-debounce-ms = <3000>;
	mmi,pd-power-max = <30000>;
};

&qti_glink_charger{
	compatible = "mmi,qti-glink-charger";
	mmi,chrg-iterm-ma = <536>;
	mmi,fg-iterm-ma = <586>;
	mmi,max-fv-mv = <4500>;
	mmi,max-fcc-ma = <4000>;
	mmi,demo-fv-mv = <4000>;
	mmi,df-serialnum = "LWNRN55SWD";
	profile-ids-map = "107000", "LWNRN55SWD","38000","ATLRN55NVT";
};


&battery_charger {
	qcom,thermal-mitigation = <5800000 5000000 4500000 4000000 3500000 3000000 2000000 1500000 1000000 500000>;
};
