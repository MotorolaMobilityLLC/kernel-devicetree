&mdss_mdp {
	dsi_ili9883c_hd_plus_120_video: qcom,mdss_dsi_txd_ili9883c_6528_hd_plus_120_video {
		qcom,mdss-dsi-panel-name =
			"mipi_mot_vid_txd_ili9883c_hdp_652_120";
		qcom,mdss-dsi-panel-type = "dsi_video_mode";
		qcom,dsi-ctrl-num = <0>;
		qcom,dsi-phy-num = <0>;
		qcom,mdss-dsi-virtual-channel-id = <0>;
		qcom,mdss-dsi-stream = <0>;
		qcom,mdss-dsi-bpp = <24>;
		qcom,mdss-dsi-border-color = <0>;
		qcom,mdss-dsi-traffic-mode = "burst_mode";
		qcom,mdss-dsi-bllp-power-mode;
		qcom,mdss-dsi-bllp-eof-power-mode;
		qcom,mdss-dsi-lane-0-state;
		qcom,mdss-dsi-lane-1-state;
		qcom,mdss-dsi-lane-2-state;
		qcom,mdss-dsi-lane-3-state;
		qcom,mdss-dsi-dma-trigger = "trigger_sw";
		qcom,mdss-dsi-mdp-trigger = "none";
		qcom,mdss-dsi-lp11-init;
		qcom,mdss-dsi-reset-sequence = <1 10>, <0 10>, <1 10>;
		qcom,mdss-dsi-tx-eot-append;
		qcom,adjust-timer-wakeup-ms = <1>;

		qcom,mdss-pan-physical-width-dimension = <68>;
		qcom,mdss-pan-physical-height-dimension = <151>;

		qcom,mdss-dsi-cabc-mv-command = [15 00 00 00 00 00 02 55 03];
		qcom,mdss-dsi-cabc-mv-command-state =  "dsi_hs_mode";
		qcom,mdss-dsi-cabc-ui-command = [15 00 00 00 00 00 02 55 02];
		qcom,mdss-dsi-cabc-ui-command-state =  "dsi_hs_mode";
		qcom,mdss-dsi-cabc-dis-command = [15 01 00 00 00 00 02 55 00];
		qcom,mdss-dsi-cabc-dis-command-state =  "dsi_hs_mode";

		qcom,mdss-dsi-display-timings {
			timing@0 {
				qcom,mdss-dsi-panel-width = <720>;
				qcom,mdss-dsi-panel-height = <1600>;
				qcom,mdss-dsi-h-front-porch = <26>;
				qcom,mdss-dsi-h-back-porch = <20>;
				qcom,mdss-dsi-h-pulse-width = <8>;
				qcom,mdss-dsi-h-sync-skew = <0>;
				qcom,mdss-dsi-v-back-porch = <30>;
				qcom,mdss-dsi-v-front-porch = <516>;
				qcom,mdss-dsi-v-pulse-width = <2>;
				qcom,mdss-dsi-panel-framerate = <120>;
				qcom,mdss-dsi-on-command = [
				39 00 00 00 00 00 04 FF 98 83 03
				39 00 00 00 00 00 02 8C D2
				39 00 00 00 00 00 02 8D D6
				39 00 00 00 00 00 02 8E DA
				39 00 00 00 00 00 02 8F DE
				39 00 00 00 00 00 02 90 DF
				39 00 00 00 00 00 02 91 E6
				39 00 00 00 00 00 02 92 E9
				39 00 00 00 00 00 02 93 ED
				39 00 00 00 00 00 02 94 F0
				39 00 00 00 00 00 02 95 FF
				39 00 00 00 00 00 02 96 B5
				39 00 00 00 00 00 02 97 BA
				39 00 00 00 00 00 02 98 BF
				39 00 00 00 00 00 02 99 C4
				39 00 00 00 00 00 02 9A C9
				39 00 00 00 00 00 02 9B CD
				39 00 00 00 00 00 02 9C D5
				39 00 00 00 00 00 02 9D E6
				39 00 00 00 00 00 02 9E F6
				39 00 00 00 00 00 02 9F FB
				39 00 00 00 00 00 02 87 4D
				39 00 00 00 00 00 04 FF 98 83 06
				39 00 00 00 00 00 02 06 A4
				39 00 00 00 00 00 02 3E E2
				39 00 00 00 00 00 04 FF 98 83 03
				39 00 00 00 00 00 02 80 04
				39 00 00 00 00 00 02 81 04
				39 00 00 00 00 00 02 82 04
				39 00 00 00 00 00 02 83 B8
				39 00 00 00 00 00 02 84 02
				39 00 00 00 00 00 02 AF 18
				39 00 00 00 00 00 04 ff 98 83 00
				39 00 00 00 00 00 03 51 00 00
				39 00 00 00 00 00 02 35 00
				39 00 00 00 00 00 02 53 2C
				39 00 00 00 00 00 02 55 02
				05 01 00 00 3C 00 01 11
				05 01 00 00 00 00 01 29
				];
				qcom,mdss-dsi-on-command-state = "dsi_lp_mode";
				qcom,mdss-dsi-off-command = [
					39 01 00 00 05 00 04 FF 98 83 00
					05 01 00 00 14 00 01 28
					05 01 00 00 55 00 01 10
				];
				qcom,mdss-dsi-off-command-state = "dsi_lp_mode";
			};
		};
	};
};
