redriver:redriver@30{
	compatible = "parade,ps5169-redriver";
	reg = <0x30>;
	vcc-supply = <&L15B>;
	pinctrl-names = "default";
	pinctrl-0 = <&redriver_enable>;
	redriver,enable-gpio = <&tlmm 22 0x00>;
	redriver,orientation-gpio = <&tlmm 11 0x00>;
	config-seq =
		/* <reg_offset, value, delay_us> */
		<0x9d 0x80 10000
		0x9d 0x00 0
		0x40 0x80 0
		0x8d 0x01 0
		0x90 0x01 0
		0x51 0x87 0
		0x50 0x20 0
		0x54 0x11 0
		0x5d 0x66 0
		0x52 0x50 0
		0x55 0x00 0
		0x56 0x00 0
		0x57 0x00 0
		0x58 0x00 0
		0x59 0x00 0
		0x5a 0x00 0
		0x5b 0x00 0
		0x5e 0x07 0
		0x5f 0x00 0
		0x60 0x00 0
		0x61 0x03 0
		0x65 0x40 0
		0x66 0x00 0
		0x67 0x03 0
		0x75 0x0c 0
		0x77 0x00 0
		0x78 0x7c 0>;
};
