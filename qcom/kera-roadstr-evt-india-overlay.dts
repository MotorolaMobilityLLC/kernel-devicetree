/* Copyright (c) 2025 Motorola Mobility LLC
 *
 * This program is free software; you can redistribute it and/or modify
 * it under the terms of the GNU General Public License version 2 and
 * only version 2 as published by the Free Software Foundation.
 *
 * This program is distributed in the hope that it will be useful,
 * but WITHOUT ANY WARRANTY; without even the implied warranty of
 * MERCHANTABILITY or FITNESS FOR A PARTICULAR PURPOSE.  See the
 * GNU General Public License for more details.
 */

/dts-v1/;
/plugin/;

#include "kera-roadstr-device-common-overlay.dtsi"
#include "kera-roadstr-charger-india-overlay.dtsi"

/ {
	model = "roadstr";
	compatible = "qcom,kera-qrd", "qcom,kera", "qcom,kerap-qrd", "qcom,kerap",
			"qcom,qrd";
	qcom,msm-id = <686 0x10000>, <659 0x10000>;
	qcom,board-id = <0x441 0xA100>;
};

