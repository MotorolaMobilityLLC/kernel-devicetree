// SPDX-License-Identifier: BSD-3-Clause
/*
 * Copyright (c) 2024 Qualcomm Innovation Center, Inc. All rights reserved.
 */

#include "parrot-qrd.dtsi"
#include "parrot-qrd-pm8350b.dtsi"

&usb0 {
	qcom,disable-host-ssphy-powerdown;
};
