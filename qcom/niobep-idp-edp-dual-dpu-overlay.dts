/dts-v1/;
/plugin/;

#include "niobep-idp-edp-dual-dpu.dtsi"

/ {
	model = "Qualcomm Technologies, Inc. NiobeP IDP EDP DUAL DPU";
	compatible = "qcom,niobep-idp", "qcom,niobep", "qcom,idp";
	qcom,msm-id = <652 0x10000>;
	qcom,board-id = <0x10022 4>;
};
