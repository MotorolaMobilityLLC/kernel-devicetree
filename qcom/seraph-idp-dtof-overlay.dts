/dts-v1/;
/plugin/;

#include "seraph-idp.dtsi"

/ {
	model = "Qualcomm Technologies, Inc. Seraph IDP DTOF";
	compatible = "qcom,seraph-idp", "qcom,seraph", "qcom,idp";
	qcom,msm-id = <672 0x10000>;
	qcom,board-id = <0x10022 1>;
};

