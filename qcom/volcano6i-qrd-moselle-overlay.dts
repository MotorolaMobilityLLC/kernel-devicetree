/dts-v1/;
/plugin/;

#include "volcano6i-qrd-moselle.dtsi"

/ {
	model = "Qualcomm Technologies, Inc. Volcano6I QRD +  WCD9378 AMIC + Amoled (SPI) + Moselle";
	compatible = "qcom,volcano-qrd", "qcom,volcano", "qcom,volcanop-qrd", "qcom,volcanop", "qcom,qrd";
	qcom,msm-id = <657 0x10000>, <658 0x10000>;
	qcom,board-id = <11 1>;
};

&pmiv0104_eusb2_repeater {
	status = "ok";
	vdd18-supply = <&L7B>;
	vdd3-supply = <&L17B>;

	qcom,param-override-seq =
		<0xb 0x51
		0x6 0x57>;
};

&eusb2_phy0 {
	dummy-supply = <&pmiv0104_eusb2_repeater>;
	usb-repeater = <&pmiv0104_eusb2_repeater>;
};
