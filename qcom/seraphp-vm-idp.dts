/dts-v1/;

#include "seraphp-vm.dtsi"
#include "seraphp-vm-idp.dtsi"

/ {
	model = "Qualcomm Technologies, Inc. SeraphP SVM IDP";
	compatible = "qcom,seraphp-idp", "qcom,seraphp", "qcom,idp";
	qcom,board-id = <0x10022 0>;
};
