/dts-v1/;

#include "seraph-vm.dtsi"
#include "seraph-vm-idp-dtof.dtsi"

/ {
	model = "Qualcomm Technologies, Inc. Seraph SVM IDP DTOF";
	compatible = "qcom,seraph-idp", "qcom,seraph", "qcom,idp";
	qcom,board-id = <0x10022 1>;
};
