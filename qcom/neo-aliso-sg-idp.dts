/dts-v1/;

#include "neo_la.dtsi"
#include "neo-aliso-sg-idp.dtsi"


/ {
	model = "Qualcomm Technologies, Inc. NEO ALISO SG IDP";
	compatible = "qcom,neo-idp", "qcom,neo", "qcom,idp";
	qcom,board-id = <34 2>;
};
