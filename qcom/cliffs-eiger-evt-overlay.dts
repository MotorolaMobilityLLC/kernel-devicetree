/dts-v1/;
/plugin/;
// This file is copied from: cliffs-arcfox-pvt2-overlay.dts
#include "cliffs-arcfox-device-common-overlay.dtsi"

/ {
	model = "eiger";
	compatible = "qcom,cliffs-mtp", "qcom,cliffs", "qcom,mtp", "qcom,moto";
	qcom,msm-id = <614 0x10000>, <632 0x10000>;
	qcom,board-id = <0x46 0xA000>;
};
