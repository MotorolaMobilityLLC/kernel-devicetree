/dts-v1/;
/plugin/;

#include "volcano-marvel-common-overlay.dtsi"

/ {
	model = "marvel";
	compatible = "qcom,volcano-qrd", "qcom,volcano", "qcom,volcanop-qrd", "qcom,volcanop", "qcom,qrd", "qcom,moto";
	qcom,msm-id = <636 0x10000>, <640 0x10000>, <641 0x10000>, <712 0x10000>;
	qcom,board-id = <0x41 0x9000>;
};
