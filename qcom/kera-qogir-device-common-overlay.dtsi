/* Copyright (c) 2021, The Linux Foundation. All rights reserved.
 *
 * This program is free software; you can redistribute it and/or modify
 * it under the terms of the GNU General Public License version 2 and
 * only version 2 as published by the Free Software Foundation.
 *
 * This program is distributed in the hope that it will be useful,
 * but WITHOUT ANY WARRANTY; without even the implied warranty of
 * MERCHANTABILITY or FITNESS FOR A PARTICULAR PURPOSE.  See the
 * GNU General Public License for more details.
 */

/*
   This file is only for qogir device, na etc.
*/

#include "kera-qogir-products-common-overlay.dtsi"
#include "kera-pmiv0102.dtsi"
#include "kera_ufs3.dtsi"
#include "kera-qogir-st-nfc.dtsi"
#include "kera-qogir-touchscreen-overlay.dtsi"
#include "kera-qogir-haptics-overlay.dtsi"
#include "kera-moto-common-charger.dtsi"
#include "kera-qogir-charger-overlay.dtsi"

&L11B {
    /delete-property/ regulator-always-on;
};
