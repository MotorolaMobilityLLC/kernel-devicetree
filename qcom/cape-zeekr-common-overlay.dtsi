/* Copyright (c) 2022, The Linux Foundation. All rights reserved.
 *
 * This program is free software; you can redistribute it and/or modify
 * it under the terms of the GNU General Public License version 2 and
 * only version 2 as published by the Free Software Foundation.
 *
 * This program is distributed in the hope that it will be useful,
 * but WITHOUT ANY WARRANTY; without even the implied warranty of
 * MERCHANTABILITY or FITNESS FOR A PARTICULAR PURPOSE.  See the
 * GNU General Public License for more details.
 */

/*
   This base is original from "cape-mtp-pm8010-overlay.dts"
*/
#include "cape-moto-common-overlay-base.dtsi"
#include "waipio-pm8010-spmi.dtsi"
#include "cape-moto-common-overlay.dtsi"
#include "waipio-moto-common-charger.dtsi"
#include "cape-zeekr-charger-overlay.dtsi"
#include "cape-zeekr-fingerprint-overlay.dtsi"
#include "cape-zeekr-evb-sensor-overlay.dtsi"

&qupv3_se9_i2c {
        status = "ok";
        qcom,clk-freq-out = <1000000>;
        #address-cells = <1>;
        #size-cells = <0>;
        nq@28 {
                compatible = "qcom,sn-nci";
                reg = <0x28>;
                qcom,sn-irq = <&tlmm 46 0x00>;
                qcom,sn-ven = <&tlmm 34 0x00>;
                qcom,sn-firm = <&tlmm 45 0x00>;
                qcom,sn-clkreq = <&tlmm 35 0x00>;
                qcom,sn-vdd-1p8-supply = <&S10B>;
                qcom,sn-vdd-1p8-voltage = <1800000 1800000>;
                qcom,sn-vdd-1p8-current = <157000>;
                interrupt-parent = <&tlmm>;
                interrupts = <46 0>;
                interrupt-names = "nfc_irq";
                pinctrl-names = "nfc_active", "nfc_suspend";
                pinctrl-0 = <&nfc_int_active &nfc_enable_active>;
                pinctrl-1 = <&nfc_int_suspend &nfc_enable_suspend>;
        };
};

