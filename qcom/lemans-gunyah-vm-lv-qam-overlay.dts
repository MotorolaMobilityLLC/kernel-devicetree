/dts-v1/;
/plugin/;

/ {
	model = "Qualcomm Technologies, Inc. Lemans IVI QAM Gunyah LV VM";
	compatible = "qcom,lemans", "qcom,qam";
	qcom,msm-id = <532 0x10000>, <532 0x20000>;
	qcom,board-id = <0x10025 0x0>;
};
