/dts-v1/;

#include "monaco-vm.dtsi"
#include "monaco-vm-la-mt.dtsi"

/ {
	model = "Qualcomm Technologies, Inc. Monaco Multi LA Virtual Machine";
	compatible = "qcom,monaco", "qcom,quinvm";
	qcom,board-id = <0x0 0x2000001>;
};
