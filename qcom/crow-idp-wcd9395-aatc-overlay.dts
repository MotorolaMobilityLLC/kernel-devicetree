/dts-v1/;
/plugin/;

#include "crow-idp-wcd9395-aatc.dtsi"
#include "crow-idp-pm7550ba.dtsi"

/ {
	model = "Qualcomm Technologies, Inc. Crow IDP + WCD9395 AATC";
	compatible = "qcom,crow-idp", "qcom,crow", "qcom,idp";
	qcom,msm-id = <608 0x10000>;
	qcom,board-id = <34 3>;
};
