&mdss_mdp {
	dsi_icnl9916c_hd_plus_120_video: qcom,mdss_dsi_tm_icnl9916c_6528_fh_plus_120_video {
		qcom,mdss-dsi-panel-name =
			"mipi_mot_vid_tm_icnl9916c_hdp_652_120";
		qcom,mdss-dsi-panel-type = "dsi_video_mode";
		qcom,dsi-ctrl-num = <0>;
		qcom,dsi-phy-num = <0>;
		qcom,mdss-dsi-virtual-channel-id = <0>;
		qcom,mdss-dsi-stream = <0>;
		qcom,mdss-dsi-bpp = <24>;
		qcom,mdss-dsi-border-color = <0>;
		qcom,mdss-dsi-traffic-mode = "burst_mode";
		qcom,mdss-dsi-bllp-power-mode;
		qcom,mdss-dsi-bllp-eof-power-mode;
		qcom,mdss-dsi-lane-0-state;
		qcom,mdss-dsi-lane-1-state;
		qcom,mdss-dsi-lane-2-state;
		qcom,mdss-dsi-lane-3-state;
		qcom,mdss-dsi-dma-trigger = "trigger_sw";
		qcom,mdss-dsi-mdp-trigger = "none";
		qcom,mdss-dsi-lp11-init;
		qcom,mdss-dsi-reset-sequence = <1 10>, <0 10>, <1 10>;
		qcom,mdss-dsi-tx-eot-append;
		qcom,adjust-timer-wakeup-ms = <1>;

		qcom,mdss-pan-physical-width-dimension = <68>;
		qcom,mdss-pan-physical-height-dimension = <151>;
/*
		qcom,mdss-dsi-cabc-mv-command = [
				15 00 00 00 00 00 02 55 03
				39 00 00 00 00 00 03 F0 5A 59
				39 00 00 00 00 00 03 F1 A5 A6
				39 00 00 00 00 00 21 E7 30 00 40 00 01 1F 20 42 1F A0 24 CC 01 00 00 30 18 15 00 A8 FF FF F0 F0 F0 F0 F0 FF F5 F8 FB FF
				39 00 00 00 00 00 21 E8 04 10 24 38 4C 60 74 88 9C B0 C4 D8 98 84 BB BB CD DD EE FF E7 EF F7 FF 87 10 99 FB 5D BF 21 84
				39 00 00 00 00 00 03 F0 A5 A5
				39 01 00 00 00 00 03 F1 5A 5A
				];
		qcom,mdss-dsi-cabc-mv-command-state =  "dsi_hs_mode";
		qcom,mdss-dsi-cabc-ui-command = [
				15 00 00 00 00 00 02 55 03
				39 00 00 00 00 00 03 F0 5A 59
				39 00 00 00 00 00 03 F1 A5 A6
				39 00 00 00 00 00 21 E7 30 00 40 00 01 1F 20 42 1F A0 24 CC 01 00 00 30 18 15 00 A8 F0 F0 F0 F8 F8 F8 F8 FF FC FC FD FF
				39 00 00 00 00 00 21 E8 04 10 24 38 4C 60 74 88 9C B0 C4 D8 98 84 EE EE EE FF FF FF 20 37 4E 66 9C D3 0A 3B 6C 9D CE FF
				39 00 00 00 00 00 03 F0 A5 A5
				39 01 00 00 00 00 03 F1 5A 5A
				];
		qcom,mdss-dsi-cabc-ui-command-state =  "dsi_hs_mode";
		qcom,mdss-dsi-cabc-dis-command = [15 01 00 00 00 00 02 55 00];
		qcom,mdss-dsi-cabc-dis-command-state =  "dsi_hs_mode";
*/
		qcom,mdss-dsi-display-timings {
			timing@0 {
				qcom,mdss-dsi-panel-width = <720>;
				qcom,mdss-dsi-panel-height = <1600>;
				qcom,mdss-dsi-h-front-porch = <28>;
				qcom,mdss-dsi-h-back-porch = <28>;
				qcom,mdss-dsi-h-pulse-width = <4>;
				qcom,mdss-dsi-h-sync-skew = <0>;
				qcom,mdss-dsi-v-back-porch = <32>;
				qcom,mdss-dsi-v-front-porch = <323>;
				qcom,mdss-dsi-v-pulse-width = <4>;
				qcom,mdss-dsi-panel-framerate = <120>;
				qcom,mdss-dsi-on-command = [
				39 01 00 00 00 00 04 f0 99 16 0C
				39 01 00 00 00 00 05 bd a1 0a 52 a6
				39 01 00 00 00 00 04 f0 00 00 00
				39 01 00 00 00 00 03 35 00 00
				39 01 00 00 00 00 03 51 00 00
				39 00 00 00 00 00 03 53 2C 00
				39 01 00 00 78 00 03 11 00 00
				39 01 00 00 0A 00 03 29 00 00
				39 01 00 00 00 00 03 6D 02 00
				];
				qcom,mdss-dsi-on-command-state = "dsi_lp_mode";
				qcom,mdss-dsi-off-command = [
				39 01 00 00 00 00 04 f0 99 16 0C
				39 01 00 00 00 00 05 bd a1 0a 52 ae
				39 01 00 00 00 00 04 f0 00 00 00
				39 01 00 00 00 00 03 6d 25 00
				05 01 00 00 10 00 01 28
				05 01 00 00 78 00 01 10
				];
				qcom,mdss-dsi-off-command-state = "dsi_lp_mode";
			};
		};
	};
};
