/* Copyright (c) 2021, The Linux Foundation. All rights reserved.
 *
 * This program is free software; you can redistribute it and/or modify
 * it under the terms of the GNU General Public License version 2 and
 * only version 2 as published by the Free Software Foundation.
 *
 * This program is distributed in the hope that it will be useful,
 * but WITHOUT ANY WARRANTY; without even the implied warranty of
 * MERCHANTABILITY or FITNESS FOR A PARTICULAR PURPOSE.  See the
 * GNU General Public License for more details.
 */
#include "parrot-moto-common-overlay-base.dtsi"
#include "parrot-moto-common-overlay.dtsi"
#include "parrot-genevn-charger-overlay.dtsi"
#include "parrot-genevn-touchscreen-overlay.dtsi"
#include "parrot-genevn-sensor-overlay.dtsi"

&usb0 {
	qcom,force-adb-enable;
};

&tlmm {
	qcom,gpios-reserved = <0 1 2 3 38 18 19 20 21>;
};
