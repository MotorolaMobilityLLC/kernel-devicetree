&soc {
    wlan_node: qcom,cnss-vendor-wlan-wonder {
        compatible = "qcom,cnss-vendor-wlan-wonder";
        status = "okay";
    };
    wonder_node: wonder-device {
        compatible = "google,wonder-drv-v1";
        // This is important to link vendor lable to wondertap-provider.
        wondertap-provider = <&wlan_node>;
        status = "okay";
    };
};
