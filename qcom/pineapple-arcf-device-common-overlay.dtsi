/* Copyright (c) 2021, The Linux Foundation. All rights reserved.
 *
 * This program is free software; you can redistribute it and/or modify
 * it under the terms of the GNU General Public License version 2 and
 * only version 2 as published by the Free Software Foundation.
 *
 * This program is distributed in the hope that it will be useful,
 * but WITHOUT ANY WARRANTY; without even the implied warranty of
 * MERCHANTABILITY or FITNESS FOR A PARTICULAR PURPOSE.  See the
 * GNU General Public License for more details.
 */

/* This file is only for arcf device */

#include "pineapple-arcf-products-common-overlay.dtsi"
#include "pineapple-moto-common-st-nfc.dtsi"
#include <dt-bindings/clock/qcom,rpmh.h>

&BOB2 {
	regulator-min-microvolt = <2704000>;
	regulator-max-microvolt = <3208000>;
	qcom,init-voltage = <3100000>;
	regulator-boot-on;
};