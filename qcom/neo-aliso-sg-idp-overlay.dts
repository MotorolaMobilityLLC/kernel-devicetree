/dts-v1/;
/plugin/;

#include "neo-aliso-sg-idp.dtsi"

/ {
	model = "Qualcomm Technologies, Inc. NEO IDP";
	compatible = "qcom,neo-idp", "qcom,neo", "qcom,idp";
	qcom,msm-id = <739 0x10000>;
	qcom,board-id = <34 2>;
};
