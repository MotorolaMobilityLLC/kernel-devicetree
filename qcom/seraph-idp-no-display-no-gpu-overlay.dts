/dts-v1/;
/plugin/;

#include "seraph-idp-no-display-no-gpu.dtsi"

/ {
	model = "Qualcomm Technologies, Inc. Seraph IDP NO DISPLAY NO GPU";
	compatible = "qcom,seraph-idp", "qcom,seraph", "qcom,idp";
	qcom,msm-id = <672 0x10000>;
	qcom,board-id = <0x10022 3>;
};
