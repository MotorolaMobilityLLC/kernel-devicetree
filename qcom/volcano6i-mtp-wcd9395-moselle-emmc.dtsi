#include "volcano6i-mtp-wcd9395-moselle.dtsi"

&ufsphy_mem {
	status = "disabled";
};

&ufshc_mem {
	status = "disabled";
};

&L12B {
	regulator-min-microvolt = <2952000>;
	regulator-max-microvolt = <2952000>;
};

&sdhc_1 {
	status = "ok";

	vdd-supply = <&L12B>;
	qcom,vdd-voltage-level = <2952000 2952000>;
	qcom,vdd-current-level = <0 570000>;

	vdd-io-supply = <&L4F>;
	qcom,vdd-io-voltage-level = <1800000 1800000>;
	qcom,vdd-io-current-level = <0 325000>;

	qcom,vdd-io-always-on;

	pinctrl-names = "default", "sleep";
	pinctrl-0 = <&sdc1_on>;
	pinctrl-1 = <&sdc1_off>;
};

