/* Copyright (c) 2021, The Linux Foundation. All rights reserved.
 *
 * This program is free software; you can redistribute it and/or modify
 * it under the terms of the GNU General Public License version 2 and
 * only version 2 as published by the Free Software Foundation.
 *
 * This program is distributed in the hope that it will be useful,
 * but WITHOUT ANY WARRANTY; without even the implied warranty of
 * MERCHANTABILITY or FITNESS FOR A PARTICULAR PURPOSE.  See the
 * GNU General Public License for more details.
 */

/* This file is only for malmo device */

#include "blair-malmo-products-common-overlay.dtsi"
#include "blair-pm6125-malmo-common-overlay.dtsi"
#include "blair-malmo-vibrator-overlay.dtsi"
#include "blair-malmo-fps-overlay.dtsi"

&sdhc_2 {
        status = "ok";

        cd-gpios = <&tlmm 94 GPIO_ACTIVE_HIGH>;
};
