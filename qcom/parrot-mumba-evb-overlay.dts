/dts-v1/;
/plugin/;

#include "parrot-mumba-common-overlay.dtsi"

/ {
	model = "mumba";
	compatible = "qcom,parrot-qrd", "qcom,parrot", "qcom,qrd", "moto,mumba";
	qcom,msm-id = <663 0x10000>, <715 0x10000>;
	qcom,board-id = <0x41 0x9000>;
};

&qti_glink_charger {
	mmi,df-serialnum = "ATLSF70NVT";
	profile-ids-map = "107000", "ATLSF70NVT","38000","COSSF70COS";
};