&mmi_charger {
	mmi,pd-power-max = <30000>;
	mmi,dcp-power-max = <7500>;
	mmi,upper-limit-capacity = <75>;
};

&battery_charger {
	qcom,thermal-mitigation = <4675000 4000000 3500000 3000000 2500000 2000000 1000000 500000 100000>;
	qcom,wireless-fw-name = "cps4038.bin";
};

&qti_glink_charger {
	mmi,shutdown-empty-vbat-mv = <3000>;
};

&bm_adsp_ulog {
	categories = /bits/ 64 <0x1FFFBFFFFF>;
};
