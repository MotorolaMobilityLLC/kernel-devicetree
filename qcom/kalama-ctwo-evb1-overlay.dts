/* Copyright (c) 2021, The Linux Foundation. All rights reserved.
 *
 * This program is free software; you can redistribute it and/or modify
 * it under the terms of the GNU General Public License version 2 and
 * only version 2 as published by the Free Software Foundation.
 *
 * This program is distributed in the hope that it will be useful,
 * but WITHOUT ANY WARRANTY; without even the implied warranty of
 * MERCHANTABILITY or FITNESS FOR A PARTICULAR PURPOSE.  See the
 * GNU General Public License for more details.
 */

/* This is derivated from Qcom kalama-mtp-overlay.dts */

/dts-v1/;
/plugin/;

#include "kalama-ctwo-device-common-overlay.dtsi"

/ {
	model = "ctwo";
	compatible = "qcom,kalama-mtp", "qcom,kalama", "qcom,mtp", "qcom,ctwo";
	qcom,msm-id = <519 0x10000>, <536 0x10000>, <519 0x20000>, <536 0x20000>;
	qcom,board-id = <0x4b 0x9000>;
};
