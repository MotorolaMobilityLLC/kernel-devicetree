// SPDX-License-Identifier: BSD-3-Clause
/*
 * Copyright (c) 2025 Motorola Mobility LLC. All rights reserved.
 */

/dts-v1/;
/plugin/;

#include "alor-eletre-products-common-overlay.dtsi"

/ {
	model = "eletre";
	compatible = "qcom,alor-qrd", "qcom,alor", "qcom,qrd";
	qcom,msm-id = <685 0x10000>;
	qcom,board-id = <0x4A 0x9000>;
};
