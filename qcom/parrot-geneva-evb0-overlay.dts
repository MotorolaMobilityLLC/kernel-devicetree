/dts-v1/;
/plugin/;

#include "parrot-geneva-common-overlay.dtsi"

/ {
	model = "geneva";
	compatible = "qcom,parrot-qrd", "qcom,parrot", "moto,parrot", "moto,geneva";
	qcom,msm-id = <537 0x10000>;
	qcom,board-id = <0x43 0x9000>, <0x41 0x9000>;
	qcom,pmic-id-size = <9>;
	qcom,pmic-id = <0x0 0x0 0x0 0x0 0x0 0x0 0x0 0x0 0x0>;
};
