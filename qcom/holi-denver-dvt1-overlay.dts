/* Copyright (c) 2020, The Linux Foundation. All rights reserved.
 *
 * This program is free software; you can redistribute it and/or modify
 * it under the terms of the GNU General Public License version 2 and
 * only version 2 as published by the Free Software Foundation.
 *
 * This program is distributed in the hope that it will be useful,
 * but WITHOUT ANY WARRANTY; without even the implied warranty of
 * MERCHANTABILITY or FITNESS FOR A PARTICULAR PURPOSE.  See the
 * GNU General Public License for more details.
 */

/dts-v1/;
/plugin/;

#include "holi-denver-common-overlay.dtsi"

/ {
	model = "denver";
	compatible = "qcom,holi-denver", "qcom,holi-moto", "qcom,holi";
	qcom,msm-id = <454 0x10000>, <472 0x10000>;
	qcom,board-id = <0x42 0xB100>;
};

&dsi_nt36675_boe_video {
	qcom,mdss-dsi-display-timings {
		timing@0 {
				qcom,mdss-dsi-on-command =
				[
					15 00 00 00 00 00 02 FF 10
					15 00 00 00 00 00 02 FB 01
					15 00 00 00 00 00 02 FB 01
					15 00 00 00 00 00 02 B0 00
					15 00 00 00 00 00 02 FF 20
					15 00 00 00 00 00 02 FB 01
					15 00 00 00 00 00 02 FB 01
					15 00 00 00 00 00 02 07 3C
					15 00 00 00 00 00 02 69 92
					15 00 00 00 00 00 02 88 FF
					15 00 00 00 00 00 02 89 13
					15 00 00 00 00 00 02 8A 13
					15 00 00 00 00 00 02 8B 13
					15 00 00 00 00 00 02 8C 13
					15 00 00 00 00 00 02 8D 13
					15 00 00 00 00 00 02 8E 13
					15 00 00 00 00 00 02 8F 13
					15 00 00 00 00 00 02 90 13
					15 00 00 00 00 00 02 95 D1
					15 00 00 00 00 00 02 96 D1
					15 00 00 00 00 00 02 F2 54
					15 00 00 00 00 00 02 F4 54
					15 00 00 00 00 00 02 F6 54
					15 00 00 00 00 00 02 F8 54
					15 00 00 00 00 00 02 FF 24
					15 00 00 00 00 00 02 FB 01
					15 00 00 00 00 00 02 FB 01
					15 00 00 00 00 00 02 00 A3
					15 00 00 00 00 00 02 01 A3
					15 00 00 00 00 00 02 02 00
					15 00 00 00 00 00 02 03 22
					15 00 00 00 00 00 02 04 0F
					15 00 00 00 00 00 02 05 0F
					15 00 00 00 00 00 02 06 28
					15 00 00 00 00 00 02 07 17
					15 00 00 00 00 00 02 08 27
					15 00 00 00 00 00 02 09 15
					15 00 00 00 00 00 02 0A 26
					15 00 00 00 00 00 02 0B 13
					15 00 00 00 00 00 02 10 03
					15 00 00 00 00 00 02 11 04
					15 00 00 00 00 00 02 12 1C
					15 00 00 00 00 00 02 13 24
					15 00 00 00 00 00 02 14 24
					15 00 00 00 00 00 02 15 0B
					15 00 00 00 00 00 02 16 0C
					15 00 00 00 00 00 02 17 01
					15 00 00 00 00 00 02 18 A3
					15 00 00 00 00 00 02 19 A3
					15 00 00 00 00 00 02 1A 00
					15 00 00 00 00 00 02 1B 22
					15 00 00 00 00 00 02 1C 0F
					15 00 00 00 00 00 02 1D 0F
					15 00 00 00 00 00 02 1E 28
					15 00 00 00 00 00 02 1F 17
					15 00 00 00 00 00 02 20 27
					15 00 00 00 00 00 02 21 15
					15 00 00 00 00 00 02 22 26
					15 00 00 00 00 00 02 23 13
					15 00 00 00 00 00 02 28 03
					15 00 00 00 00 00 02 29 04
					15 00 00 00 00 00 02 2A 1C
					15 00 00 00 00 00 02 2B 24
					15 00 00 00 00 00 02 2D 24
					15 00 00 00 00 00 02 2F 0B
					15 00 00 00 00 00 02 30 0C
					15 00 00 00 00 00 02 31 01
					15 00 00 00 00 00 02 32 09
					15 00 00 00 00 00 02 33 02
					15 00 00 00 00 00 02 34 00
					15 00 00 00 00 00 02 35 01
					15 00 00 00 00 00 02 36 01
					15 00 00 00 00 00 02 37 2A
					15 00 00 00 00 00 02 38 09
					15 00 00 00 00 00 02 45 02
					15 00 00 00 00 00 02 46 03
					15 00 00 00 00 00 02 47 02
					15 00 00 00 00 00 02 48 03
					15 00 00 00 00 00 02 49 0A
					15 00 00 00 00 00 02 4A 05
					15 00 00 00 00 00 02 4B 49
					15 00 00 00 00 00 02 4E 70
					15 00 00 00 00 00 02 4F 70
					15 00 00 00 00 00 02 50 05
					15 00 00 00 00 00 02 53 70
					15 00 00 00 00 00 02 7B 8E
					15 00 00 00 00 00 02 7D 04
					15 00 00 00 00 00 02 80 04
					15 00 00 00 00 00 02 81 04
					15 00 00 00 00 00 02 82 16
					15 00 00 00 00 00 02 83 34
					15 00 00 00 00 00 02 84 52
					15 00 00 00 00 00 02 85 25
					15 00 00 00 00 00 02 86 43
					15 00 00 00 00 00 02 87 61
					15 00 00 00 00 00 02 90 25
					15 00 00 00 00 00 02 91 43
					15 00 00 00 00 00 02 92 61
					15 00 00 00 00 00 02 93 16
					15 00 00 00 00 00 02 94 34
					15 00 00 00 00 00 02 95 52
					15 00 00 00 00 00 02 9C F4
					15 00 00 00 00 00 02 9D 01
					15 00 00 00 00 00 02 A0 0E
					15 00 00 00 00 00 02 A2 0E
					15 00 00 00 00 00 02 A4 04
					15 00 00 00 00 00 02 A5 04
					15 00 00 00 00 00 02 AA 05
					15 00 00 00 00 00 02 AD 02
					15 00 00 00 00 00 02 B0 0B
					15 00 00 00 00 00 02 B3 08
					15 00 00 00 00 00 02 B6 11
					15 00 00 00 00 00 02 B9 0E
					15 00 00 00 00 00 02 BC 17
					15 00 00 00 00 00 02 BF 14
					15 00 00 00 00 00 02 C4 C0
					15 00 00 00 00 00 02 CA C9
					15 00 00 00 00 00 02 D9 80
					15 00 00 00 00 00 02 E5 06
					15 00 00 00 00 00 02 E6 80
					15 00 00 00 00 00 02 ED C0
					15 00 00 00 00 00 02 FF 25
					15 00 00 00 00 00 02 FB 01
					15 00 00 00 00 00 02 FB 01
					15 00 00 00 00 00 02 66 D8
					15 00 00 00 00 00 02 67 01
					15 00 00 00 00 00 02 68 58
					15 00 00 00 00 00 02 69 10
					15 00 00 00 00 00 02 6B 00
					15 00 00 00 00 00 02 6C 15
					15 00 00 00 00 00 02 71 1D
					15 00 00 00 00 00 02 77 72
					15 00 00 00 00 00 02 7E 15
					15 00 00 00 00 00 02 7F 00
					15 00 00 00 00 00 02 8D 00
					15 00 00 00 00 00 02 C0 5D
					15 00 00 00 00 00 02 C1 11
					15 00 00 00 00 00 02 C3 00
					15 00 00 00 00 00 02 C4 01
					15 00 00 00 00 00 02 C5 01
					15 00 00 00 00 00 02 EF 00
					15 00 00 00 00 00 02 F0 00
					15 00 00 00 00 00 02 F1 04
					15 00 00 00 00 00 02 FF 26
					15 00 00 00 00 00 02 FB 01
					15 00 00 00 00 00 02 FB 01
					15 00 00 00 00 00 02 00 00
					15 00 00 00 00 00 02 01 F2
					15 00 00 00 00 00 02 02 F2
					15 00 00 00 00 00 02 03 01
					15 00 00 00 00 00 02 04 F2
					15 00 00 00 00 00 02 05 08
					15 00 00 00 00 00 02 06 1F
					15 00 00 00 00 00 02 07 1F
					15 00 00 00 00 00 02 08 1F
					15 00 00 00 00 00 02 74 AF
					15 00 00 00 00 00 02 81 0E
					15 00 00 00 00 00 02 83 04
					15 00 00 00 00 00 02 84 03
					15 00 00 00 00 00 02 85 01
					15 00 00 00 00 00 02 86 03
					15 00 00 00 00 00 02 87 01
					15 00 00 00 00 00 02 88 0A
					15 00 00 00 00 00 02 8A 1A
					15 00 00 00 00 00 02 8C 54
					15 00 00 00 00 00 02 8D 27
					15 00 00 00 00 00 02 8E 63
					15 00 00 00 00 00 02 8F 36
					15 00 00 00 00 00 02 90 72
					15 00 00 00 00 00 02 91 45
					15 00 00 00 00 00 02 9A 80
					15 00 00 00 00 00 02 9B 04
					15 00 00 00 00 00 02 9C 00
					15 00 00 00 00 00 02 9D 00
					15 00 00 00 00 00 02 9E 00
					15 00 00 00 00 00 02 FF 27
					15 00 00 00 00 00 02 FB 01
					15 00 00 00 00 00 02 FB 01
					15 00 00 00 00 00 02 01 60
					15 00 00 00 00 00 02 20 80
					15 00 00 00 00 00 02 21 95
					15 00 00 00 00 00 02 25 81
					15 00 00 00 00 00 02 26 DF
					15 00 00 00 00 00 02 88 02
					15 00 00 00 00 00 02 8A 0A
					15 00 00 00 00 00 02 F9 00
					15 00 00 00 00 00 02 FF 2A
					15 00 00 00 00 00 02 FB 01
					15 00 00 00 00 00 02 FB 01
					15 00 00 00 00 00 02 07 32
					15 00 00 00 00 00 02 0A 40
					15 00 00 00 00 00 02 0C 0E
					15 00 00 00 00 00 02 0E 03
					15 00 00 00 00 00 02 11 9F
					15 00 00 00 00 00 02 15 0F
					15 00 00 00 00 00 02 16 2E
					15 00 00 00 00 00 02 19 0F
					15 00 00 00 00 00 02 1A 01
					15 00 00 00 00 00 02 1B 11
					15 00 00 00 00 00 02 1D 12
					15 00 00 00 00 00 02 1E 79
					15 00 00 00 00 00 02 1F 79
					15 00 00 00 00 00 02 20 79
					15 00 00 00 00 00 02 2D 01
					15 00 00 00 00 00 02 33 0B
					15 00 00 00 00 00 02 34 28
					15 00 00 00 00 00 02 36 09
					15 00 00 00 00 00 02 37 28
					15 00 00 00 00 00 02 45 F0
					15 00 00 00 00 00 02 75 A0
					15 00 00 00 00 00 02 A5 78
					15 00 00 00 00 00 02 D8 40
					15 00 00 00 00 00 02 EE 01
					15 00 00 00 00 00 02 F0 A8
					15 00 00 00 00 00 02 FF F0
					15 00 00 00 00 00 02 FB 01
					15 00 00 00 00 00 02 BB 40
					15 00 00 00 00 00 02 FF 20
					15 00 00 00 00 00 02 FB 01
					39 00 00 00 00 00 11 B0 00 08 00 2B 00 5A 00 7D 00 9B 00 B4 00 CA 00 DE
					39 00 00 00 00 00 11 B1 00 F0 01 2A 01 53 01 95 01 C3 02 0D 02 42 02 44
					39 00 00 00 00 00 11 B2 02 79 02 B4 02 DE 03 0E 03 32 03 58 03 68 03 77
					39 00 00 00 00 00 0F B3 03 89 03 9F 03 B7 03 CD 03 DA 03 DC 00 00
					39 00 00 00 00 00 11 B4 00 08 00 2B 00 5A 00 7D 00 9B 00 B4 00 CA 00 DE
					39 00 00 00 00 00 11 B5 00 F0 01 2A 01 53 01 95 01 C3 02 0D 02 42 02 44
					39 00 00 00 00 00 11 B6 02 79 02 B4 02 DE 03 0E 03 32 03 58 03 68 03 77
					39 00 00 00 00 00 0F B7 03 89 03 9F 03 B7 03 CD 03 DA 03 DC 00 00
					39 00 00 00 00 00 11 B8 00 08 00 2B 00 5A 00 7D 00 9B 00 B4 00 CA 00 DE
					39 00 00 00 00 00 11 B9 00 F0 01 2A 01 53 01 95 01 C3 02 0D 02 42 02 44
					39 00 00 00 00 00 11 BA 02 79 02 B4 02 DE 03 0E 03 32 03 58 03 68 03 77
					39 00 00 00 00 00 0F BB 03 89 03 9F 03 B7 03 CD 03 DA 03 DC 00 00
					15 00 00 00 00 00 02 FF 21
					15 00 00 00 00 00 02 FB 01
					39 00 00 00 00 00 11 B0 00 00 00 23 00 52 00 75 00 93 00 AC 00 C2 00 D6
					39 00 00 00 00 00 11 B1 00 E8 01 22 01 4B 01 8D 01 BB 02 05 02 3A 02 3C
					39 00 00 00 00 00 11 B2 02 71 02 AC 02 D6 03 06 03 2A 03 50 03 60 03 6F
					39 00 00 00 00 00 0F B3 03 81 03 97 03 AF 03 C5 03 D2 03 D4 00 00
					39 00 00 00 00 00 11 B4 00 00 00 23 00 52 00 75 00 93 00 AC 00 C2 00 D6
					39 00 00 00 00 00 11 B5 00 E8 01 22 01 4B 01 8D 01 BB 02 05 02 3A 02 3C
					39 00 00 00 00 00 11 B6 02 71 02 AC 02 D6 03 06 03 2A 03 50 03 60 03 6F
					39 00 00 00 00 00 0F B7 03 81 03 97 03 AF 03 C5 03 D2 03 D4 00 00
					39 00 00 00 00 00 11 B8 00 00 00 23 00 52 00 75 00 93 00 AC 00 C2 00 D6
					39 00 00 00 00 00 11 B9 00 E8 01 22 01 4B 01 8D 01 BB 02 05 02 3A 02 3C
					39 00 00 00 00 00 11 BA 02 71 02 AC 02 D6 03 06 03 2A 03 50 03 60 03 6F
					39 00 00 00 00 00 0F BB 03 81 03 97 03 AF 03 C5 03 D2 03 D4 00 00
					15 00 00 00 00 00 02 FF 23
					15 00 00 00 00 00 02 FB 01
					15 00 00 00 00 00 02 00 80
					15 00 00 00 00 00 02 07 00
					15 00 00 00 00 00 02 08 01
					15 00 00 00 00 00 02 09 55
					15 00 00 00 00 00 02 FF 10
					15 00 00 00 00 00 02 FB 01
					39 00 00 00 00 00 03 51 0C CC
					15 00 00 00 00 00 02 53 2C
					15 00 00 00 00 00 02 55 01
					05 01 00 00 78 00 01 11
					05 01 00 00 14 00 01 29
				];
		};
	};
};

