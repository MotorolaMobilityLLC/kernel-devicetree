/dts-v1/;
/plugin/;

#include "neo-aliso-sg-atp.dtsi"

/ {
	model = "Qualcomm Technologies, Inc. NEO ATP";
	compatible = "qcom,neo-atp", "qcom,neo", "qcom,atp";
	qcom,msm-id = <739 0x10000>;
	qcom,board-id = <33 1>;
};
