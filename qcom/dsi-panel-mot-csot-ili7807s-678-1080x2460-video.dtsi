&mdss_mdp {
	dsi_csot_ili7807s_678_fhd_video: qcom,mdss_dsi_csot_ili7807s_678_fhd_video {
		qcom,mdss-dsi-panel-name =
				"mipi_mot_vid_csot_ili7807s_fhd_678";
		qcom,mdss-dsi-panel-type = "dsi_video_mode";

		qcom,dsi-ctrl-num = <0>;
		qcom,dsi-phy-num = <0>;
		qcom,mdss-dsi-virtual-channel-id = <0>;
		qcom,mdss-dsi-stream = <0>;
		qcom,mdss-dsi-bpp = <24>;
		qcom,mdss-dsi-color-order = "rgb_swap_rgb";
		qcom,mdss-dsi-underflow-color = <0xfff>;
		qcom,mdss-dsi-border-color = <0>;
		qcom,mdss-dsi-h-sync-pulse = <0>;
		qcom,mdss-dsi-traffic-mode = "non_burst_sync_event";
		qcom,mdss-dsi-lane-map = "lane_map_0123";
		qcom,mdss-dsi-bllp-eof-power-mode;
		qcom,mdss-dsi-bllp-power-mode;
		qcom,mdss-dsi-tx-eot-append;
		qcom,mdss-dsi-lane-0-state;
		qcom,mdss-dsi-lane-1-state;
		qcom,mdss-dsi-lane-2-state;
		qcom,mdss-dsi-lane-3-state;
		qcom,mdss-dsi-dma-trigger = "trigger_sw";
		qcom,mdss-dsi-mdp-trigger = "none";
		qcom,mdss-dsi-lp11-init;
		qcom,mdss-dsi-reset-sequence = <1 4>, <0 1>, <1 12>;
		qcom,mdss-pan-physical-width-dimension = <69>;
		qcom,mdss-pan-physical-height-dimension = <158>;

		qcom,mdss-dsi-cabc-mv-command = [15 01 00 00 00 00 02 55 03];
		qcom,mdss-dsi-cabc-mv-command-state =  "dsi_hs_mode";
		qcom,mdss-dsi-cabc-ui-command = [15 01 00 00 00 00 02 55 01];
		qcom,mdss-dsi-cabc-ui-command-state =  "dsi_hs_mode";
		qcom,mdss-dsi-cabc-dis-command = [15 01 00 00 00 00 02 55 00];
		qcom,mdss-dsi-cabc-dis-command-state =  "dsi_hs_mode";

		qcom,mdss-dsi-display-timings {
			timing@0 {
			qcom,mdss-dsi-panel-width = <1080>;
			qcom,mdss-dsi-panel-height = <2460>;
			qcom,mdss-dsi-h-front-porch = <20>;
			qcom,mdss-dsi-h-back-porch = <24>;
			qcom,mdss-dsi-h-pulse-width = <4>;
			qcom,mdss-dsi-h-sync-skew = <0>;
			qcom,mdss-dsi-h-sync-pulse = <0>;
			qcom,mdss-dsi-v-back-porch = <84>;
			qcom,mdss-dsi-v-front-porch = <2588>;
			qcom,mdss-dsi-v-pulse-width = <2>;
			qcom,mdss-dsi-panel-framerate = <60>;
			qcom,mdss-dsi-h-left-border = <0>;
			qcom,mdss-dsi-h-right-border = <0>;
			qcom,mdss-dsi-v-top-border = <0>;
			qcom,mdss-dsi-v-bottom-border = <0>;
			qcom,mdss-dsi-on-command =
			[
				39 01 00 00 00 00 04 FF 78 07 06
				15 01 00 00 00 00 02 3E E2
				15 01 00 00 00 00 02 80 00
				39 01 00 00 00 00 04 FF 78 07 08
				39 01 00 00 00 00 03 FD 00 9F
				15 01 00 00 00 00 02 E1 D7
				39 01 00 00 00 00 03 FD 00 00
				39 01 00 00 00 00 04 FF 78 07 00
				15 01 00 00 00 00 02 53 2C
				15 01 00 00 00 00 02 55 01
				39 01 00 00 00 00 04 FF 78 07 03
				15 01 00 00 00 00 02 83 C8
				15 01 00 00 00 00 02 84 04
				39 01 00 00 00 00 04 FF 78 07 06
				15 01 00 00 00 00 02 08 20
				39 01 00 00 00 00 04 FF 78 07 17
				39 01 00 00 00 00 86 20 00 00 00 00 00 11 00 00 89 30 80 09 9c 04 38 00 0a 02 1c 02 1c 02 00 02 0e 00 20 00 ed 00 07 00 0c 0a ab 0a 2c 18 00 10 f0 03 0c 20 00 06 0b 0b 33 0e 1c 2a 38 46 54 62 69 70 77 79 7b 7d 7e 01 02 01 00 09 40 09 be 19 fc 19 fa 19 f8 1a 38 1a 78 1a b6 2a f6 2b 34 2b 74 3b 74 6b f4 00 00 00 00 00 00 00 00 00 00 00 00 00 00 00 00 00 00 00 00 00 00 00 00 00 00 00 00 00 00 00 00 00 00 00 00 00 00 00 00
				39 01 00 00 00 00 04 FF 78 07 00
				05 01 00 00 78 00 01 11
				05 01 00 00 14 00 01 29
			];
			qcom,mdss-dsi-off-command = [
				05 01 00 00 32 00 01 28
				05 01 00 00 96 00 01 10
			];
			qcom,mdss-dsi-on-command-state = "dsi_lp_mode";
			qcom,mdss-dsi-off-command-state = "dsi_hs_mode";

			qcom,compression-mode = "dsc";
			qcom,mdss-dsc-slice-height = <10>;
			qcom,mdss-dsc-slice-width = <540>;
			qcom,mdss-dsc-slice-per-pkt = <2>;
			qcom,mdss-dsc-bit-per-component = <8>;
			qcom,mdss-dsc-bit-per-pixel = <8>;
			qcom,mdss-dsc-block-prediction-enable;

			};
		};

	};
};
