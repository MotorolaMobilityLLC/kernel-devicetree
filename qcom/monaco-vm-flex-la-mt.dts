/dts-v1/;

#include "monaco-vm.dtsi"
#include "monaco-vm-flex-la-mt.dtsi"

/ {
	model = "Qualcomm Technologies, Inc. Monaco Flex Multi LA Virtual Machine";
	qcom,msm-name = "SA_MONACO_FLEX_IVI";
	compatible = "qcom,monaco", "qcom,quinvm";
	qcom,msm-id = <695 0x10000>;
	qcom,board-id = <0x0 0x2000001>;
};
