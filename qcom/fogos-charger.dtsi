
#include <dt-bindings/iio/qti_power_supply_iio.h>


&mot_batterydata {
	df-serialnum = "SB18D96852";
	qcom,batt-id-range-pct = <15>;
	#include "qg-batterydata-qf50-atl-5000mah.dtsi"
	#include "qg-batterydata-qf50-scud-5000mah.dtsi"
	#include "qg-batterydata-qf50-swd-5000mah.dtsi"
};

&pm7250b_charger {
	#io-channel-cells = <1>;
	io-channels = <&pm7250b_vadc ADC5_USB_IN_V_16>,
		      <&pm7250b_vadc ADC5_USB_IN_I>,
		      <&pm7250b_vadc ADC5_CHG_TEMP>,
		      <&pm7250b_vadc ADC5_DIE_TEMP>,
		      <&pm7250b_vadc ADC5_AMUX_THM3_100K_PU>,
		      <&pm7250b_vadc ADC5_SBUx>,
		      <&pm7250b_vadc ADC5_VPH_PWR>,
		      <&pm7250b_vadc ADC5_AMUX_THM1_100K_PU>,
		      <&pm7250b_qg PSY_IIO_RESISTANCE_ID>,
		      <&pm7250b_qg PSY_IIO_VOLTAGE_NOW>,
		      <&pm7250b_qg PSY_IIO_TEMP>,
		      <&pm7250b_qg PSY_IIO_CAPACITY>,
		      <&pm7250b_qg PSY_IIO_VOLTAGE_OCV>,
		      <&pm7250b_qg PSY_IIO_VOLTAGE_AVG>,
		      <&pm7250b_qg PSY_IIO_DEBUG_BATTERY>,
		      <&pm7250b_qg PSY_IIO_REAL_CAPACITY>,
		      <&pm7250b_qg PSY_IIO_CC_SOC>,
		      <&pm7250b_qg PSY_IIO_CURRENT_NOW>,
		      <&pm7250b_qg PSY_IIO_VOLTAGE_MAX>,
		      <&pm7250b_qg PSY_IIO_CHARGE_FULL>,
		      <&pm7250b_qg PSY_IIO_CHARGE_COUNTER>,
		      <&pm7250b_qg PSY_IIO_CYCLE_COUNT>,
		      <&pm7250b_qg PSY_IIO_CHARGE_FULL_DESIGN>,
		      <&pm7250b_qg PSY_IIO_TIME_TO_FULL_NOW>;
	io-channel-names = "usb_in_voltage",
			   "usb_in_current",
			   "chg_temp",
			   "die_temp",
			   "conn_temp",
			   "sbux_res",
			   "vph_voltage",
			   "skin_temp",
			   "resistance_id",
			   "voltage_now",
			   "temp",
			   "capacity",
			   "voltage_ocv",
			   "voltage_avg",
			   "debug_battery",
			   "real_capacity",
			   "cc_soc",
			   "current_now",
			   "voltage_max",
			   "charge_full",
			   "charge_counter",
			   "cycle_count",
			   "charge_full_design",
			   "time_to_full_now";
	qcom,fcc-max-ua = <4000000>;
	qcom,fv-max-uv = <4530000>;
	qcom,dcp-curr-max = <2000000>;
	qcom,otg-cl-ua = <1500000>;
	qcom,thermal-mitigation = <4000000 3500000
			3000000 2500000
			2000000 1500000
			1200000 900000
			600000>;
	/delete-property/ qcom,fcc-stepping-enable;
	qcom,lpd-disable;

};

&pm7250b_mmi {
	/delete-property/ qcom,force-hvdcp-5v;
	qcom,mmi-temp-zones = <0 4200 1000 0>,
				<10 4250 3000 1000>,
				<15 0 3000 3000>,
				<25 0 4000 4000>,
				<35 0 4000 4000>,
				<45 0 4000 4000>,
				<60 4200 4000 0>;
	qcom,mmi-ffc-zones = <4200 243 407>,
                               <4500 243 407>,
                               <4500 243 407>,
                               <4530 523 659>,
                               <4530 590 751>,
                               <4530 871 1035>,
                               <4200 243 407>;

	qcom,iterm-ma = <243>;
	qcom,hvdcp-power-max = <18000>;
	//mmi,hvdcp2-force-9v;
	qcom,hvdcp2-max-icl-ua = <2000000>;
	mmi,enable-factory-mode-aicl;
	qcom,noffc-chg-iterm = <243>;
	qcom,noffc-chg-iterm-45c = <487>;
	qcom,noffc-qg-iterm = <407>;
	qcom,noffc-qg-iterm-45c = <642>;
	qcom,noffc-max-fv = <4500>;
	mmi,enable-dcp-ffc;

};

&pm7250b_qg {
	#io-channel-cells = <1>;
	io-channels = <&pm7250b_vadc ADC5_BAT_THERM_100K_PU>,
		      <&pm7250b_vadc ADC5_BAT_ID_100K_PU>,
		      <&pm7250b_charger PSY_IIO_INPUT_CURRENT_LIMITED>,
		      <&pm7250b_charger PSY_IIO_RECHARGE_SOC>,
		      <&pm7250b_charger PSY_IIO_FORCE_RECHARGE>,
		      <&pm7250b_charger PSY_IIO_CHARGE_DONE>;
	io-channel-names = "batt-therm",
			   "batt-id",
			   "input_current_limited",
			   "recharge_soc",
			   "force_recharge",
			   "charge_done";
	qcom,qg-iterm-ma = <407>;
};

