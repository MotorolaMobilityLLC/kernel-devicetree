/dts-v1/;
/plugin/;

#include "parrot-genevn-common-overlay.dtsi"

/ {
	model = "genevn";
	compatible = "qcom,parrot-qrd", "qcom,parrot", "qcom,qrd", "moto,genevn";
	qcom,msm-id = <537 0x10000>;
	qcom,board-id = <0x41 0xB100>;
	qcom,pmic-id-size = <9>;
	qcom,pmic-id = <0x0 0x0 0x0 0x0 0x0 0x0 0x0 0x0 0x0>;
};
