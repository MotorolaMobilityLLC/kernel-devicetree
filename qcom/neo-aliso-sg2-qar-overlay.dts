/dts-v1/;
/plugin/;

#include "neo-aliso-sg2-qar.dtsi"

/ {
	model = "Qualcomm Technologies, Inc. NEO SG2 QAR Aliso";
	compatible = "qcom,neo";
	qcom,msm-id = <740 0x10000>;
	qcom,board-id = <44 1>;
};
