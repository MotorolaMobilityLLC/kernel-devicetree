/dts-v1/;
/plugin/;

#include "waipio-mtp.dtsi"

/ {
	model = "Qualcomm Technologies, Inc. Waipio MTP XR with PCIE";
	compatible = "qcom,waipio-mtp", "qcom,waipio", "qcom,mtp";
	qcom,msm-id = <457 0x10000>;
	qcom,board-id = <0x10008 7>;
};
