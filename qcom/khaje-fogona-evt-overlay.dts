/* Copyright (c) 2020, The Linux Foundation. All rights reserved.
 *
 * This program is free software; you can redistribute it and/or modify
 * it under the terms of the GNU General Public License version 2 and
 * only version 2 as published by the Free Software Foundation.
 *
 * This program is distributed in the hope that it will be useful,
 * but WITHOUT ANY WARRANTY; without even the implied warranty of
 * MERCHANTABILITY or FITNESS FOR A PARTICULAR PURPOSE.  See the
 * GNU General Public License for more details.
 */

/dts-v1/;
/plugin/;

#include "khaje-fogona-common-overlay.dtsi"
/ {
	model = "fogona";
    compatible = "qcom,khaje-idp", "qcom,khaje", "qcom,idp", "mot.fogona";
    qcom,msm-id = <518 0x10000>, <585 0x10000>, <586 0x10000>;
	qcom,board-id = <0x41 0xA000>;
//	qcom,pmic-id = <0x2D 0x0 0x0 0x0>;
};

