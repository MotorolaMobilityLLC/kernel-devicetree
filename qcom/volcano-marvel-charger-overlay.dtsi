&mmi_charger {
	mmi,upper-limit-capacity = <70>;
	mmi,pd-power-max = <68000>;
	mmi,heartbeat-interval = <10000>;
};

&qti_glink_charger {
	profile-ids-map-7000 = "107000", "ATLSA70NVT", "87000", "LWNSA70SWD", "67000", "COSSA70COS";
	profile-ids-map-5200 = "47000", "ATLSA52NVT", "27000", "VEKSA52VEK";
	profile-ids-map-5600 = "7000", "ATLSA56NVT";
	mmi,df-serialnum-7000 = "ATLSA70NVT";
	mmi,df-serialnum-5200 = "ATLSA52NVT";
	mmi,df-serialnum-5600 = "ATLSA56NVT";
};

&battery_charger {
	qcom,thermal-mitigation = <12000000 11000000 10000000 9000000 8000000 7000000 6000000 5000000 4000000 3000000 2000000 1500000 1000000 500000>;
	qcom,wireless-charging-not-supported;
};
