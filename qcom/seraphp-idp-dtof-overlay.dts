/dts-v1/;
/plugin/;

#include "seraphp-idp.dtsi"

/ {
	model = "Qualcomm Technologies, Inc. SeraphP IDP DTOF";
	compatible = "qcom,seraphp-idp", "qcom,seraphp", "qcom,idp";
	qcom,msm-id = <673 0x10000>;
	qcom,board-id = <0x10022 1>;
};

