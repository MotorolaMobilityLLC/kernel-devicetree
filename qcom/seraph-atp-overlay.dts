/dts-v1/;
/plugin/;

#include "seraph-atp.dtsi"

/ {
	model = "Qualcomm Technologies, Inc. Seraph ATP";
	compatible = "qcom,seraph-atp", "qcom,seraph", "qcom,atp";
	qcom,msm-id = <672 0x10000>;
	qcom,board-id = <0x10021 0>;
};

