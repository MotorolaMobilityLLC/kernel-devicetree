/dts-v1/;
/plugin/;

#include "parrot-mona-sm6450-common-overlay.dtsi"
#include "parrot-wcn6750.dtsi"

/ {
	model = "paro";
	compatible = "qcom,parrot-qrd", "qcom,parrot", "qcom,qrd", "moto,paro";
	qcom,msm-id = <537 0x10000>;
	qcom,board-id = <0x41 0x9000>;
};

