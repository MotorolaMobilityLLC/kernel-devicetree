/dts-v1/;
/plugin/;

#include "pineapple-atp.dtsi"

/ {
	model = "Qualcomm Technologies, Inc. Pineapple ATP";
	compatible = "qcom,pineapple-atp", "qcom,pineapple", "qcom,pineapplep-atp", "qcom,pineapplep", "qcom,atp";
	qcom,msm-id = <557 0x20000>, <577 0x20000>, <682 0x20000>, <696 0x20000>,
			<645 0x20000>, <646 0x20000>, <702 0x20000>;
	qcom,board-id = <0x10021 0>;
};
