/dts-v1/;

#include "neo_luna-v2.dtsi"
#include "neo-aliso-sg2-idp.dtsi"

/ {
	model = "Qualcomm Technologies, Inc. NEO ALISO SG2 IDP Display and GPU";
	compatible = "qcom,neo-idp", "qcom,neo", "qcom,idp";
	qcom,board-id = <34 2>;
};
