/dts-v1/;
/plugin/;

#include "cliffs-arcfox-device-common-overlay.dtsi"

/ {
	model = "arcfox";
	compatible = "qcom,cliffs-mtp", "qcom,cliffs", "qcom,mtp", "qcom,moto";
	qcom,msm-id = <614 0x10000>, <632 0x10000>;
	qcom,board-id = <0x43 0xB1B0>;
};
