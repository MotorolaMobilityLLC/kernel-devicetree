/dts-v1/;

#include "anorak.dtsi"
#include "anorak-atp.dtsi"

/ {
	model = "Qualcomm Technologies, Inc. Anorak ATP";
	compatible = "qcom,anorak-atp", "qcom,anorak", "qcom,atp";
	qcom,board-id = <33 0>;
};
