/*
   This base is original from "volcano-qrd-overlay.dts"
*/

#include "volcano-qrd.dtsi"
#include "volcano-moto-common-charger.dtsi"

&pmiv0104_eusb2_repeater {
	status = "ok";
	vdd18-supply = <&L7B>;
	vdd3-supply = <&L17B>;

	qcom,param-override-seq =
		<0xb 0x51
		 0x2 0x53
		 0x6 0x57>;
	qcom,host-param-override-seq =
		<0xb 0x51
		 0x2 0x53
		 0x6 0x57>;
};

&eusb2_phy0 {
	dummy-supply = <&pmiv0104_eusb2_repeater>;
	usb-repeater = <&pmiv0104_eusb2_repeater>;
};

&ufshc_mem {
        rpm-level = <3>;
        spm-level = <3>;
};
