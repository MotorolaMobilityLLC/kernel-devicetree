/*
 * Copyright (c) 2019, The Linux Foundation. All rights reserved.
 *
 * This program is free software; you can redistribute it and/or modify
 * it under the terms of the GNU General Public License version 2 and
 * only version 2 as published by the Free Software Foundation.
 *
 * This program is distributed in the hope that it will be useful,
 * but WITHOUT ANY WARRANTY; without even the implied warranty of
 * MERCHANTABILITY or FITNESS FOR A PARTICULAR PURPOSE.  See the
 * GNU General Public License for more details.
 */

&qupv3_se0_spi {
	status = "disabled";
};

&qupv3_se0_i2c {
	status = "ok";
	goodix-gtx8@5d {
		compatible = "goodix,gt9886";

	goodix,avdd-name = "avdd";
	avdd-supply = <&L9E>;
	goodix,iovdd-name = "iovdd";
	iovdd-supply = <&L1E>;

		reg = <0x5d>;
		goodix,reset-gpio = <&tlmm 21 0x00>;
		goodix,irq-gpio = <&tlmm 22 0x2008>;
		goodix,irq-flags = <2>; /* 1:trigger rising, 2:trigger falling;*/
		goodix,panel-max-x = <1080>;
		goodix,panel-max-y = <2400>;
		goodix,panel-max-w = <255>;
	};
};
