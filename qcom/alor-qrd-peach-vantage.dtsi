// SPDX-License-Identifier: BSD-3-Clause
/*
 * Copyright (c) Qualcomm Technologies, Inc. and/or its subsidiaries.
 */
&S3D_E0 {
	regulator-min-microvolt = <400000>;
	regulator-max-microvolt = <1004000>;
	qcom,init-voltage = <400000>;
};
