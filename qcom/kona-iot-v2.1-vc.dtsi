#include "kona-iot-vc.dtsi"

&dwc1 {
	dr_mode = "host";
};

&pcie2 {
	qcom,boot-option = <0x0>;
};

&qupv3_se15_i2c {
	status = "ok";
	fsa4480: fsa4480@43 {
		compatible = "qcom,fsa4480-i2c";
		reg = <0x43>;
		io-channels = <&pm8150b_charger PSY_IIO_TYPEC_ACCESSORY_MODE>;
		io-channel-names = "typec_mode";
		qcom,use-power-supply = <1>;
	};
};
