&soc {
	/* Debug UART Instance */
	blsp1_uart2_console: serial@78b1000 {
		compatible = "qcom,msm-uartdm", "qcom,msm-uartdm-v1.4";
		reg = <0x78b1000 0x200>;
		interrupts = <0 118 0>;
		clocks = <&gcc GCC_BLSP1_UART2_APPS_CLK>,
			<&gcc GCC_BLSP1_AHB_CLK>;
		clock-names = "core", "iface";
		pinctrl-names = "active", "sleep";
		pinctrl-0 = <&blsp_uart_tx_a2_active
			     &blsp_uart_rx_a2_active>;
		pinctrl-1 = <&blsp_uart_tx_rx_a2_sleep>;
		status = "disabled";
	};
};
