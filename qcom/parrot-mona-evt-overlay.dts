/dts-v1/;
/plugin/;

#include "parrot-mona-common-overlay.dtsi"

/ {
	model = "mona";
	compatible = "qcom,parrot-qrd", "qcom,parrot", "qcom,qrd", "moto,mona";
	qcom,msm-id = <663 0x10000>;
	qcom,board-id = <0x43 0xA100>;
};

