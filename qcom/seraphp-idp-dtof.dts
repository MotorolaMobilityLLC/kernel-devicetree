/dts-v1/;
/plugin/;

#include "seraphp.dtsi"
#include "seraphp-idp.dtsi"

/ {
	model = "Qualcomm Technologies, Inc. SeraphP IDP DTOF";
	compatible = "qcom,seraphp-idp", "qcom,seraphp", "qcom,idp";
	qcom,board-id = <0x10022 1>;
};

