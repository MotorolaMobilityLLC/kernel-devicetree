/* Copyright (c) 2021, The Linux Foundation. All rights reserved.
 *
 * This program is free software; you can redistribute it and/or modify
 * it under the terms of the GNU General Public License version 2 and
 * only version 2 as published by the Free Software Foundation.
 *
 * This program is distributed in the hope that it will be useful,
 * but WITHOUT ANY WARRANTY; without even the implied warranty of
 * MERCHANTABILITY or FITNESS FOR A PARTICULAR PURPOSE.  See the
 * GNU General Public License for more details.
 */
#include "blair-milanf-common-overlay.dtsi"
#include "blair-pm6125-moto-common-overlay.dtsi"

&pm7250b_charger {
	dpdm-supply = <&usb2_phy0>;
};

&smb1394 {
	status = "disabled";
};
