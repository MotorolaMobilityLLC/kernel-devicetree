/dts-v1/;
/plugin/;

#include "niobe-idp-edp-dual-dpu.dtsi"

/ {
	model = "Qualcomm Technologies, Inc. Niobe IDP EDP DUAL DPU";
	compatible = "qcom,niobe-idp", "qcom,niobe", "qcom,idp";
	qcom,msm-id = <629 0x10000>;
	qcom,board-id = <0x10022 4>;
};
