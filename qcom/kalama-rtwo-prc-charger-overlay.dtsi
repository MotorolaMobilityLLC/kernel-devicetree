&mmi_charger {
		mmi,heartbeat-interval = <10000>;
		mmi,pd-power-max = <68000>;
		mmi,dcp-power-max = <10000>;
		mmi,hvdcp-power-max = <33000>;
};

&qti_glink_charger {
	profile-ids-map = "107000", "SB18D58448", "38000", "SB18D58447";
};

&battery_charger {
	qcom,thermal-mitigation = <12400000 10000000 8000000 7000000 6000000 5000000 4000000 3000000 1500000 1000000 100000>;
	qcom,wireless-fw-name = "cps4038.bin";
};
