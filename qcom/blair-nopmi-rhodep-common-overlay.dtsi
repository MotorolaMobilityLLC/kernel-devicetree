/* Copyright (c) 2021, The Linux Foundation. All rights reserved.
 *
 * This program is free software; you can redistribute it and/or modify
 * it under the terms of the GNU General Public License version 2 and
 * only version 2 as published by the Free Software Foundation.
 *
 * This program is distributed in the hope that it will be useful,
 * but WITHOUT ANY WARRANTY; without even the implied warranty of
 * MERCHANTABILITY or FITNESS FOR A PARTICULAR PURPOSE.  See the
 * GNU General Public License for more details.
 */
#include "blair-rhodep-common-overlay.dtsi"
#include "blair-nopmi-moto-common-overlay.dtsi"
#include "tcpc_config.dtsi"
#include "sgm7220.dtsi"
#include "rt9426a.dtsi"
#include "discrete_charging.dtsi"

&usb0 {
       qcom,force-adb-enable;
};


&qupv3_se8_i2c {
	status = "okay";
	cw2217@64 {
		compatible = "cellwise,cw2217";
		reg = <0x64>;
		status = "okay";

		df-serialnum = "SB18D33989";
		#include "bat_setting/CW_md50-scud-5000mah.dtsi"
		#include "bat_setting/CW_md50-amperex-5000mah.dtsi"
	};
};

