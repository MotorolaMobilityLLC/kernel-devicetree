/* Copyright (c) 2021, The Linux Foundation. All rights reserved.
 *
 * This program is free software; you can redistribute it and/or modify
 * it under the terms of the GNU General Public License version 2 and
 * only version 2 as published by the Free Software Foundation.
 *
 * This program is distributed in the hope that it will be useful,
 * but WITHOUT ANY WARRANTY; without even the implied warranty of
 * MERCHANTABILITY or FITNESS FOR A PARTICULAR PURPOSE.  See the
 * GNU General Public License for more details.
 */

/* This is derivated from Qcom kalama-mtp-overlay.dts */

/dts-v1/;
/plugin/;

#include "kalama-rtwo-device-prc-common-overlay.dtsi"

/ {
	model = "rtwo";
	compatible = "qcom,kalama-mtp", "qcom,kalama", "qcom,mtp", "qcom,rtwo";
	qcom,msm-id = <519 0x10000>, <536 0x10000>, <519 0x20000>, <536 0x20000>;
	qcom,board-id = <0x41 0xC000>;
};

&pm8550b_eusb2_repeater {
	qcom,param-override-seq =
		/* <value reg_offset> */
		/* Adjust HS trasmit amplitude */
		<0xb 0x51
		/* HS disconnect threshold */
		 0x6 0x53
		/* Squelch detection threshold */
		 0x6 0x54
		/* Tx pre-emphasis tuning */
		 0x6 0x57>;
};

&mmi_charger {
	mmi,pd-power-max = <125000>;
};

&battery_charger {
	qcom,thermal-mitigation = <23000000 18000000 16000000 12000000 10000000 8000000 6000000 4000000 3000000 1500000 1000000 300000>;
};
