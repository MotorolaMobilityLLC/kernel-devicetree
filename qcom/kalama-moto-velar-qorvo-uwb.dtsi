/* Copyright (c) 2021, The Linux Foundation. All rights reserved.
 *
 * This program is free software; you can redistribute it and/or modify
 * it under the terms of the GNU General Public License version 2 and
 * only version 2 as published by the Free Software Foundation.
 *
 * This program is distributed in the hope that it will be useful,
 * but WITHOUT ANY WARRANTY; without even the implied warranty of
 * MERCHANTABILITY or FITNESS FOR A PARTICULAR PURPOSE.  See the
 * GNU General Public License for more details.
 */

/* This file is used for velar device which use qorvo UWB chipst */

#include <dt-bindings/gpio/gpio.h>
#include <dt-bindings/clock/qcom,rpmh.h>

&qupv3_se6_spi {
	status = "ok";
	qm35@0 {
		status = "ok";
		compatible = "qorvo,qm35";
		reg = <0>;
		spi-max-frequency = <20000000>;
		reset-gpios = <&tlmm 173 GPIO_ACTIVE_LOW>;
		ss-ready-gpios = <&tlmm 137 (GPIO_ACTIVE_HIGH | GPIO_PULL_DOWN)>;
		wakeup-gpios = <&tlmm 172 GPIO_ACTIVE_HIGH>;
		csn-gpios = <&tlmm 51 GPIO_ACTIVE_LOW>;
		interrupt-parent = <&tlmm>;
		interrupts = <89 IRQ_TYPE_LEVEL_HIGH>;
		clocks = <&rpmhcc RPMH_RF_CLK5>;
		clock-names = "uwb_rf_clk5";

		// Uncomment to bind regulators to qm35-vddX
		// qm35-vdd1-supply = <&reg_ls1_29>;
		// qm35-vdd2-supply = <&reg_ls1_30>;
		// qm35-vdd3-supply = <&reg_ls1_31>;
		// qm35-vdd4-supply = <&reg_ls1_32>;
	};
};

