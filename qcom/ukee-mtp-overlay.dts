/dts-v1/;
/plugin/;

#include "ukee-mtp.dtsi"

/ {
	model = "Qualcomm Technologies, Inc. Ukee MTP";
	compatible = "qcom,ukee-mtp", "qcom,ukee", "qcom,mtp";
	qcom,msm-id = <591 0x10000>;
	qcom,board-id = <8 0>;
};
