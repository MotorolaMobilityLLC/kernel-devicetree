/* Copyright (c) 2021, The Linux Foundation. All rights reserved.
 *
 * This program is free software; you can redistribute it and/or modify
 * it under the terms of the GNU General Public License version 2 and
 * only version 2 as published by the Free Software Foundation.
 *
 * This program is distributed in the hope that it will be useful,
 * but WITHOUT ANY WARRANTY; without even the implied warranty of
 * MERCHANTABILITY or FITNESS FOR A PARTICULAR PURPOSE.  See the
 * GNU General Public License for more details.
 */

/dts-v1/;
/plugin/;

#include "waipio-hiphic-common-overlay.dtsi"
#include "waipio-hiphic-evb-sensor-overlay.dtsi"
#include "waipio-hiphic-key-overlay.dtsi"

/ {
	model = "hiphic";
	compatible = "qcom,waipio-mtp", "qcom,waipio", "qcom,mtp", "moto,hiphic";
	qcom,msm-id = <457 0x10000>, <482 0x10000>;
	qcom,board-id = < 0x45 0x9100>;
};
