// SPDX-License-Identifier: BSD-3-Clause
/*
 * Copyright (c) 2024 Qualcomm Innovation Center, Inc. All rights reserved.
 */

/dts-v1/;
/plugin/;

#include "canoe-vantg-products-common-overlay.dtsi"
#include "canoe-vantg-touchscreen-thp-overlay.dtsi"

/ {
	model = "vantg";
	compatible = "qcom,canoe-qrd", "qcom,canoe", "qcom,canoep-cdp", "qcom,canoep",
			   "qcom,qrd";
	qcom,msm-id = <660 0x10000>, <660 0x20000>, <661 0x10000>, <661 0x20000>,
		      <0x1000294 0x10000>, <0x1000294 0x20000>,
		      <0x1000295 0x10000>, <0x1000295 0x20000>;
	qcom,board-id = <0x41 0xB1A0>;
};
