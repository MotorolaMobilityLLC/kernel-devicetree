/dts-v1/;
/plugin/;

#include "neo-aliso-sg2-atp.dtsi"

/ {
	model = "Qualcomm Technologies, Inc. NEO ALISO SG2 ATP";
	compatible = "qcom,neo-atp", "qcom,neo", "qcom,atp";
	qcom,msm-id = <740 0x10000>;
	qcom,board-id = <33 1>;
};
