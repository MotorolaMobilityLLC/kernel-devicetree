/* Copyright (c) 2021, The Linux Foundation. All rights reserved.
 *
 * This program is free software; you can redistribute it and/or modify
 * it under the terms of the GNU General Public License version 2 and
 * only version 2 as published by the Free Software Foundation.
 *
 * This program is distributed in the hope that it will be useful,
 * but WITHOUT ANY WARRANTY; without even the implied warranty of
 * MERCHANTABILITY or FITNESS FOR A PARTICULAR PURPOSE.  See the
 * GNU General Public License for more details.
 */

/dts-v1/;
/plugin/;

#include "holi-cypfq-common-overlay.dtsi"

/ {
	model = "cypfq";
	compatible = "qcom,holi-cypfq", "qcom,holi-moto", "qcom,holi";
	qcom,msm-id = <454 0x10000>, <472 0x10000>;
	qcom,board-id = <0x47 0xB100>;
};


&dsi_csot_gc7372_678_fhd_video {
	qcom,mdss-dsi-display-timings {
		timing@0 {
			qcom,mdss-dsi-on-command =
			[
					39 01 00 00 00 00 04 FF 55 AA 66
					15 01 00 00 00 00 02 FF 23
					15 01 00 00 00 00 02 FB 00
					15 01 00 00 00 00 02 2E 2B
					15 01 00 00 00 00 02 32 01
					15 01 00 00 00 00 02 FF 10
					15 01 00 00 00 00 02 FB 00
					15 01 00 00 00 00 02 36 08
					15 01 00 00 00 00 02 BA 03
					15 01 00 00 00 00 02 69 00
					15 01 00 00 00 00 02 35 00
					15 01 00 00 00 00 02 53 2C
					15 01 00 00 00 00 02 55 01
					05 01 00 00 96 00 01 11
					05 01 00 00 32 00 01 29
			];
		};
	};
};
