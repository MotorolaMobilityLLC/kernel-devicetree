/dts-v1/;
/plugin/;

/ {
	model = "Qualcomm Technologies, Inc. Monaco Multi LA Virtual Machine";
	compatible = "qcom,monaco", "qcom,quinvm";
	qcom,msm-id = <606 0x10000>;
	qcom,board-id = <0x0 0x2000001>;
};
