/dts-v1/;
/plugin/;

#include "parrot-boston-common-overlay.dtsi"

/ {
	model = "boston";
	compatible = "qcom,parrot-qrd", "qcom,parrot", "qcom,qrd", "moto,boston";
	qcom,msm-id = <537 0x10000>;
	qcom,board-id = <0x44 0xB100>;
	qcom,pmic-id-size = <9>;
	qcom,pmic-id = <0x0 0x0 0x0 0x0 0x0 0x0 0x0 0x0 0x0>;
};

&soc {
	pen_detect{
		compatible = "hall_pen_detect";
		pinctrl-names = "default","sleep";
		pinctrl-0 = <&pen_int_default>;
		pinctrl-1 = <&pen_int_sleep>;
		hall,factory-class-name = "hall_16";
		hall,input-dev-name = "pen_detect";
		hall_vdd-supply = <&L8E>;
		hall,nirq-gpio-num = <1>;
		hall,nirq-gpio_0 = <&tlmm 31 0x02>;
		hall,nirq-gpio-high-val_0 = <0>;
		hall,nirq-gpio-low-val_0 = <1>;
	};
};

