&mdss_mdp {
	mot_tm_u8_nt37703_655_1080x2400_dsc_vid: qcom,mdss_dsi_mot_tm_u8_nt37703_655_1080x2400_dsc_vid {
		qcom,mdss-dsi-panel-name =
			"mipi_moto_vid_tm_u8_1080p_dsc_655";
		qcom,mdss-dsi-panel-type = "dsi_video_mode";
		qcom,mdss-dsi-panel-physical-type = "oled";
		qcom,mdss-dsi-virtual-channel-id = <0>;
		qcom,mdss-dsi-stream = <0>;
		qcom,dsi-ctrl-num = <0>;
		qcom,dsi-phy-num = <0>;
		qcom,mdss-pan-physical-width-dimension = <69>;
		qcom,mdss-pan-physical-height-dimension = <152>;
		qcom,mdss-dsi-bpp = <30>;
		qcom,mdss-dsi-underflow-color = <0xff>;
		qcom,mdss-dsi-border-color = <0>;

		qcom,mdss-dsi-traffic-mode = "non_burst_sync_event";
		//qcom,mdss-dsi-lane-map = "lane_map_0123";
		qcom,mdss-dsi-bllp-eof-power-mode;
		qcom,mdss-dsi-bllp-power-mode;
		qcom,mdss-dsi-lp11-init;
		qcom,mdss-dsi-lane-0-state;
		qcom,mdss-dsi-lane-1-state;
		qcom,mdss-dsi-lane-2-state;
		qcom,mdss-dsi-lane-3-state;
		qcom,mdss-dsi-dma-trigger = "trigger_sw";
		qcom,mdss-dsi-mdp-trigger = "none";
		qcom,mdss-dsi-dma-schedule-line = <15>;
		qcom,mdss-dsi-reset-sequence = <1 10>, <0 10>, <1 10>;

		qcom,bklt-dcs-2bytes-enabled;

		qcom,mdss-dsi-panel-hdr-enabled;
		qcom,mdss-dsi-panel-hdr-color-primaries = <14500 15500 32000
					17000 15500 30000 8000 3000>;
		qcom,mdss-dsi-panel-peak-brightness = <4200000>;

		qcom,mdss-dsi-panel-blackness-level = <3230>;

		qcom,mdss-dsi-dc-off-command = [
				39 01 00 00 00 00 03 8B 00 00];
		qcom,mdss-dsi-dc-off-command-state = "dsi_hs_mode";
		qcom,mdss-dsi-dc-on-command = [
				39 01 00 00 00 00 03 8B 00 81];
		qcom,mdss-dsi-dc-on-command-state = "dsi_hs_mode";

		qcom,mdss-dsi-hbm-on-command = [
				39 01 00 00 00 00 0E A9 01 00 51 09 0A 00 00 01 00 87 00 00 20];
		qcom,mdss-dsi-hbm-on-command-state = "dsi_hs_mode";

		qcom,mdss-dsi-hbm-off-command = [
				39 01 00 00 00 00 0E A9 01 00 51 09 0A 00 00 01 00 87 00 00 20];
		qcom,mdss-dsi-hbm-off-command-state = "dsi_hs_mode";

		qcom,mdss-dsi-hbm-fod;
		qcom,mdss-dsi-hbm-fod-on-command = [
				39 01 00 00 00 00 0E A9 01 00 51 09 0A 8F FF 01 00 87 00 00 25];
		qcom,mdss-dsi-hbm-fod-on-command-state = "dsi_hs_mode";

		qcom,mdss-dsi-panel-lhbm-wait-fps-valid;
		qcom,mdss-dsi-panel-local-hbm-wait-fps-count = <68>;
		qcom,mdss-dsi-panel-local-hbm-wait-fps-interval = <2>;
		qcom,mdss-dsi-panel-lhbm-not-allowed-fps-list = <60 90>;

		qcom,mdss-dsi-display-timings {
			timing@0 {
				cell-index = <0>;
				qcom,mdss-dsi-panel-framerate = <60>;
				qcom,mdss-dsi-panel-width = <1080>;
				qcom,mdss-dsi-panel-height = <2400>;
				qcom,mdss-dsi-h-front-porch = <16>;
				qcom,mdss-dsi-h-back-porch = <16>;
				qcom,mdss-dsi-h-pulse-width = <4>;
				qcom,mdss-dsi-h-sync-skew = <0>;
				qcom,mdss-dsi-v-back-porch = <14>;
				qcom,mdss-dsi-v-front-porch = <3488>;
				qcom,mdss-dsi-v-pulse-width = <2>;
				qcom,mdss-dsi-h-left-border = <0>;
				qcom,mdss-dsi-h-right-border = <0>;
				qcom,mdss-dsi-v-top-border = <0>;
				qcom,mdss-dsi-v-bottom-border = <0>;

				qcom,mdss-dsi-on-command = [
					39 01 00 00 00 00 06 F0 55 AA 52 08 00
					39 01 00 00 00 00 02 6F 06
					39 01 00 00 00 00 02 B5 39
					39 01 00 00 00 00 02 6F 07
					39 01 00 00 00 00 05 B5 00 35 00 00
					39 01 00 00 00 00 02 6F 18
					39 01 00 00 00 00 02 B5 00
					39 01 00 00 00 00 02 6F 19
					39 01 00 00 00 00 02 B5 0B
					39 01 00 00 00 00 02 6F 22
					39 01 00 00 00 00 02 B5 21
					39 01 00 00 00 00 06 88 01 02 1B 08 77
					39 01 00 00 00 00 02 87 20
					39 01 00 00 00 00 05 2A 00 00 04 37
					39 01 00 00 00 00 05 2B 00 00 09 5F
					39 01 00 00 00 00 03 90 03 03
					39 01 00 00 00 00 02 53 20
					39 01 00 00 00 00 05 FF AA 55 A5 80
					39 01 00 00 00 00 02 6F 15
					39 01 00 00 00 00 03 F8 01 E1
					39 01 00 00 00 00 05 FF AA 55 A5 80
					39 01 00 00 00 00 02 6F 17
					39 01 00 00 00 00 02 F4 02
					39 01 00 00 00 00 05 FF AA 55 A5 81
					39 01 00 00 00 00 02 6F 13
					39 01 00 00 00 00 02 F9 01
					39 01 00 00 00 00 05 FF AA 55 A5 81
					39 01 00 00 00 00 02 6F 3C
					39 01 00 00 00 00 02 F5 81
					39 01 00 00 00 00 02 35 00
					39 01 00 00 00 00 03 51 0D BA
					39 01 00 00 00 00 02 2F 03
					39 01 00 00 00 00 06 F0 55 AA 52 08 01
					39 01 00 00 00 00 02 6F 03
					39 01 00 00 00 00 02 C7 47
					39 01 00 00 00 00 02 5F 80
					39 01 00 00 00 00 06 F0 55 AA 52 08 00
					39 01 00 00 00 00 02 6F 34
					39 01 00 00 00 00 02 DF 35
					05 01 00 00 78 00 01 11
					05 01 00 00 14 00 01 29
				];

				qcom,mdss-dsi-off-command = [
					05 01 00 00 14 00 02 28 00
					05 01 00 00 78 00 02 10 00];
				qcom,mdss-dsi-on-command-state = "dsi_lp_mode";
				qcom,mdss-dsi-off-command-state = "dsi_lp_mode";
				qcom,mdss-dsi-h-sync-pulse = <0>;
				qcom,compression-mode = "dsc";
				qcom,mdss-dsc-slice-height = <20>;
				qcom,mdss-dsc-slice-width = <540>;
				qcom,mdss-dsc-slice-per-pkt = <2>;
				qcom,mdss-dsc-bit-per-component = <10>;
				qcom,mdss-dsc-bit-per-pixel = <8>;
				qcom,mdss-dsc-block-prediction-enable;
				qcom,mdss-dsc-novateck-ic;
				qcom,mdss-dsi-dfps-60-command = [
					39 01 00 00 00 00 02 2F 03];
				qcom,mdss-dsi-dfps-60-command-state = "dsi_hs_mode";

				qcom,mdss-dsi-dfps-90-command = [
					39 01 00 00 00 00 02 2F 02];
				qcom,mdss-dsi-dfps-90-command-state = "dsi_hs_mode";

				qcom,mdss-dsi-dfps-120-command = [
					39 01 00 00 00 00 02 2F 01];
				qcom,mdss-dsi-dfps-120-command-state = "dsi_hs_mode";
			};
		};
	};
};
